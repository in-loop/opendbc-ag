VERSION "created by canmatrix"

NS_ :

BS_:

BU_:

BO_ 2147547826 VDMA_FAB2_High_Voltage_Energy_St: 8 Vector__XXX
 SG_ High_Voltage_Energy_Storage_Pack : 0|64@1+ (1,0) [0|18446744073709551615] "" Vector__XXX

BO_ 2147547827 VDMA_FAB3_AUTOSAR_Time_Synchroni: 8 Vector__XXX
 SG_ AUTOSAR_Time_Synchronization_Raw : 0|64@1+ (1,0) [0|18446744073709551615] "" Vector__XXX

BO_ 2147547828 VDMA_FAB4_EV_DC_Charging_Limits_: 8 Vector__XXX
 SG_ EV_DC_Charging_Limits_1_RawPaylo : 0|64@1+ (1,0) [0|18446744073709551615] "" Vector__XXX

BO_ 2147547829 VDMA_FAB5_EVSE_DC_Charging_Limit: 8 Vector__XXX
 SG_ EVSE_DC_Charging_Limits_1_RawPay : 0|64@1+ (1,0) [0|18446744073709551615] "" Vector__XXX

BO_ 2147547830 VDMA_FAB6_EVSE_DC_Charging_Limit: 8 Vector__XXX
 SG_ EVSE_DC_Charging_Limits_2_RawPay : 0|64@1+ (1,0) [0|18446744073709551615] "" Vector__XXX

BO_ 2147547831 VDMA_FAB7_EV_DC_Charging_Target: 8 Vector__XXX
 SG_ EV_DC_Charging_Target_RawPayload : 0|64@1+ (1,0) [0|18446744073709551615] "" Vector__XXX

BO_ 2147547832 VDMA_FAB8_EVSE_DC_Status_1: 8 Vector__XXX
 SG_ EVSE_DC_Status_1_RawPayload : 0|64@1+ (1,0) [0|18446744073709551615] "" Vector__XXX

BO_ 2147547833 VDMA_FAB9_EVSE_1_Contactor_Cmd_1: 8 Vector__XXX
 SG_ EVSE_1_Contactor_Cmd_1_RawPayloa : 0|64@1+ (1,0) [0|18446744073709551615] "" Vector__XXX

BO_ 2147547834 VDMA_FABA_EVSE_1_Contactor_Statu: 8 Vector__XXX
 SG_ EVSE_1_Contactor_Status_1_RawPay : 0|64@1+ (1,0) [0|18446744073709551615] "" Vector__XXX

BO_ 2147547835 VDMA_FABB_Direct_Lamp_Control_Co: 8 Vector__XXX
 SG_ Direct_Lamp_Control_Command_3_Ra : 0|64@1+ (1,0) [0|18446744073709551615] "" Vector__XXX

BO_ 2147547836 VDMA_FABC_Direct_Lamp_Control_Da: 8 Vector__XXX
 SG_ Direct_Lamp_Control_Data_3_RawPa : 0|64@1+ (1,0) [0|18446744073709551615] "" Vector__XXX

BO_ 2147547837 VDMA_FABD_Motor_Generator_1_Life: 8 Vector__XXX
 SG_ Motor_Generator_1_Lifetime_Data_ : 0|64@1+ (1,0) [0|18446744073709551615] "" Vector__XXX

BO_ 2147547838 VDMA_FABE_Motor_Generator_2_Life: 8 Vector__XXX
 SG_ Motor_Generator_2_Lifetime_Data_ : 0|64@1+ (1,0) [0|18446744073709551615] "" Vector__XXX

BO_ 2147547839 VDMA_FABF_Motor_Generator_3_Life: 8 Vector__XXX
 SG_ Motor_Generator_3_Lifetime_Data_ : 0|64@1+ (1,0) [0|18446744073709551615] "" Vector__XXX

BO_ 2147547840 VDMA_FAC0_Motor_Generator_4_Life: 8 Vector__XXX
 SG_ Motor_Generator_4_Lifetime_Data_ : 0|64@1+ (1,0) [0|18446744073709551615] "" Vector__XXX

BO_ 2147547841 VDMA_FAC1_Motor_Generator_5_Life: 8 Vector__XXX
 SG_ Motor_Generator_5_Lifetime_Data_ : 0|64@1+ (1,0) [0|18446744073709551615] "" Vector__XXX

BO_ 2147547842 VDMA_FAC2_Motor_Generator_6_Life: 8 Vector__XXX
 SG_ Motor_Generator_6_Lifetime_Data_ : 0|64@1+ (1,0) [0|18446744073709551615] "" Vector__XXX

BO_ 2147547843 VDMA_FAC3_Air_Supply_Pressure_3: 8 Vector__XXX
 SG_ Air_Supply_Pressure_3_RawPayload : 0|64@1+ (1,0) [0|18446744073709551615] "" Vector__XXX

BO_ 2147547844 VDMA_FAC4_EVSE_AC_Supply_Voltage: 8 Vector__XXX
 SG_ EVSE_AC_Supply_Voltage_RawPayloa : 0|64@1+ (1,0) [0|18446744073709551615] "" Vector__XXX

BO_ 2147547845 VDMA_FAC5_EVSE_AC_3_Phase_Load: 8 Vector__XXX
 SG_ EVSE_AC_3_Phase_Load_RawPayload : 0|64@1+ (1,0) [0|18446744073709551615] "" Vector__XXX

BO_ 2147547846 VDMA_FAC6_Electronic_Retarder_Co: 8 Vector__XXX
 SG_ Electronic_Retarder_Controller_3 : 0|64@1+ (1,0) [0|18446744073709551615] "" Vector__XXX

BO_ 2147547848 VDMA_FAC8_Electronic_Transmissio: 8 Vector__XXX
 SG_ Electronic_Transmission_Controll : 0|64@1+ (1,0) [0|18446744073709551615] "" Vector__XXX

BO_ 2147547851 VDMA_FACB_Collision_Avoidance_Sy: 8 Vector__XXX
 SG_ Collision_Avoidance_System_4_Raw : 0|64@1+ (1,0) [0|18446744073709551615] "" Vector__XXX

BO_ 2147547852 VDMA_FACC_Collision_Avoidance_Sy: 8 Vector__XXX
 SG_ Collision_Avoidance_System_3_Raw : 0|64@1+ (1,0) [0|18446744073709551615] "" Vector__XXX

BO_ 2147547853 VDMA_FACD_Aftertreatment_1_SCR_E: 8 Vector__XXX
 SG_ Aftertreatment_1_SCR_Exhaust_Gas : 0|64@1+ (1,0) [0|18446744073709551615] "" Vector__XXX

BO_ 2147547854 VDMA_FACE_PTO_Information_2: 8 Vector__XXX
 SG_ PTO_Information_2_RawPayload : 0|64@1+ (1,0) [0|18446744073709551615] "" Vector__XXX

BO_ 2147547855 VDMA_FACF_EVCC_Diagnostic_Data_1: 8 Vector__XXX
 SG_ EVCC_Diagnostic_Data_1_RawPayloa : 0|64@1+ (1,0) [0|18446744073709551615] "" Vector__XXX

BO_ 2147547856 VDMA_FAD0_Cab_Door_Control_2: 8 Vector__XXX
 SG_ Cab_Door_Control_2_RawPayload : 0|64@1+ (1,0) [0|18446744073709551615] "" Vector__XXX

BO_ 2147547857 VDMA_FAD1_Engine_Average_Informa: 8 Vector__XXX
 SG_ Engine_Average_Information_2_Raw : 0|64@1+ (1,0) [0|18446744073709551615] "" Vector__XXX

BO_ 2147547858 VDMA_FAD2_Turbocharger_Informati: 8 Vector__XXX
 SG_ Turbocharger_Information_9_RawPa : 0|64@1+ (1,0) [0|18446744073709551615] "" Vector__XXX

BO_ 2147547859 VDMA_FAD3_Automated_Driving_Syst: 8 Vector__XXX
 SG_ Automated_Driving_System_Control : 0|64@1+ (1,0) [0|18446744073709551615] "" Vector__XXX

BO_ 2147547860 VDMA_FAD4_EVSE_AC_Status_2: 8 Vector__XXX
 SG_ EVSE_AC_Status_2_RawPayload : 0|64@1+ (1,0) [0|18446744073709551615] "" Vector__XXX

BO_ 2147547861 VDMA_FAD5_EVSE_AC_Status_1: 8 Vector__XXX
 SG_ EVSE_AC_Status_1_RawPayload : 0|64@1+ (1,0) [0|18446744073709551615] "" Vector__XXX

BO_ 2147547862 VDMA_FAD6_EVSE_Status_1: 8 Vector__XXX
 SG_ EVSE_Status_1_RawPayload : 0|64@1+ (1,0) [0|18446744073709551615] "" Vector__XXX

BO_ 2147547863 VDMA_FAD7_Object_Detection_Messa: 8 Vector__XXX
 SG_ Object_Detection_Message_1_1_Raw : 0|64@1+ (1,0) [0|18446744073709551615] "" Vector__XXX

BO_ 2147547864 VDMA_FAD8_Object_Detection_Messa: 8 Vector__XXX
 SG_ Object_Detection_Message_2_1_Raw : 0|64@1+ (1,0) [0|18446744073709551615] "" Vector__XXX

BO_ 2147547865 VDMA_FAD9_Object_Detection_Messa: 8 Vector__XXX
 SG_ Object_Detection_Message_2_2_Raw : 0|64@1+ (1,0) [0|18446744073709551615] "" Vector__XXX

BO_ 2147547866 VDMA_FADA_Object_Detection_Messa: 8 Vector__XXX
 SG_ Object_Detection_Message_2_3_Raw : 0|64@1+ (1,0) [0|18446744073709551615] "" Vector__XXX

BO_ 2147547867 VDMA_FADB_Object_Detection_Messa: 8 Vector__XXX
 SG_ Object_Detection_Message_2_4_Raw : 0|64@1+ (1,0) [0|18446744073709551615] "" Vector__XXX

BO_ 2147547868 VDMA_FADC_Object_Detection_Messa: 8 Vector__XXX
 SG_ Object_Detection_Message_2_5_Raw : 0|64@1+ (1,0) [0|18446744073709551615] "" Vector__XXX

BO_ 2147547869 VDMA_FADD_Object_Detection_Messa: 8 Vector__XXX
 SG_ Object_Detection_Message_2_6_Raw : 0|64@1+ (1,0) [0|18446744073709551615] "" Vector__XXX

BO_ 2147547870 VDMA_FADE_Object_Detection_Messa: 8 Vector__XXX
 SG_ Object_Detection_Message_2_7_Raw : 0|64@1+ (1,0) [0|18446744073709551615] "" Vector__XXX

BO_ 2147547871 VDMA_FADF_Object_Detection_Messa: 8 Vector__XXX
 SG_ Object_Detection_Message_2_8_Raw : 0|64@1+ (1,0) [0|18446744073709551615] "" Vector__XXX

BO_ 2147547872 VDMA_FAE0_Object_Detection_Messa: 8 Vector__XXX
 SG_ Object_Detection_Message_2_9_Raw : 0|64@1+ (1,0) [0|18446744073709551615] "" Vector__XXX

BO_ 2147547873 VDMA_FAE1_Object_Detection_Messa: 8 Vector__XXX
 SG_ Object_Detection_Message_2_10_Ra : 0|64@1+ (1,0) [0|18446744073709551615] "" Vector__XXX

BO_ 2147547874 VDMA_FAE2_Object_Detection_Messa: 8 Vector__XXX
 SG_ Object_Detection_Message_2_11_Ra : 0|64@1+ (1,0) [0|18446744073709551615] "" Vector__XXX

BO_ 2147547875 VDMA_FAE3_Object_Detection_Messa: 8 Vector__XXX
 SG_ Object_Detection_Message_2_12_Ra : 0|64@1+ (1,0) [0|18446744073709551615] "" Vector__XXX

BO_ 2147547876 VDMA_FAE4_Object_Detection_Messa: 8 Vector__XXX
 SG_ Object_Detection_Message_2_13_Ra : 0|64@1+ (1,0) [0|18446744073709551615] "" Vector__XXX

BO_ 2147547877 VDMA_FAE5_Object_Detection_Messa: 8 Vector__XXX
 SG_ Object_Detection_Message_2_14_Ra : 0|64@1+ (1,0) [0|18446744073709551615] "" Vector__XXX

BO_ 2147547878 VDMA_FAE6_Object_Detection_Messa: 8 Vector__XXX
 SG_ Object_Detection_Message_2_15_Ra : 0|64@1+ (1,0) [0|18446744073709551615] "" Vector__XXX

BO_ 2147547879 VDMA_FAE7_Object_Detection_Messa: 8 Vector__XXX
 SG_ Object_Detection_Message_2_16_Ra : 0|64@1+ (1,0) [0|18446744073709551615] "" Vector__XXX

BO_ 2147547880 VDMA_FAE8_Object_Detection_Messa: 8 Vector__XXX
 SG_ Object_Detection_Message_2_17_Ra : 0|64@1+ (1,0) [0|18446744073709551615] "" Vector__XXX

BO_ 2147547881 VDMA_FAE9_Object_Detection_Messa: 8 Vector__XXX
 SG_ Object_Detection_Message_2_18_Ra : 0|64@1+ (1,0) [0|18446744073709551615] "" Vector__XXX

BO_ 2147547882 VDMA_FAEA_Object_Detection_Messa: 8 Vector__XXX
 SG_ Object_Detection_Message_2_19_Ra : 0|64@1+ (1,0) [0|18446744073709551615] "" Vector__XXX

BO_ 2147547883 VDMA_FAEB_Object_Detection_Messa: 8 Vector__XXX
 SG_ Object_Detection_Message_2_20_Ra : 0|64@1+ (1,0) [0|18446744073709551615] "" Vector__XXX

BO_ 2147547884 VDMA_FAEC_Object_Detection_Messa: 8 Vector__XXX
 SG_ Object_Detection_Message_2_21_Ra : 0|64@1+ (1,0) [0|18446744073709551615] "" Vector__XXX

BO_ 2147547885 VDMA_FAED_Temperature_Sensing_Mo: 8 Vector__XXX
 SG_ Temperature_Sensing_Module_1_Raw : 0|64@1+ (1,0) [0|18446744073709551615] "" Vector__XXX

BO_ 2147547886 VDMA_FAEE_Temperature_Sensing_Mo: 8 Vector__XXX
 SG_ Temperature_Sensing_Module_2_Raw : 0|64@1+ (1,0) [0|18446744073709551615] "" Vector__XXX

BO_ 2147547887 VDMA_FAEF_Aftertreatment_2_SCR_S: 8 Vector__XXX
 SG_ Aftertreatment_2_SCR_Service_Inf : 0|64@1+ (1,0) [0|18446744073709551615] "" Vector__XXX

BO_ 2147547888 VDMA_FAF0_Aftertreatment_1_SCR_S: 8 Vector__XXX
 SG_ Aftertreatment_1_SCR_Service_Inf : 0|64@1+ (1,0) [0|18446744073709551615] "" Vector__XXX

BO_ 2147547889 VDMA_FAF1_PSA_Times_Lifetime_Hou: 8 Vector__XXX
 SG_ PSA_Times_Lifetime_Hours_RawPayl : 0|64@1+ (1,0) [0|18446744073709551615] "" Vector__XXX

BO_ 2147547890 VDMA_FAF2_PSA_Times_Stored_100_H: 8 Vector__XXX
 SG_ PSA_Times_Stored_100_Hours_RawPa : 0|64@1+ (1,0) [0|18446744073709551615] "" Vector__XXX

BO_ 2147547891 VDMA_FAF3_PSA_Times_Active_100_H: 8 Vector__XXX
 SG_ PSA_Times_Active_100_Hours_RawPa : 0|64@1+ (1,0) [0|18446744073709551615] "" Vector__XXX

BO_ 2147547892 VDMA_FAF4_Hybrid_Charge_Depletin: 8 Vector__XXX
 SG_ Hybrid_Charge_Depleting_or_Incre : 0|64@1+ (1,0) [0|18446744073709551615] "" Vector__XXX

BO_ 2147547893 VDMA_FAF5_Hybrid_Charge_Depletin: 8 Vector__XXX
 SG_ Hybrid_Charge_Depleting_or_Incre : 0|64@1+ (1,0) [0|18446744073709551615] "" Vector__XXX

BO_ 2147547894 VDMA_FAF6_Hybrid_Charge_Depletin: 8 Vector__XXX
 SG_ Hybrid_Charge_Depleting_or_Incre : 0|64@1+ (1,0) [0|18446744073709551615] "" Vector__XXX

BO_ 2147547895 VDMA_FAF7_Aftertreatment_1_Histo: 8 Vector__XXX
 SG_ Aftertreatment_1_Historical_Info : 0|64@1+ (1,0) [0|18446744073709551615] "" Vector__XXX

BO_ 2147547896 VDMA_FAF8_Engine_Maximum_Net_Tor: 8 Vector__XXX
 SG_ Engine_Maximum_Net_Torque_Map_Ra : 0|64@1+ (1,0) [0|18446744073709551615] "" Vector__XXX

BO_ 2147547897 VDMA_FAF9_Aftertreatment_1_SCR_2: 8 Vector__XXX
 SG_ Aftertreatment_1_SCR_2_NOx_Mass_ : 0|64@1+ (1,0) [0|18446744073709551615] "" Vector__XXX

BO_ 2147547898 VDMA_FAFA_Aftertreatment_1_SCR_1: 8 Vector__XXX
 SG_ Aftertreatment_1_SCR_1_NOx_Mass_ : 0|64@1+ (1,0) [0|18446744073709551615] "" Vector__XXX

BO_ 2147547899 VDMA_FAFB_Evaporative_System_Pre: 8 Vector__XXX
 SG_ Evaporative_System_Pressure_and_ : 0|64@1+ (1,0) [0|18446744073709551615] "" Vector__XXX

BO_ 2147547900 VDMA_FAFC_GHG_Tracking_Lifetime_: 8 Vector__XXX
 SG_ GHG_Tracking_Lifetime_Array_Data : 0|64@1+ (1,0) [0|18446744073709551615] "" Vector__XXX

BO_ 2147547901 VDMA_FAFD_GHG_Tracking_Stored_10: 8 Vector__XXX
 SG_ GHG_Tracking_Stored_100_Hour_Arr : 0|64@1+ (1,0) [0|18446744073709551615] "" Vector__XXX

BO_ 2147547902 VDMA_FAFE_GHG_Tracking_Active_10: 8 Vector__XXX
 SG_ GHG_Tracking_Active_100_Hour_Arr : 0|64@1+ (1,0) [0|18446744073709551615] "" Vector__XXX

BO_ 2147547903 VDMA_FAFF_Green_House_Gas_Stored: 8 Vector__XXX
 SG_ Green_House_Gas_Stored_100_Hour_ : 0|64@1+ (1,0) [0|18446744073709551615] "" Vector__XXX

BO_ 2147547904 VDMA_FB00_Green_House_Gas_Active: 8 Vector__XXX
 SG_ Green_House_Gas_Active_100_Hour_ : 0|64@1+ (1,0) [0|18446744073709551615] "" Vector__XXX

BO_ 2147547905 VDMA_FB01_Green_House_Gas_Lifeti: 8 Vector__XXX
 SG_ Green_House_Gas_Lifetime_Active_ : 0|64@1+ (1,0) [0|18446744073709551615] "" Vector__XXX

BO_ 2147547906 VDMA_FB02_NOx_Tracking_Engine_Ac: 8 Vector__XXX
 SG_ NOx_Tracking_Engine_Activity_Lif : 0|64@1+ (1,0) [0|18446744073709551615] "" Vector__XXX

BO_ 2147547907 VDMA_FB03_NOx_Tracking_Engine_Ac: 8 Vector__XXX
 SG_ NOx_Tracking_Engine_Activity_Lif : 0|64@1+ (1,0) [0|18446744073709551615] "" Vector__XXX

BO_ 2147547908 VDMA_FB04_NOx_Tracking_Engine_Ac: 8 Vector__XXX
 SG_ NOx_Tracking_Engine_Activity_Lif : 0|64@1+ (1,0) [0|18446744073709551615] "" Vector__XXX

BO_ 2147547909 VDMA_FB05_NOx_Tracking_Engine_Ac: 8 Vector__XXX
 SG_ NOx_Tracking_Engine_Activity_Lif : 0|64@1+ (1,0) [0|18446744073709551615] "" Vector__XXX

BO_ 2147547910 VDMA_FB06_NOx_Tracking_Valid_NOx: 8 Vector__XXX
 SG_ NOx_Tracking_Valid_NOx_Lifetime_ : 0|64@1+ (1,0) [0|18446744073709551615] "" Vector__XXX

BO_ 2147547911 VDMA_FB07_NOx_Tracking_Valid_NOx: 8 Vector__XXX
 SG_ NOx_Tracking_Valid_NOx_Lifetime_ : 0|64@1+ (1,0) [0|18446744073709551615] "" Vector__XXX

BO_ 2147547912 VDMA_FB08_NOx_Tracking_Valid_NOx: 8 Vector__XXX
 SG_ NOx_Tracking_Valid_NOx_Lifetime_ : 0|64@1+ (1,0) [0|18446744073709551615] "" Vector__XXX

BO_ 2147547913 VDMA_FB09_NOx_Tracking_Valid_NOx: 8 Vector__XXX
 SG_ NOx_Tracking_Valid_NOx_Lifetime_ : 0|64@1+ (1,0) [0|18446744073709551615] "" Vector__XXX

BO_ 2147547914 VDMA_FB0A_NOx_Tracking_Valid_NOx: 8 Vector__XXX
 SG_ NOx_Tracking_Valid_NOx_Lifetime_ : 0|64@1+ (1,0) [0|18446744073709551615] "" Vector__XXX

BO_ 2147547915 VDMA_FB0B_NOx_Tracking_Valid_NOx: 8 Vector__XXX
 SG_ NOx_Tracking_Valid_NOx_Lifetime_ : 0|64@1+ (1,0) [0|18446744073709551615] "" Vector__XXX

BO_ 2147547916 VDMA_FB0C_NOx_Tracking_Stored_10: 8 Vector__XXX
 SG_ NOx_Tracking_Stored_100_Hour_Fue : 0|64@1+ (1,0) [0|18446744073709551615] "" Vector__XXX

BO_ 2147547917 VDMA_FB0D_NOx_Tracking_Stored_10: 8 Vector__XXX
 SG_ NOx_Tracking_Stored_100_Hour_Eng : 0|64@1+ (1,0) [0|18446744073709551615] "" Vector__XXX

BO_ 2147547918 VDMA_FB0E_NOx_Tracking_Stored_10: 8 Vector__XXX
 SG_ NOx_Tracking_Stored_100_Hour_Veh : 0|64@1+ (1,0) [0|18446744073709551615] "" Vector__XXX

BO_ 2147547919 VDMA_FB0F_NOx_Tracking_Stored_10: 8 Vector__XXX
 SG_ NOx_Tracking_Stored_100_Hour_Eng : 0|64@1+ (1,0) [0|18446744073709551615] "" Vector__XXX

BO_ 2147547920 VDMA_FB10_NOx_Tracking_Stored_10: 8 Vector__XXX
 SG_ NOx_Tracking_Stored_100_Hour_Eng : 0|64@1+ (1,0) [0|18446744073709551615] "" Vector__XXX

BO_ 2147547921 VDMA_FB11_NOx_Tracking_Stored_10: 8 Vector__XXX
 SG_ NOx_Tracking_Stored_100_Hour_Sys : 0|64@1+ (1,0) [0|18446744073709551615] "" Vector__XXX

BO_ 2147547922 VDMA_FB12_NOx_Tracking_Active_10: 8 Vector__XXX
 SG_ NOx_Tracking_Active_100_Hour_Fue : 0|64@1+ (1,0) [0|18446744073709551615] "" Vector__XXX

BO_ 2147547923 VDMA_FB13_NOx_Tracking_Active_10: 8 Vector__XXX
 SG_ NOx_Tracking_Active_100_Hour_Eng : 0|64@1+ (1,0) [0|18446744073709551615] "" Vector__XXX

BO_ 2147547924 VDMA_FB14_NOx_Tracking_Active_10: 8 Vector__XXX
 SG_ NOx_Tracking_Active_100_Hour_Veh : 0|64@1+ (1,0) [0|18446744073709551615] "" Vector__XXX

BO_ 2147547925 VDMA_FB15_NOx_Tracking_Active_10: 8 Vector__XXX
 SG_ NOx_Tracking_Active_100_Hour_Eng : 0|64@1+ (1,0) [0|18446744073709551615] "" Vector__XXX

BO_ 2147547926 VDMA_FB16_NOx_Tracking_Active_10: 8 Vector__XXX
 SG_ NOx_Tracking_Active_100_Hour_Eng : 0|64@1+ (1,0) [0|18446744073709551615] "" Vector__XXX

BO_ 2147547927 VDMA_FB17_NOx_Tracking_Active_10: 8 Vector__XXX
 SG_ NOx_Tracking_Active_100_Hour_Sys : 0|64@1+ (1,0) [0|18446744073709551615] "" Vector__XXX

BO_ 2147547928 VDMA_FB18_Motor_Generator_6_Inve: 8 Vector__XXX
 SG_ Motor_Generator_6_Inverter_Contr : 0|64@1+ (1,0) [0|18446744073709551615] "" Vector__XXX

BO_ 2147547929 VDMA_FB19_Motor_Generator_6_Inve: 8 Vector__XXX
 SG_ Motor_Generator_6_Inverter_Limit : 0|64@1+ (1,0) [0|18446744073709551615] "" Vector__XXX

BO_ 2147547930 VDMA_FB1A_Motor_Generator_6_Inve: 8 Vector__XXX
 SG_ Motor_Generator_6_Inverter_Limit : 0|64@1+ (1,0) [0|18446744073709551615] "" Vector__XXX

BO_ 2147547931 VDMA_FB1B_Motor_Generator_6_Inve: 8 Vector__XXX
 SG_ Motor_Generator_6_Inverter_Limit : 0|64@1+ (1,0) [0|18446744073709551615] "" Vector__XXX

BO_ 2147547932 VDMA_FB1C_Motor_Generator_6_Inve: 8 Vector__XXX
 SG_ Motor_Generator_6_Inverter_Isola : 0|64@1+ (1,0) [0|18446744073709551615] "" Vector__XXX

BO_ 2147547933 VDMA_FB1D_Motor_Generator_5_Inve: 8 Vector__XXX
 SG_ Motor_Generator_5_Inverter_Contr : 0|64@1+ (1,0) [0|18446744073709551615] "" Vector__XXX

BO_ 2147547934 VDMA_FB1E_Motor_Generator_5_Inve: 8 Vector__XXX
 SG_ Motor_Generator_5_Inverter_Limit : 0|64@1+ (1,0) [0|18446744073709551615] "" Vector__XXX

BO_ 2147547935 VDMA_FB1F_Motor_Generator_5_Inve: 8 Vector__XXX
 SG_ Motor_Generator_5_Inverter_Limit : 0|64@1+ (1,0) [0|18446744073709551615] "" Vector__XXX

BO_ 2147547936 VDMA_FB20_Motor_Generator_5_Inve: 8 Vector__XXX
 SG_ Motor_Generator_5_Inverter_Limit : 0|64@1+ (1,0) [0|18446744073709551615] "" Vector__XXX

BO_ 2147547937 VDMA_FB21_Motor_Generator_5_Inve: 8 Vector__XXX
 SG_ Motor_Generator_5_Inverter_Isola : 0|64@1+ (1,0) [0|18446744073709551615] "" Vector__XXX

BO_ 2147547938 VDMA_FB22_Motor_Generator_4_Inve: 8 Vector__XXX
 SG_ Motor_Generator_4_Inverter_Contr : 0|64@1+ (1,0) [0|18446744073709551615] "" Vector__XXX

BO_ 2147547939 VDMA_FB23_Motor_Generator_4_Inve: 8 Vector__XXX
 SG_ Motor_Generator_4_Inverter_Limit : 0|64@1+ (1,0) [0|18446744073709551615] "" Vector__XXX

BO_ 2147547940 VDMA_FB24_Motor_Generator_4_Inve: 8 Vector__XXX
 SG_ Motor_Generator_4_Inverter_Limit : 0|64@1+ (1,0) [0|18446744073709551615] "" Vector__XXX

BO_ 2147547941 VDMA_FB25_Motor_Generator_4_Inve: 8 Vector__XXX
 SG_ Motor_Generator_4_Inverter_Limit : 0|64@1+ (1,0) [0|18446744073709551615] "" Vector__XXX

BO_ 2147547942 VDMA_FB26_Motor_Generator_4_Inve: 8 Vector__XXX
 SG_ Motor_Generator_4_Inverter_Isola : 0|64@1+ (1,0) [0|18446744073709551615] "" Vector__XXX

BO_ 2147547943 VDMA_FB27_Motor_Generator_3_Inve: 8 Vector__XXX
 SG_ Motor_Generator_3_Inverter_Contr : 0|64@1+ (1,0) [0|18446744073709551615] "" Vector__XXX

BO_ 2147547944 VDMA_FB28_Motor_Generator_3_Inve: 8 Vector__XXX
 SG_ Motor_Generator_3_Inverter_Limit : 0|64@1+ (1,0) [0|18446744073709551615] "" Vector__XXX

BO_ 2147547945 VDMA_FB29_Motor_Generator_3_Inve: 8 Vector__XXX
 SG_ Motor_Generator_3_Inverter_Limit : 0|64@1+ (1,0) [0|18446744073709551615] "" Vector__XXX

BO_ 2147547946 VDMA_FB2A_Motor_Generator_3_Inve: 8 Vector__XXX
 SG_ Motor_Generator_3_Inverter_Limit : 0|64@1+ (1,0) [0|18446744073709551615] "" Vector__XXX

BO_ 2147547947 VDMA_FB2B_Motor_Generator_3_Inve: 8 Vector__XXX
 SG_ Motor_Generator_3_Inverter_Isola : 0|64@1+ (1,0) [0|18446744073709551615] "" Vector__XXX

BO_ 2147547948 VDMA_FB2C_Diagnostic_Readiness_4: 8 Vector__XXX
 SG_ Diagnostic_Readiness_4_RawPayloa : 0|64@1+ (1,0) [0|18446744073709551615] "" Vector__XXX

BO_ 2147547949 VDMA_FB2D_Turbocharger_Informati: 8 Vector__XXX
 SG_ Turbocharger_Information_8_RawPa : 0|64@1+ (1,0) [0|18446744073709551615] "" Vector__XXX

BO_ 2147547950 VDMA_FB2E_Winch_Information_2: 8 Vector__XXX
 SG_ Winch_Information_2_RawPayload : 0|64@1+ (1,0) [0|18446744073709551615] "" Vector__XXX

BO_ 2147547951 VDMA_FB2F_Motor_Generator_6_Inve: 8 Vector__XXX
 SG_ Motor_Generator_6_Inverter_Refer : 0|64@1+ (1,0) [0|18446744073709551615] "" Vector__XXX

BO_ 2147547952 VDMA_FB30_Motor_Generator_6_Inve: 8 Vector__XXX
 SG_ Motor_Generator_6_Inverter_Statu : 0|64@1+ (1,0) [0|18446744073709551615] "" Vector__XXX

BO_ 2147547953 VDMA_FB31_Motor_Generator_6_Inve: 8 Vector__XXX
 SG_ Motor_Generator_6_Inverter_Refer : 0|64@1+ (1,0) [0|18446744073709551615] "" Vector__XXX

BO_ 2147547954 VDMA_FB32_Motor_Generator_6_Inve: 8 Vector__XXX
 SG_ Motor_Generator_6_Inverter_Tempe : 0|64@1+ (1,0) [0|18446744073709551615] "" Vector__XXX

BO_ 2147547955 VDMA_FB33_Motor_Generator_6_Inve: 8 Vector__XXX
 SG_ Motor_Generator_6_Inverter_Motor : 0|64@1+ (1,0) [0|18446744073709551615] "" Vector__XXX

BO_ 2147547956 VDMA_FB34_Motor_Generator_6_Inve: 8 Vector__XXX
 SG_ Motor_Generator_6_Inverter_Isola : 0|64@1+ (1,0) [0|18446744073709551615] "" Vector__XXX

BO_ 2147547957 VDMA_FB35_Motor_Generator_6_Inve: 8 Vector__XXX
 SG_ Motor_Generator_6_Inverter_Activ : 0|64@1+ (1,0) [0|18446744073709551615] "" Vector__XXX

BO_ 2147547958 VDMA_FB36_Motor_Generator_5_Inve: 8 Vector__XXX
 SG_ Motor_Generator_5_Inverter_Refer : 0|64@1+ (1,0) [0|18446744073709551615] "" Vector__XXX

BO_ 2147547959 VDMA_FB37_Motor_Generator_5_Inve: 8 Vector__XXX
 SG_ Motor_Generator_5_Inverter_Statu : 0|64@1+ (1,0) [0|18446744073709551615] "" Vector__XXX

BO_ 2147547960 VDMA_FB38_Motor_Generator_5_Inve: 8 Vector__XXX
 SG_ Motor_Generator_5_Inverter_Refer : 0|64@1+ (1,0) [0|18446744073709551615] "" Vector__XXX

BO_ 2147547961 VDMA_FB39_Motor_Generator_5_Inve: 8 Vector__XXX
 SG_ Motor_Generator_5_Inverter_Tempe : 0|64@1+ (1,0) [0|18446744073709551615] "" Vector__XXX

BO_ 2147547962 VDMA_FB3A_Motor_Generator_5_Inve: 8 Vector__XXX
 SG_ Motor_Generator_5_Inverter_Motor : 0|64@1+ (1,0) [0|18446744073709551615] "" Vector__XXX

BO_ 2147547963 VDMA_FB3B_Motor_Generator_5_Inve: 8 Vector__XXX
 SG_ Motor_Generator_5_Inverter_Isola : 0|64@1+ (1,0) [0|18446744073709551615] "" Vector__XXX

BO_ 2147547964 VDMA_FB3C_Motor_Generator_5_Inve: 8 Vector__XXX
 SG_ Motor_Generator_5_Inverter_Activ : 0|64@1+ (1,0) [0|18446744073709551615] "" Vector__XXX

BO_ 2147547965 VDMA_FB3D_Motor_Generator_4_Inve: 8 Vector__XXX
 SG_ Motor_Generator_4_Inverter_Refer : 0|64@1+ (1,0) [0|18446744073709551615] "" Vector__XXX

BO_ 2147547966 VDMA_FB3E_Motor_Generator_4_Inve: 8 Vector__XXX
 SG_ Motor_Generator_4_Inverter_Statu : 0|64@1+ (1,0) [0|18446744073709551615] "" Vector__XXX

BO_ 2147547967 VDMA_FB3F_Motor_Generator_4_Inve: 8 Vector__XXX
 SG_ Motor_Generator_4_Inverter_Refer : 0|64@1+ (1,0) [0|18446744073709551615] "" Vector__XXX

BO_ 2147547968 VDMA_FB40_Motor_Generator_4_Inve: 8 Vector__XXX
 SG_ Motor_Generator_4_Inverter_Tempe : 0|64@1+ (1,0) [0|18446744073709551615] "" Vector__XXX

BO_ 2147547969 VDMA_FB41_Motor_Generator_4_Inve: 8 Vector__XXX
 SG_ Motor_Generator_4_Inverter_Motor : 0|64@1+ (1,0) [0|18446744073709551615] "" Vector__XXX

BO_ 2147547970 VDMA_FB42_Motor_Generator_4_Inve: 8 Vector__XXX
 SG_ Motor_Generator_4_Inverter_Isola : 0|64@1+ (1,0) [0|18446744073709551615] "" Vector__XXX

BO_ 2147547971 VDMA_FB43_Motor_Generator_4_Inve: 8 Vector__XXX
 SG_ Motor_Generator_4_Inverter_Activ : 0|64@1+ (1,0) [0|18446744073709551615] "" Vector__XXX

BO_ 2147547972 VDMA_FB44_Motor_Generator_3_Inve: 8 Vector__XXX
 SG_ Motor_Generator_3_Inverter_Refer : 0|64@1+ (1,0) [0|18446744073709551615] "" Vector__XXX

BO_ 2147547973 VDMA_FB45_Motor_Generator_3_Inve: 8 Vector__XXX
 SG_ Motor_Generator_3_Inverter_Statu : 0|64@1+ (1,0) [0|18446744073709551615] "" Vector__XXX

BO_ 2147547974 VDMA_FB46_Motor_Generator_3_Inve: 8 Vector__XXX
 SG_ Motor_Generator_3_Inverter_Refer : 0|64@1+ (1,0) [0|18446744073709551615] "" Vector__XXX

BO_ 2147547975 VDMA_FB47_Motor_Generator_3_Inve: 8 Vector__XXX
 SG_ Motor_Generator_3_Inverter_Tempe : 0|64@1+ (1,0) [0|18446744073709551615] "" Vector__XXX

BO_ 2147547976 VDMA_FB48_Motor_Generator_3_Inve: 8 Vector__XXX
 SG_ Motor_Generator_3_Inverter_Motor : 0|64@1+ (1,0) [0|18446744073709551615] "" Vector__XXX

BO_ 2147547977 VDMA_FB49_Motor_Generator_3_Inve: 8 Vector__XXX
 SG_ Motor_Generator_3_Inverter_Isola : 0|64@1+ (1,0) [0|18446744073709551615] "" Vector__XXX

BO_ 2147547978 VDMA_FB4A_Motor_Generator_3_Inve: 8 Vector__XXX
 SG_ Motor_Generator_3_Inverter_Activ : 0|64@1+ (1,0) [0|18446744073709551615] "" Vector__XXX

BO_ 2147547979 VDMA_FB4B_Automated_Driving_Syst: 8 Vector__XXX
 SG_ Automated_Driving_System_Status_ : 0|64@1+ (1,0) [0|18446744073709551615] "" Vector__XXX

BO_ 2147547980 VDMA_FB4C_Cab_Climate_System_Inf: 8 Vector__XXX
 SG_ Cab_Climate_System_Information_2 : 0|64@1+ (1,0) [0|18446744073709551615] "" Vector__XXX

BO_ 2147547981 VDMA_FB4D_Maintenance_Informatio: 8 Vector__XXX
 SG_ Maintenance_Information_1_RawPay : 0|64@1+ (1,0) [0|18446744073709551615] "" Vector__XXX

BO_ 2147547982 VDMA_FB4E_Hoist_Control_Informat: 8 Vector__XXX
 SG_ Hoist_Control_Information_RawPay : 0|64@1+ (1,0) [0|18446744073709551615] "" Vector__XXX

BO_ 2147547983 VDMA_FB4F_High_Voltage_Energy_St: 8 Vector__XXX
 SG_ High_Voltage_Energy_Storage_Pack : 0|64@1+ (1,0) [0|18446744073709551615] "" Vector__XXX

BO_ 2147547984 VDMA_FB50_High_Voltage_Energy_St: 8 Vector__XXX
 SG_ High_Voltage_Energy_Storage_Pack : 0|64@1+ (1,0) [0|18446744073709551615] "" Vector__XXX

BO_ 2147547985 VDMA_FB51_High_Voltage_Energy_St: 8 Vector__XXX
 SG_ High_Voltage_Energy_Storage_Pack : 0|64@1+ (1,0) [0|18446744073709551615] "" Vector__XXX

BO_ 2147547986 VDMA_FB52_High_Voltage_Energy_St: 8 Vector__XXX
 SG_ High_Voltage_Energy_Storage_Pack : 0|64@1+ (1,0) [0|18446744073709551615] "" Vector__XXX

BO_ 2147547987 VDMA_FB53_High_Voltage_Energy_St: 8 Vector__XXX
 SG_ High_Voltage_Energy_Storage_Pack : 0|64@1+ (1,0) [0|18446744073709551615] "" Vector__XXX

BO_ 2147547988 VDMA_FB54_High_Voltage_Energy_St: 8 Vector__XXX
 SG_ High_Voltage_Energy_Storage_Pack : 0|64@1+ (1,0) [0|18446744073709551615] "" Vector__XXX

BO_ 2147547989 VDMA_FB55_High_Voltage_Energy_St: 8 Vector__XXX
 SG_ High_Voltage_Energy_Storage_Pack : 0|64@1+ (1,0) [0|18446744073709551615] "" Vector__XXX

BO_ 2147547990 VDMA_FB56_High_Voltage_Energy_St: 8 Vector__XXX
 SG_ High_Voltage_Energy_Storage_Pack : 0|64@1+ (1,0) [0|18446744073709551615] "" Vector__XXX

BO_ 2147547991 VDMA_FB57_High_Voltage_Energy_St: 8 Vector__XXX
 SG_ High_Voltage_Energy_Storage_Pack : 0|64@1+ (1,0) [0|18446744073709551615] "" Vector__XXX

BO_ 2147547992 VDMA_FB58_High_Voltage_Energy_St: 8 Vector__XXX
 SG_ High_Voltage_Energy_Storage_Pack : 0|64@1+ (1,0) [0|18446744073709551615] "" Vector__XXX

BO_ 2147547993 VDMA_FB59_High_Voltage_Energy_St: 8 Vector__XXX
 SG_ High_Voltage_Energy_Storage_Pack : 0|64@1+ (1,0) [0|18446744073709551615] "" Vector__XXX

BO_ 2147547994 VDMA_FB5A_High_Voltage_Energy_St: 8 Vector__XXX
 SG_ High_Voltage_Energy_Storage_Pack : 0|64@1+ (1,0) [0|18446744073709551615] "" Vector__XXX

BO_ 2147547995 VDMA_FB5B_Vehicle_Fire_Suppressi: 8 Vector__XXX
 SG_ Vehicle_Fire_Suppression_System_ : 0|64@1+ (1,0) [0|18446744073709551615] "" Vector__XXX

BO_ 2147547996 VDMA_FB5C_Vehicle_Fire_Suppressi: 8 Vector__XXX
 SG_ Vehicle_Fire_Suppression_System_ : 0|64@1+ (1,0) [0|18446744073709551615] "" Vector__XXX

BO_ 2147547997 VDMA_FB5D_Vehicle_Fire_Suppressi: 8 Vector__XXX
 SG_ Vehicle_Fire_Suppression_System_ : 0|64@1+ (1,0) [0|18446744073709551615] "" Vector__XXX

BO_ 2147547998 VDMA_FB5E_Vehicle_Fire_Suppressi: 8 Vector__XXX
 SG_ Vehicle_Fire_Suppression_System_ : 0|64@1+ (1,0) [0|18446744073709551615] "" Vector__XXX

BO_ 2147547999 VDMA_FB5F_Vehicle_Fire_Suppressi: 8 Vector__XXX
 SG_ Vehicle_Fire_Suppression_System_ : 0|64@1+ (1,0) [0|18446744073709551615] "" Vector__XXX

BO_ 2147548000 VDMA_FB60_Vehicle_Fire_Suppressi: 8 Vector__XXX
 SG_ Vehicle_Fire_Suppression_System_ : 0|64@1+ (1,0) [0|18446744073709551615] "" Vector__XXX

BO_ 2147548001 VDMA_FB61_Vehicle_Fire_Suppressi: 8 Vector__XXX
 SG_ Vehicle_Fire_Suppression_System_ : 0|64@1+ (1,0) [0|18446744073709551615] "" Vector__XXX

BO_ 2147548002 VDMA_FB62_Vehicle_Fire_Suppressi: 8 Vector__XXX
 SG_ Vehicle_Fire_Suppression_System_ : 0|64@1+ (1,0) [0|18446744073709551615] "" Vector__XXX

BO_ 2147548003 VDMA_FB63_Vehicle_Fire_Suppressi: 8 Vector__XXX
 SG_ Vehicle_Fire_Suppression_System_ : 0|64@1+ (1,0) [0|18446744073709551615] "" Vector__XXX

BO_ 2147548004 VDMA_FB64_Vehicle_Fire_Suppressi: 8 Vector__XXX
 SG_ Vehicle_Fire_Suppression_System_ : 0|64@1+ (1,0) [0|18446744073709551615] "" Vector__XXX

BO_ 2147548005 VDMA_FB65_Vehicle_Fire_Suppressi: 8 Vector__XXX
 SG_ Vehicle_Fire_Suppression_System_ : 0|64@1+ (1,0) [0|18446744073709551615] "" Vector__XXX

BO_ 2147548006 VDMA_FB66_Vehicle_Fire_Suppressi: 8 Vector__XXX
 SG_ Vehicle_Fire_Suppression_System_ : 0|64@1+ (1,0) [0|18446744073709551615] "" Vector__XXX

BO_ 2147548007 VDMA_FB67_Motor_Generator_2_Inve: 8 Vector__XXX
 SG_ Motor_Generator_2_Inverter_Activ : 0|64@1+ (1,0) [0|18446744073709551615] "" Vector__XXX

BO_ 2147548008 VDMA_FB68_Motor_Generator_2_Inve: 8 Vector__XXX
 SG_ Motor_Generator_2_Inverter_Isola : 0|64@1+ (1,0) [0|18446744073709551615] "" Vector__XXX

BO_ 2147548009 VDMA_FB69_Motor_Generator_1_Inve: 8 Vector__XXX
 SG_ Motor_Generator_1_Inverter_Activ : 0|64@1+ (1,0) [0|18446744073709551615] "" Vector__XXX

BO_ 2147548010 VDMA_FB6A_Motor_Generator_1_Inve: 8 Vector__XXX
 SG_ Motor_Generator_1_Inverter_Isola : 0|64@1+ (1,0) [0|18446744073709551615] "" Vector__XXX

BO_ 2147548011 VDMA_FB6B_High_Voltage_Bus_Infor: 8 Vector__XXX
 SG_ High_Voltage_Bus_Information_Raw : 0|64@1+ (1,0) [0|18446744073709551615] "" Vector__XXX

BO_ 2147548012 VDMA_FB6C_Motor_Generator_2_Inve: 8 Vector__XXX
 SG_ Motor_Generator_2_Inverter_Refer : 0|64@1+ (1,0) [0|18446744073709551615] "" Vector__XXX

BO_ 2147548013 VDMA_FB6D_Motor_Generator_2_Inve: 8 Vector__XXX
 SG_ Motor_Generator_2_Inverter_Statu : 0|64@1+ (1,0) [0|18446744073709551615] "" Vector__XXX

BO_ 2147548014 VDMA_FB6E_Motor_Generator_2_Inve: 8 Vector__XXX
 SG_ Motor_Generator_2_Inverter_Refer : 0|64@1+ (1,0) [0|18446744073709551615] "" Vector__XXX

BO_ 2147548015 VDMA_FB6F_Motor_Generator_2_Inve: 8 Vector__XXX
 SG_ Motor_Generator_2_Inverter_Tempe : 0|64@1+ (1,0) [0|18446744073709551615] "" Vector__XXX

BO_ 2147548016 VDMA_FB70_Motor_Generator_2_Inve: 8 Vector__XXX
 SG_ Motor_Generator_2_Inverter_Motor : 0|64@1+ (1,0) [0|18446744073709551615] "" Vector__XXX

BO_ 2147548017 VDMA_FB71_Motor_Generator_1_Inve: 8 Vector__XXX
 SG_ Motor_Generator_1_Inverter_Motor : 0|64@1+ (1,0) [0|18446744073709551615] "" Vector__XXX

BO_ 2147548018 VDMA_FB72_Motor_Generator_1_Inve: 8 Vector__XXX
 SG_ Motor_Generator_1_Inverter_Tempe : 0|64@1+ (1,0) [0|18446744073709551615] "" Vector__XXX

BO_ 2147548019 VDMA_FB73_Motor_Generator_1_Inve: 8 Vector__XXX
 SG_ Motor_Generator_1_Inverter_Refer : 0|64@1+ (1,0) [0|18446744073709551615] "" Vector__XXX

BO_ 2147548020 VDMA_FB74_Motor_Generator_1_Inve: 8 Vector__XXX
 SG_ Motor_Generator_1_Inverter_Statu : 0|64@1+ (1,0) [0|18446744073709551615] "" Vector__XXX

BO_ 2147548021 VDMA_FB75_Motor_Generator_1_Inve: 8 Vector__XXX
 SG_ Motor_Generator_1_Inverter_Refer : 0|64@1+ (1,0) [0|18446744073709551615] "" Vector__XXX

BO_ 2147548022 VDMA_FB76_Personnel_Detect_Statu: 8 Vector__XXX
 SG_ Personnel_Detect_Status_RawPaylo : 0|64@1+ (1,0) [0|18446744073709551615] "" Vector__XXX

BO_ 2147548023 VDMA_FB77_Engine_Cylinder_Pressu: 8 Vector__XXX
 SG_ Engine_Cylinder_Pressure_Gamma_1 : 0|64@1+ (1,0) [0|18446744073709551615] "" Vector__XXX

BO_ 2147548024 VDMA_FB78_Engine_Cylinder_Pressu: 8 Vector__XXX
 SG_ Engine_Cylinder_Pressure_Gamma_2 : 0|64@1+ (1,0) [0|18446744073709551615] "" Vector__XXX

BO_ 2147548025 VDMA_FB79_Engine_Cylinder_Pressu: 8 Vector__XXX
 SG_ Engine_Cylinder_Pressure_Gamma_3 : 0|64@1+ (1,0) [0|18446744073709551615] "" Vector__XXX

BO_ 2147548026 VDMA_FB7A_Engine_Cylinder_Pressu: 8 Vector__XXX
 SG_ Engine_Cylinder_Pressure_Gamma_4 : 0|64@1+ (1,0) [0|18446744073709551615] "" Vector__XXX

BO_ 2147548027 VDMA_FB7B_Engine_Cylinder_Pressu: 8 Vector__XXX
 SG_ Engine_Cylinder_Pressure_Gamma_5 : 0|64@1+ (1,0) [0|18446744073709551615] "" Vector__XXX

BO_ 2147548028 VDMA_FB7C_Wake_Up_and_Sleep: 8 Vector__XXX
 SG_ Wake_Up_and_Sleep_RawPayload : 0|64@1+ (1,0) [0|18446744073709551615] "" Vector__XXX

BO_ 2147548029 VDMA_FB7D_Electrified_Accessory_: 8 Vector__XXX
 SG_ Electrified_Accessory_Generator_ : 0|64@1+ (1,0) [0|18446744073709551615] "" Vector__XXX

BO_ 2147548030 VDMA_FB7E_Electrified_Accessory_: 8 Vector__XXX
 SG_ Electrified_Accessory_Generator_ : 0|64@1+ (1,0) [0|18446744073709551615] "" Vector__XXX

BO_ 2147548031 VDMA_FB7F_Well_Stimulation_Pump_: 8 Vector__XXX
 SG_ Well_Stimulation_Pump_System_Fil : 0|64@1+ (1,0) [0|18446744073709551615] "" Vector__XXX

BO_ 2147548032 VDMA_FB80_PTO_Governor_Configura: 8 Vector__XXX
 SG_ PTO_Governor_Configuration_RawPa : 0|64@1+ (1,0) [0|18446744073709551615] "" Vector__XXX

BO_ 2147548033 VDMA_FB81_On_Board_Programming_2: 8 Vector__XXX
 SG_ On_Board_Programming_2_RawPayloa : 0|64@1+ (1,0) [0|18446744073709551615] "" Vector__XXX

BO_ 2147548034 VDMA_FB82_Primary_or_Rear_Hitch_: 8 Vector__XXX
 SG_ Primary_or_Rear_Hitch_Yaw_RawPay : 0|64@1+ (1,0) [0|18446744073709551615] "" Vector__XXX

BO_ 2147548035 VDMA_FB83_Secondary_or_Front_Hit: 8 Vector__XXX
 SG_ Secondary_or_Front_Hitch_Yaw_Raw : 0|64@1+ (1,0) [0|18446744073709551615] "" Vector__XXX

BO_ 2147548036 VDMA_FB84_Operator_Status: 8 Vector__XXX
 SG_ Operator_Status_RawPayload : 0|64@1+ (1,0) [0|18446744073709551615] "" Vector__XXX

BO_ 2147548037 VDMA_FB85_Engine_Idle_Management: 8 Vector__XXX
 SG_ Engine_Idle_Management_Informati : 0|64@1+ (1,0) [0|18446744073709551615] "" Vector__XXX

BO_ 2147548038 VDMA_FB86_Alcohol_Interlock_To_V: 8 Vector__XXX
 SG_ Alcohol_Interlock_To_Vehicle_Raw : 0|64@1+ (1,0) [0|18446744073709551615] "" Vector__XXX

BO_ 2147548039 VDMA_FB87_Vehicle_To_Alcohol_Int: 8 Vector__XXX
 SG_ Vehicle_To_Alcohol_Interlock_Raw : 0|64@1+ (1,0) [0|18446744073709551615] "" Vector__XXX

BO_ 2147548040 VDMA_FB88_Marine_Control_Informa: 8 Vector__XXX
 SG_ Marine_Control_Information_3_Raw : 0|64@1+ (1,0) [0|18446744073709551615] "" Vector__XXX

BO_ 2147548041 VDMA_FB89_Engine_Fluid_Level_Pre: 8 Vector__XXX
 SG_ Engine_Fluid_Level_Pressure_13_R : 0|64@1+ (1,0) [0|18446744073709551615] "" Vector__XXX

BO_ 2147548042 VDMA_FB8A_High_Voltage_Energy_St: 8 Vector__XXX
 SG_ High_Voltage_Energy_Storage_Syst : 0|64@1+ (1,0) [0|18446744073709551615] "" Vector__XXX

BO_ 2147548043 VDMA_FB8B_Economy_Mode_Inactive_: 8 Vector__XXX
 SG_ Economy_Mode_Inactive_Hours_RawP : 0|64@1+ (1,0) [0|18446744073709551615] "" Vector__XXX

BO_ 2147548044 VDMA_FB8C_Economy_Mode_Estimated: 8 Vector__XXX
 SG_ Economy_Mode_Estimated_Instantan : 0|64@1+ (1,0) [0|18446744073709551615] "" Vector__XXX

BO_ 2147548045 VDMA_FB8D_Economy_Mode_Active_Ho: 8 Vector__XXX
 SG_ Economy_Mode_Active_Hours_RawPay : 0|64@1+ (1,0) [0|18446744073709551615] "" Vector__XXX

BO_ 2147548046 VDMA_FB8E_Economy_Mode_Fuel_Used: 8 Vector__XXX
 SG_ Economy_Mode_Fuel_Used_RawPayloa : 0|64@1+ (1,0) [0|18446744073709551615] "" Vector__XXX

BO_ 2147548047 VDMA_FB8F_Economy_Mode_Estimated: 8 Vector__XXX
 SG_ Economy_Mode_Estimated_Fuel_Savi : 0|64@1+ (1,0) [0|18446744073709551615] "" Vector__XXX

BO_ 2147548048 VDMA_FB90_DC_DC_Converter_4_Volt: 8 Vector__XXX
 SG_ DC_DC_Converter_4_Voltage_RawPay : 0|64@1+ (1,0) [0|18446744073709551615] "" Vector__XXX

BO_ 2147548049 VDMA_FB91_DC_DC_Converter_3_Volt: 8 Vector__XXX
 SG_ DC_DC_Converter_3_Voltage_RawPay : 0|64@1+ (1,0) [0|18446744073709551615] "" Vector__XXX

BO_ 2147548050 VDMA_FB92_DC_DC_Converter_2_Volt: 8 Vector__XXX
 SG_ DC_DC_Converter_2_Voltage_RawPay : 0|64@1+ (1,0) [0|18446744073709551615] "" Vector__XXX

BO_ 2147548051 VDMA_FB93_DC_DC_Converter_1_Volt: 8 Vector__XXX
 SG_ DC_DC_Converter_1_Voltage_RawPay : 0|64@1+ (1,0) [0|18446744073709551615] "" Vector__XXX

BO_ 2147548052 VDMA_FB94_Electronic_Engine_Cont: 8 Vector__XXX
 SG_ Electronic_Engine_Controller_22_ : 0|64@1+ (1,0) [0|18446744073709551615] "" Vector__XXX

BO_ 2147548053 VDMA_FB95_Engine_Hours_2: 8 Vector__XXX
 SG_ Engine_Hours_2_RawPayload : 0|64@1+ (1,0) [0|18446744073709551615] "" Vector__XXX

BO_ 2147548054 VDMA_FB96_Engine_Information_3: 8 Vector__XXX
 SG_ Engine_Information_3_RawPayload : 0|64@1+ (1,0) [0|18446744073709551615] "" Vector__XXX

BO_ 2147548055 VDMA_FB97_Vehicle_Electrical_Pow: 8 Vector__XXX
 SG_ Vehicle_Electrical_Power_15_RawP : 0|64@1+ (1,0) [0|18446744073709551615] "" Vector__XXX

BO_ 2147548056 VDMA_FB98_Exhaust_Oxygen_2: 8 Vector__XXX
 SG_ Exhaust_Oxygen_2_RawPayload : 0|64@1+ (1,0) [0|18446744073709551615] "" Vector__XXX

BO_ 2147548057 VDMA_FB99_DC_AC_Accessory_Invert: 8 Vector__XXX
 SG_ DC_AC_Accessory_Inverter_1_Tempe : 0|64@1+ (1,0) [0|18446744073709551615] "" Vector__XXX

BO_ 2147548058 VDMA_FB9A_DC_AC_Accessory_Invert: 8 Vector__XXX
 SG_ DC_AC_Accessory_Inverter_1_DC_Si : 0|64@1+ (1,0) [0|18446744073709551615] "" Vector__XXX

BO_ 2147548059 VDMA_FB9B_DC_AC_Accessory_Invert: 8 Vector__XXX
 SG_ DC_AC_Accessory_Inverter_1_AC_Si : 0|64@1+ (1,0) [0|18446744073709551615] "" Vector__XXX

BO_ 2147548060 VDMA_FB9C_DC_AC_Accessory_Invert: 8 Vector__XXX
 SG_ DC_AC_Accessory_Inverter_1_Confi : 0|64@1+ (1,0) [0|18446744073709551615] "" Vector__XXX

BO_ 2147548061 VDMA_FB9D_DC_AC_Accessory_Invert: 8 Vector__XXX
 SG_ DC_AC_Accessory_Inverter_1_Lifet : 0|64@1+ (1,0) [0|18446744073709551615] "" Vector__XXX

BO_ 2147548062 VDMA_FB9E_DC_AC_Accessory_Invert: 8 Vector__XXX
 SG_ DC_AC_Accessory_Inverter_2_Tempe : 0|64@1+ (1,0) [0|18446744073709551615] "" Vector__XXX

BO_ 2147548063 VDMA_FB9F_DC_AC_Accessory_Invert: 8 Vector__XXX
 SG_ DC_AC_Accessory_Inverter_2_DC_Si : 0|64@1+ (1,0) [0|18446744073709551615] "" Vector__XXX

BO_ 2147548064 VDMA_FBA0_DC_AC_Accessory_Invert: 8 Vector__XXX
 SG_ DC_AC_Accessory_Inverter_2_AC_Si : 0|64@1+ (1,0) [0|18446744073709551615] "" Vector__XXX

BO_ 2147548065 VDMA_FBA1_DC_AC_Accessory_Invert: 8 Vector__XXX
 SG_ DC_AC_Accessory_Inverter_2_Confi : 0|64@1+ (1,0) [0|18446744073709551615] "" Vector__XXX

BO_ 2147548066 VDMA_FBA2_DC_AC_Accessory_Invert: 8 Vector__XXX
 SG_ DC_AC_Accessory_Inverter_2_Lifet : 0|64@1+ (1,0) [0|18446744073709551615] "" Vector__XXX

BO_ 2147548067 VDMA_FBA3_DC_AC_Accessory_Invert: 8 Vector__XXX
 SG_ DC_AC_Accessory_Inverter_3_Tempe : 0|64@1+ (1,0) [0|18446744073709551615] "" Vector__XXX

BO_ 2147548068 VDMA_FBA4_DC_AC_Accessory_Invert: 8 Vector__XXX
 SG_ DC_AC_Accessory_Inverter_3_DC_Si : 0|64@1+ (1,0) [0|18446744073709551615] "" Vector__XXX

BO_ 2147548069 VDMA_FBA5_DC_AC_Accessory_Invert: 8 Vector__XXX
 SG_ DC_AC_Accessory_Inverter_3_AC_Si : 0|64@1+ (1,0) [0|18446744073709551615] "" Vector__XXX

BO_ 2147548070 VDMA_FBA6_DC_AC_Accessory_Invert: 8 Vector__XXX
 SG_ DC_AC_Accessory_Inverter_3_Confi : 0|64@1+ (1,0) [0|18446744073709551615] "" Vector__XXX

BO_ 2147548071 VDMA_FBA7_DC_AC_Accessory_Invert: 8 Vector__XXX
 SG_ DC_AC_Accessory_Inverter_3_Lifet : 0|64@1+ (1,0) [0|18446744073709551615] "" Vector__XXX

BO_ 2147548072 VDMA_FBA8_DC_AC_Accessory_Invert: 8 Vector__XXX
 SG_ DC_AC_Accessory_Inverter_4_Tempe : 0|64@1+ (1,0) [0|18446744073709551615] "" Vector__XXX

BO_ 2147548073 VDMA_FBA9_DC_AC_Accessory_Invert: 8 Vector__XXX
 SG_ DC_AC_Accessory_Inverter_4_DC_Si : 0|64@1+ (1,0) [0|18446744073709551615] "" Vector__XXX

BO_ 2147548074 VDMA_FBAA_DC_AC_Accessory_Invert: 8 Vector__XXX
 SG_ DC_AC_Accessory_Inverter_4_AC_Si : 0|64@1+ (1,0) [0|18446744073709551615] "" Vector__XXX

BO_ 2147548075 VDMA_FBAB_DC_AC_Accessory_Invert: 8 Vector__XXX
 SG_ DC_AC_Accessory_Inverter_4_Confi : 0|64@1+ (1,0) [0|18446744073709551615] "" Vector__XXX

BO_ 2147548076 VDMA_FBAC_DC_AC_Accessory_Invert: 8 Vector__XXX
 SG_ DC_AC_Accessory_Inverter_4_Lifet : 0|64@1+ (1,0) [0|18446744073709551615] "" Vector__XXX

BO_ 2147548077 VDMA_FBAD_DC_AC_Accessory_Invert: 8 Vector__XXX
 SG_ DC_AC_Accessory_Inverter_5_Tempe : 0|64@1+ (1,0) [0|18446744073709551615] "" Vector__XXX

BO_ 2147548078 VDMA_FBAE_DC_AC_Accessory_Invert: 8 Vector__XXX
 SG_ DC_AC_Accessory_Inverter_5_DC_Si : 0|64@1+ (1,0) [0|18446744073709551615] "" Vector__XXX

BO_ 2147548079 VDMA_FBAF_DC_AC_Accessory_Invert: 8 Vector__XXX
 SG_ DC_AC_Accessory_Inverter_5_AC_Si : 0|64@1+ (1,0) [0|18446744073709551615] "" Vector__XXX

BO_ 2147548080 VDMA_FBB0_DC_AC_Accessory_Invert: 8 Vector__XXX
 SG_ DC_AC_Accessory_Inverter_5_Confi : 0|64@1+ (1,0) [0|18446744073709551615] "" Vector__XXX

BO_ 2147548081 VDMA_FBB1_DC_AC_Accessory_Invert: 8 Vector__XXX
 SG_ DC_AC_Accessory_Inverter_5_Lifet : 0|64@1+ (1,0) [0|18446744073709551615] "" Vector__XXX

BO_ 2147548082 VDMA_FBB2_Well_Stimulation_Pump_: 8 Vector__XXX
 SG_ Well_Stimulation_Pump_Sensor_Cal : 0|64@1+ (1,0) [0|18446744073709551615] "" Vector__XXX

BO_ 2147548083 VDMA_FBB3_Well_Stimulation_Pump_: 8 Vector__XXX
 SG_ Well_Stimulation_Pump_Fluid_Volu : 0|64@1+ (1,0) [0|18446744073709551615] "" Vector__XXX

BO_ 2147548084 VDMA_FBB4_Well_Stimulation_Pump_: 8 Vector__XXX
 SG_ Well_Stimulation_Pump_Serial_Num : 0|64@1+ (1,0) [0|18446744073709551615] "" Vector__XXX

BO_ 2147548085 VDMA_FBB5_Well_Stimulation_Pump_: 8 Vector__XXX
 SG_ Well_Stimulation_Pump_Trip_Hours : 0|64@1+ (1,0) [0|18446744073709551615] "" Vector__XXX

BO_ 2147548086 VDMA_FBB6_Aftertreatment_1_Outle: 8 Vector__XXX
 SG_ Aftertreatment_1_Outlet_Gas_4_Ra : 0|64@1+ (1,0) [0|18446744073709551615] "" Vector__XXX

BO_ 2147548087 VDMA_FBB7_Aftertreatment_1_Intak: 8 Vector__XXX
 SG_ Aftertreatment_1_Intake_Gas_4_Ra : 0|64@1+ (1,0) [0|18446744073709551615] "" Vector__XXX

BO_ 2147548088 VDMA_FBB8_DC_DC_Converter_4_Life: 8 Vector__XXX
 SG_ DC_DC_Converter_4_Lifetime_Data_ : 0|64@1+ (1,0) [0|18446744073709551615] "" Vector__XXX

BO_ 2147548089 VDMA_FBB9_DC_DC_Converter_4_Conf: 8 Vector__XXX
 SG_ DC_DC_Converter_4_Configuration_ : 0|64@1+ (1,0) [0|18446744073709551615] "" Vector__XXX

BO_ 2147548090 VDMA_FBBA_DC_DC_Converter_4_SLI_: 8 Vector__XXX
 SG_ DC_DC_Converter_4_SLI_Battery_Li : 0|64@1+ (1,0) [0|18446744073709551615] "" Vector__XXX

BO_ 2147548091 VDMA_FBBB_DC_DC_Converter_4_Temp: 8 Vector__XXX
 SG_ DC_DC_Converter_4_Temperatures_R : 0|64@1+ (1,0) [0|18446744073709551615] "" Vector__XXX

BO_ 2147548092 VDMA_FBBC_DC_DC_Converter_4_Low_: 8 Vector__XXX
 SG_ DC_DC_Converter_4_Low_Side_Limit : 0|64@1+ (1,0) [0|18446744073709551615] "" Vector__XXX

BO_ 2147548093 VDMA_FBBD_DC_DC_Converter_4_High: 8 Vector__XXX
 SG_ DC_DC_Converter_4_High_Side_Limi : 0|64@1+ (1,0) [0|18446744073709551615] "" Vector__XXX

BO_ 2147548094 VDMA_FBBE_DC_DC_Converter_3_Life: 8 Vector__XXX
 SG_ DC_DC_Converter_3_Lifetime_Data_ : 0|64@1+ (1,0) [0|18446744073709551615] "" Vector__XXX

BO_ 2147548095 VDMA_FBBF_DC_DC_Converter_3_Conf: 8 Vector__XXX
 SG_ DC_DC_Converter_3_Configuration_ : 0|64@1+ (1,0) [0|18446744073709551615] "" Vector__XXX

BO_ 2147548096 VDMA_FBC0_DC_DC_Converter_3_SLI_: 8 Vector__XXX
 SG_ DC_DC_Converter_3_SLI_Battery_Li : 0|64@1+ (1,0) [0|18446744073709551615] "" Vector__XXX

BO_ 2147548097 VDMA_FBC1_DC_DC_Converter_3_Temp: 8 Vector__XXX
 SG_ DC_DC_Converter_3_Temperatures_R : 0|64@1+ (1,0) [0|18446744073709551615] "" Vector__XXX

BO_ 2147548098 VDMA_FBC2_DC_DC_Converter_3_Low_: 8 Vector__XXX
 SG_ DC_DC_Converter_3_Low_Side_Limit : 0|64@1+ (1,0) [0|18446744073709551615] "" Vector__XXX

BO_ 2147548099 VDMA_FBC3_DC_DC_Converter_3_High: 8 Vector__XXX
 SG_ DC_DC_Converter_3_High_Side_Limi : 0|64@1+ (1,0) [0|18446744073709551615] "" Vector__XXX

BO_ 2147548100 VDMA_FBC4_DC_DC_Converter_2_Life: 8 Vector__XXX
 SG_ DC_DC_Converter_2_Lifetime_Data_ : 0|64@1+ (1,0) [0|18446744073709551615] "" Vector__XXX

BO_ 2147548101 VDMA_FBC5_DC_DC_Converter_2_Conf: 8 Vector__XXX
 SG_ DC_DC_Converter_2_Configuration_ : 0|64@1+ (1,0) [0|18446744073709551615] "" Vector__XXX

BO_ 2147548102 VDMA_FBC6_DC_DC_Converter_2_SLI_: 8 Vector__XXX
 SG_ DC_DC_Converter_2_SLI_Battery_Li : 0|64@1+ (1,0) [0|18446744073709551615] "" Vector__XXX

BO_ 2147548103 VDMA_FBC7_DC_DC_Converter_2_Temp: 8 Vector__XXX
 SG_ DC_DC_Converter_2_Temperatures_R : 0|64@1+ (1,0) [0|18446744073709551615] "" Vector__XXX

BO_ 2147548104 VDMA_FBC8_DC_DC_Converter_2_Low_: 8 Vector__XXX
 SG_ DC_DC_Converter_2_Low_Side_Limit : 0|64@1+ (1,0) [0|18446744073709551615] "" Vector__XXX

BO_ 2147548105 VDMA_FBC9_DC_DC_Converter_2_High: 8 Vector__XXX
 SG_ DC_DC_Converter_2_High_Side_Limi : 0|64@1+ (1,0) [0|18446744073709551615] "" Vector__XXX

BO_ 2147548106 VDMA_FBCA_CiA_602_2_AUTOSAR_CAN_: 8 Vector__XXX
 SG_ CiA_602_2_AUTOSAR_CAN_NM_Obsolet : 0|64@1+ (1,0) [0|18446744073709551615] "" Vector__XXX

CM_ BO_ 2147547826  "Source: isobus.net VDMA Data Dictionary (https://www.isobus.net/isobus/pGNAndSPN/10359?type=PGN)";
CM_ BO_ 2147547827  "Source: isobus.net VDMA Data Dictionary (https://www.isobus.net/isobus/pGNAndSPN/10360?type=PGN)";
CM_ BO_ 2147547828  "Source: isobus.net VDMA Data Dictionary (https://www.isobus.net/isobus/pGNAndSPN/10364?type=PGN)";
CM_ BO_ 2147547829  "Source: isobus.net VDMA Data Dictionary (https://www.isobus.net/isobus/pGNAndSPN/10368?type=PGN)";
CM_ BO_ 2147547830  "Source: isobus.net VDMA Data Dictionary (https://www.isobus.net/isobus/pGNAndSPN/10372?type=PGN)";
CM_ BO_ 2147547831  "Source: isobus.net VDMA Data Dictionary (https://www.isobus.net/isobus/pGNAndSPN/10376?type=PGN)";
CM_ BO_ 2147547832  "Source: isobus.net VDMA Data Dictionary (https://www.isobus.net/isobus/pGNAndSPN/10386?type=PGN)";
CM_ BO_ 2147547833  "Source: isobus.net VDMA Data Dictionary (https://www.isobus.net/isobus/pGNAndSPN/10387?type=PGN)";
CM_ BO_ 2147547834  "Source: isobus.net VDMA Data Dictionary (https://www.isobus.net/isobus/pGNAndSPN/10390?type=PGN)";
CM_ BO_ 2147547835  "Source: isobus.net VDMA Data Dictionary (https://www.isobus.net/isobus/pGNAndSPN/10392?type=PGN)";
CM_ BO_ 2147547836  "Source: isobus.net VDMA Data Dictionary (https://www.isobus.net/isobus/pGNAndSPN/10394?type=PGN)";
CM_ BO_ 2147547837  "Source: isobus.net VDMA Data Dictionary (https://www.isobus.net/isobus/pGNAndSPN/10398?type=PGN)";
CM_ BO_ 2147547838  "Source: isobus.net VDMA Data Dictionary (https://www.isobus.net/isobus/pGNAndSPN/10402?type=PGN)";
CM_ BO_ 2147547839  "Source: isobus.net VDMA Data Dictionary (https://www.isobus.net/isobus/pGNAndSPN/10406?type=PGN)";
CM_ BO_ 2147547840  "Source: isobus.net VDMA Data Dictionary (https://www.isobus.net/isobus/pGNAndSPN/10410?type=PGN)";
CM_ BO_ 2147547841  "Source: isobus.net VDMA Data Dictionary (https://www.isobus.net/isobus/pGNAndSPN/10414?type=PGN)";
CM_ BO_ 2147547842  "Source: isobus.net VDMA Data Dictionary (https://www.isobus.net/isobus/pGNAndSPN/10418?type=PGN)";
CM_ BO_ 2147547843  "Source: isobus.net VDMA Data Dictionary (https://www.isobus.net/isobus/pGNAndSPN/10420?type=PGN)";
CM_ BO_ 2147547844  "Source: isobus.net VDMA Data Dictionary (https://www.isobus.net/isobus/pGNAndSPN/10423?type=PGN)";
CM_ BO_ 2147547845  "Source: isobus.net VDMA Data Dictionary (https://www.isobus.net/isobus/pGNAndSPN/10427?type=PGN)";
CM_ BO_ 2147547846  "Source: isobus.net VDMA Data Dictionary (https://www.isobus.net/isobus/pGNAndSPN/10429?type=PGN)";
CM_ BO_ 2147547848  "Source: isobus.net VDMA Data Dictionary (https://www.isobus.net/isobus/pGNAndSPN/10434?type=PGN)";
CM_ BO_ 2147547851  "Source: isobus.net VDMA Data Dictionary (https://www.isobus.net/isobus/pGNAndSPN/10435?type=PGN)";
CM_ BO_ 2147547852  "Source: isobus.net VDMA Data Dictionary (https://www.isobus.net/isobus/pGNAndSPN/10436?type=PGN)";
CM_ BO_ 2147547853  "Source: isobus.net VDMA Data Dictionary (https://www.isobus.net/isobus/pGNAndSPN/10438?type=PGN)";
CM_ BO_ 2147547854  "Source: isobus.net VDMA Data Dictionary (https://www.isobus.net/isobus/pGNAndSPN/10440?type=PGN)";
CM_ BO_ 2147547855  "Source: isobus.net VDMA Data Dictionary (https://www.isobus.net/isobus/pGNAndSPN/10449?type=PGN)";
CM_ BO_ 2147547856  "Source: isobus.net VDMA Data Dictionary (https://www.isobus.net/isobus/pGNAndSPN/10452?type=PGN)";
CM_ BO_ 2147547857  "Source: isobus.net VDMA Data Dictionary (https://www.isobus.net/isobus/pGNAndSPN/10455?type=PGN)";
CM_ BO_ 2147547858  "Source: isobus.net VDMA Data Dictionary (https://www.isobus.net/isobus/pGNAndSPN/10459?type=PGN)";
CM_ BO_ 2147547859  "Source: isobus.net VDMA Data Dictionary (https://www.isobus.net/isobus/pGNAndSPN/10464?type=PGN)";
CM_ BO_ 2147547860  "Source: isobus.net VDMA Data Dictionary (https://www.isobus.net/isobus/pGNAndSPN/10466?type=PGN)";
CM_ BO_ 2147547861  "Source: isobus.net VDMA Data Dictionary (https://www.isobus.net/isobus/pGNAndSPN/10470?type=PGN)";
CM_ BO_ 2147547862  "Source: isobus.net VDMA Data Dictionary (https://www.isobus.net/isobus/pGNAndSPN/10478?type=PGN)";
CM_ BO_ 2147547863  "Source: isobus.net VDMA Data Dictionary (https://www.isobus.net/isobus/pGNAndSPN/10479?type=PGN)";
CM_ BO_ 2147547864  "Source: isobus.net VDMA Data Dictionary (https://www.isobus.net/isobus/pGNAndSPN/10480?type=PGN)";
CM_ BO_ 2147547865  "Source: isobus.net VDMA Data Dictionary (https://www.isobus.net/isobus/pGNAndSPN/10481?type=PGN)";
CM_ BO_ 2147547866  "Source: isobus.net VDMA Data Dictionary (https://www.isobus.net/isobus/pGNAndSPN/10482?type=PGN)";
CM_ BO_ 2147547867  "Source: isobus.net VDMA Data Dictionary (https://www.isobus.net/isobus/pGNAndSPN/10483?type=PGN)";
CM_ BO_ 2147547868  "Source: isobus.net VDMA Data Dictionary (https://www.isobus.net/isobus/pGNAndSPN/10484?type=PGN)";
CM_ BO_ 2147547869  "Source: isobus.net VDMA Data Dictionary (https://www.isobus.net/isobus/pGNAndSPN/10485?type=PGN)";
CM_ BO_ 2147547870  "Source: isobus.net VDMA Data Dictionary (https://www.isobus.net/isobus/pGNAndSPN/10486?type=PGN)";
CM_ BO_ 2147547871  "Source: isobus.net VDMA Data Dictionary (https://www.isobus.net/isobus/pGNAndSPN/10487?type=PGN)";
CM_ BO_ 2147547872  "Source: isobus.net VDMA Data Dictionary (https://www.isobus.net/isobus/pGNAndSPN/10488?type=PGN)";
CM_ BO_ 2147547873  "Source: isobus.net VDMA Data Dictionary (https://www.isobus.net/isobus/pGNAndSPN/10489?type=PGN)";
CM_ BO_ 2147547874  "Source: isobus.net VDMA Data Dictionary (https://www.isobus.net/isobus/pGNAndSPN/10490?type=PGN)";
CM_ BO_ 2147547875  "Source: isobus.net VDMA Data Dictionary (https://www.isobus.net/isobus/pGNAndSPN/10491?type=PGN)";
CM_ BO_ 2147547876  "Source: isobus.net VDMA Data Dictionary (https://www.isobus.net/isobus/pGNAndSPN/10492?type=PGN)";
CM_ BO_ 2147547877  "Source: isobus.net VDMA Data Dictionary (https://www.isobus.net/isobus/pGNAndSPN/10493?type=PGN)";
CM_ BO_ 2147547878  "Source: isobus.net VDMA Data Dictionary (https://www.isobus.net/isobus/pGNAndSPN/10494?type=PGN)";
CM_ BO_ 2147547879  "Source: isobus.net VDMA Data Dictionary (https://www.isobus.net/isobus/pGNAndSPN/10495?type=PGN)";
CM_ BO_ 2147547880  "Source: isobus.net VDMA Data Dictionary (https://www.isobus.net/isobus/pGNAndSPN/10496?type=PGN)";
CM_ BO_ 2147547881  "Source: isobus.net VDMA Data Dictionary (https://www.isobus.net/isobus/pGNAndSPN/10497?type=PGN)";
CM_ BO_ 2147547882  "Source: isobus.net VDMA Data Dictionary (https://www.isobus.net/isobus/pGNAndSPN/10498?type=PGN)";
CM_ BO_ 2147547883  "Source: isobus.net VDMA Data Dictionary (https://www.isobus.net/isobus/pGNAndSPN/10499?type=PGN)";
CM_ BO_ 2147547884  "Source: isobus.net VDMA Data Dictionary (https://www.isobus.net/isobus/pGNAndSPN/10500?type=PGN)";
CM_ BO_ 2147547885  "Source: isobus.net VDMA Data Dictionary (https://www.isobus.net/isobus/pGNAndSPN/10508?type=PGN)";
CM_ BO_ 2147547886  "Source: isobus.net VDMA Data Dictionary (https://www.isobus.net/isobus/pGNAndSPN/10516?type=PGN)";
CM_ BO_ 2147547887  "Source: isobus.net VDMA Data Dictionary (https://www.isobus.net/isobus/pGNAndSPN/10517?type=PGN)";
CM_ BO_ 2147547888  "Source: isobus.net VDMA Data Dictionary (https://www.isobus.net/isobus/pGNAndSPN/10519?type=PGN)";
CM_ BO_ 2147547889  "Source: isobus.net VDMA Data Dictionary (https://www.isobus.net/isobus/pGNAndSPN/10522?type=PGN)";
CM_ BO_ 2147547890  "Source: isobus.net VDMA Data Dictionary (https://www.isobus.net/isobus/pGNAndSPN/10525?type=PGN)";
CM_ BO_ 2147547891  "Source: isobus.net VDMA Data Dictionary (https://www.isobus.net/isobus/pGNAndSPN/10528?type=PGN)";
CM_ BO_ 2147547892  "Source: isobus.net VDMA Data Dictionary (https://www.isobus.net/isobus/pGNAndSPN/10536?type=PGN)";
CM_ BO_ 2147547893  "Source: isobus.net VDMA Data Dictionary (https://www.isobus.net/isobus/pGNAndSPN/10544?type=PGN)";
CM_ BO_ 2147547894  "Source: isobus.net VDMA Data Dictionary (https://www.isobus.net/isobus/pGNAndSPN/10552?type=PGN)";
CM_ BO_ 2147547895  "Source: isobus.net VDMA Data Dictionary (https://www.isobus.net/isobus/pGNAndSPN/10560?type=PGN)";
CM_ BO_ 2147547896  "Source: isobus.net VDMA Data Dictionary (https://www.isobus.net/isobus/pGNAndSPN/10568?type=PGN)";
CM_ BO_ 2147547897  "Source: isobus.net VDMA Data Dictionary (https://www.isobus.net/isobus/pGNAndSPN/10572?type=PGN)";
CM_ BO_ 2147547898  "Source: isobus.net VDMA Data Dictionary (https://www.isobus.net/isobus/pGNAndSPN/10576?type=PGN)";
CM_ BO_ 2147547899  "Source: isobus.net VDMA Data Dictionary (https://www.isobus.net/isobus/pGNAndSPN/10580?type=PGN)";
CM_ BO_ 2147547900  "Source: isobus.net VDMA Data Dictionary (https://www.isobus.net/isobus/pGNAndSPN/10593?type=PGN)";
CM_ BO_ 2147547901  "Source: isobus.net VDMA Data Dictionary (https://www.isobus.net/isobus/pGNAndSPN/10606?type=PGN)";
CM_ BO_ 2147547902  "Source: isobus.net VDMA Data Dictionary (https://www.isobus.net/isobus/pGNAndSPN/10619?type=PGN)";
CM_ BO_ 2147547903  "Source: isobus.net VDMA Data Dictionary (https://www.isobus.net/isobus/pGNAndSPN/10622?type=PGN)";
CM_ BO_ 2147547904  "Source: isobus.net VDMA Data Dictionary (https://www.isobus.net/isobus/pGNAndSPN/10625?type=PGN)";
CM_ BO_ 2147547905  "Source: isobus.net VDMA Data Dictionary (https://www.isobus.net/isobus/pGNAndSPN/10628?type=PGN)";
CM_ BO_ 2147547906  "Source: isobus.net VDMA Data Dictionary (https://www.isobus.net/isobus/pGNAndSPN/10645?type=PGN)";
CM_ BO_ 2147547907  "Source: isobus.net VDMA Data Dictionary (https://www.isobus.net/isobus/pGNAndSPN/10662?type=PGN)";
CM_ BO_ 2147547908  "Source: isobus.net VDMA Data Dictionary (https://www.isobus.net/isobus/pGNAndSPN/10679?type=PGN)";
CM_ BO_ 2147547909  "Source: isobus.net VDMA Data Dictionary (https://www.isobus.net/isobus/pGNAndSPN/10696?type=PGN)";
CM_ BO_ 2147547910  "Source: isobus.net VDMA Data Dictionary (https://www.isobus.net/isobus/pGNAndSPN/10713?type=PGN)";
CM_ BO_ 2147547911  "Source: isobus.net VDMA Data Dictionary (https://www.isobus.net/isobus/pGNAndSPN/10730?type=PGN)";
CM_ BO_ 2147547912  "Source: isobus.net VDMA Data Dictionary (https://www.isobus.net/isobus/pGNAndSPN/10747?type=PGN)";
CM_ BO_ 2147547913  "Source: isobus.net VDMA Data Dictionary (https://www.isobus.net/isobus/pGNAndSPN/10764?type=PGN)";
CM_ BO_ 2147547914  "Source: isobus.net VDMA Data Dictionary (https://www.isobus.net/isobus/pGNAndSPN/10781?type=PGN)";
CM_ BO_ 2147547915  "Source: isobus.net VDMA Data Dictionary (https://www.isobus.net/isobus/pGNAndSPN/10798?type=PGN)";
CM_ BO_ 2147547916  "Source: isobus.net VDMA Data Dictionary (https://www.isobus.net/isobus/pGNAndSPN/10815?type=PGN)";
CM_ BO_ 2147547917  "Source: isobus.net VDMA Data Dictionary (https://www.isobus.net/isobus/pGNAndSPN/10832?type=PGN)";
CM_ BO_ 2147547918  "Source: isobus.net VDMA Data Dictionary (https://www.isobus.net/isobus/pGNAndSPN/10849?type=PGN)";
CM_ BO_ 2147547919  "Source: isobus.net VDMA Data Dictionary (https://www.isobus.net/isobus/pGNAndSPN/10866?type=PGN)";
CM_ BO_ 2147547920  "Source: isobus.net VDMA Data Dictionary (https://www.isobus.net/isobus/pGNAndSPN/10883?type=PGN)";
CM_ BO_ 2147547921  "Source: isobus.net VDMA Data Dictionary (https://www.isobus.net/isobus/pGNAndSPN/10900?type=PGN)";
CM_ BO_ 2147547922  "Source: isobus.net VDMA Data Dictionary (https://www.isobus.net/isobus/pGNAndSPN/10917?type=PGN)";
CM_ BO_ 2147547923  "Source: isobus.net VDMA Data Dictionary (https://www.isobus.net/isobus/pGNAndSPN/10934?type=PGN)";
CM_ BO_ 2147547924  "Source: isobus.net VDMA Data Dictionary (https://www.isobus.net/isobus/pGNAndSPN/10951?type=PGN)";
CM_ BO_ 2147547925  "Source: isobus.net VDMA Data Dictionary (https://www.isobus.net/isobus/pGNAndSPN/10968?type=PGN)";
CM_ BO_ 2147547926  "Source: isobus.net VDMA Data Dictionary (https://www.isobus.net/isobus/pGNAndSPN/10985?type=PGN)";
CM_ BO_ 2147547927  "Source: isobus.net VDMA Data Dictionary (https://www.isobus.net/isobus/pGNAndSPN/11002?type=PGN)";
CM_ BO_ 2147547928  "Source: isobus.net VDMA Data Dictionary (https://www.isobus.net/isobus/pGNAndSPN/11009?type=PGN)";
CM_ BO_ 2147547929  "Source: isobus.net VDMA Data Dictionary (https://www.isobus.net/isobus/pGNAndSPN/11015?type=PGN)";
CM_ BO_ 2147547930  "Source: isobus.net VDMA Data Dictionary (https://www.isobus.net/isobus/pGNAndSPN/11021?type=PGN)";
CM_ BO_ 2147547931  "Source: isobus.net VDMA Data Dictionary (https://www.isobus.net/isobus/pGNAndSPN/11027?type=PGN)";
CM_ BO_ 2147547932  "Source: isobus.net VDMA Data Dictionary (https://www.isobus.net/isobus/pGNAndSPN/11031?type=PGN)";
CM_ BO_ 2147547933  "Source: isobus.net VDMA Data Dictionary (https://www.isobus.net/isobus/pGNAndSPN/11038?type=PGN)";
CM_ BO_ 2147547934  "Source: isobus.net VDMA Data Dictionary (https://www.isobus.net/isobus/pGNAndSPN/11044?type=PGN)";
CM_ BO_ 2147547935  "Source: isobus.net VDMA Data Dictionary (https://www.isobus.net/isobus/pGNAndSPN/11050?type=PGN)";
CM_ BO_ 2147547936  "Source: isobus.net VDMA Data Dictionary (https://www.isobus.net/isobus/pGNAndSPN/11056?type=PGN)";
CM_ BO_ 2147547937  "Source: isobus.net VDMA Data Dictionary (https://www.isobus.net/isobus/pGNAndSPN/11060?type=PGN)";
CM_ BO_ 2147547938  "Source: isobus.net VDMA Data Dictionary (https://www.isobus.net/isobus/pGNAndSPN/11067?type=PGN)";
CM_ BO_ 2147547939  "Source: isobus.net VDMA Data Dictionary (https://www.isobus.net/isobus/pGNAndSPN/11073?type=PGN)";
CM_ BO_ 2147547940  "Source: isobus.net VDMA Data Dictionary (https://www.isobus.net/isobus/pGNAndSPN/11079?type=PGN)";
CM_ BO_ 2147547941  "Source: isobus.net VDMA Data Dictionary (https://www.isobus.net/isobus/pGNAndSPN/11085?type=PGN)";
CM_ BO_ 2147547942  "Source: isobus.net VDMA Data Dictionary (https://www.isobus.net/isobus/pGNAndSPN/11089?type=PGN)";
CM_ BO_ 2147547943  "Source: isobus.net VDMA Data Dictionary (https://www.isobus.net/isobus/pGNAndSPN/11096?type=PGN)";
CM_ BO_ 2147547944  "Source: isobus.net VDMA Data Dictionary (https://www.isobus.net/isobus/pGNAndSPN/11102?type=PGN)";
CM_ BO_ 2147547945  "Source: isobus.net VDMA Data Dictionary (https://www.isobus.net/isobus/pGNAndSPN/11108?type=PGN)";
CM_ BO_ 2147547946  "Source: isobus.net VDMA Data Dictionary (https://www.isobus.net/isobus/pGNAndSPN/11114?type=PGN)";
CM_ BO_ 2147547947  "Source: isobus.net VDMA Data Dictionary (https://www.isobus.net/isobus/pGNAndSPN/11118?type=PGN)";
CM_ BO_ 2147547948  "Source: isobus.net VDMA Data Dictionary (https://www.isobus.net/isobus/pGNAndSPN/11119?type=PGN)";
CM_ BO_ 2147547949  "Source: isobus.net VDMA Data Dictionary (https://www.isobus.net/isobus/pGNAndSPN/11123?type=PGN)";
CM_ BO_ 2147547950  "Source: isobus.net VDMA Data Dictionary (https://www.isobus.net/isobus/pGNAndSPN/11124?type=PGN)";
CM_ BO_ 2147547951  "Source: isobus.net VDMA Data Dictionary (https://www.isobus.net/isobus/pGNAndSPN/11129?type=PGN)";
CM_ BO_ 2147547952  "Source: isobus.net VDMA Data Dictionary (https://www.isobus.net/isobus/pGNAndSPN/11135?type=PGN)";
CM_ BO_ 2147547953  "Source: isobus.net VDMA Data Dictionary (https://www.isobus.net/isobus/pGNAndSPN/11139?type=PGN)";
CM_ BO_ 2147547954  "Source: isobus.net VDMA Data Dictionary (https://www.isobus.net/isobus/pGNAndSPN/11144?type=PGN)";
CM_ BO_ 2147547955  "Source: isobus.net VDMA Data Dictionary (https://www.isobus.net/isobus/pGNAndSPN/11148?type=PGN)";
CM_ BO_ 2147547956  "Source: isobus.net VDMA Data Dictionary (https://www.isobus.net/isobus/pGNAndSPN/11155?type=PGN)";
CM_ BO_ 2147547957  "Source: isobus.net VDMA Data Dictionary (https://www.isobus.net/isobus/pGNAndSPN/11174?type=PGN)";
CM_ BO_ 2147547958  "Source: isobus.net VDMA Data Dictionary (https://www.isobus.net/isobus/pGNAndSPN/11179?type=PGN)";
CM_ BO_ 2147547959  "Source: isobus.net VDMA Data Dictionary (https://www.isobus.net/isobus/pGNAndSPN/11185?type=PGN)";
CM_ BO_ 2147547960  "Source: isobus.net VDMA Data Dictionary (https://www.isobus.net/isobus/pGNAndSPN/11189?type=PGN)";
CM_ BO_ 2147547961  "Source: isobus.net VDMA Data Dictionary (https://www.isobus.net/isobus/pGNAndSPN/11194?type=PGN)";
CM_ BO_ 2147547962  "Source: isobus.net VDMA Data Dictionary (https://www.isobus.net/isobus/pGNAndSPN/11198?type=PGN)";
CM_ BO_ 2147547963  "Source: isobus.net VDMA Data Dictionary (https://www.isobus.net/isobus/pGNAndSPN/11205?type=PGN)";
CM_ BO_ 2147547964  "Source: isobus.net VDMA Data Dictionary (https://www.isobus.net/isobus/pGNAndSPN/11224?type=PGN)";
CM_ BO_ 2147547965  "Source: isobus.net VDMA Data Dictionary (https://www.isobus.net/isobus/pGNAndSPN/11229?type=PGN)";
CM_ BO_ 2147547966  "Source: isobus.net VDMA Data Dictionary (https://www.isobus.net/isobus/pGNAndSPN/11235?type=PGN)";
CM_ BO_ 2147547967  "Source: isobus.net VDMA Data Dictionary (https://www.isobus.net/isobus/pGNAndSPN/11239?type=PGN)";
CM_ BO_ 2147547968  "Source: isobus.net VDMA Data Dictionary (https://www.isobus.net/isobus/pGNAndSPN/11244?type=PGN)";
CM_ BO_ 2147547969  "Source: isobus.net VDMA Data Dictionary (https://www.isobus.net/isobus/pGNAndSPN/11248?type=PGN)";
CM_ BO_ 2147547970  "Source: isobus.net VDMA Data Dictionary (https://www.isobus.net/isobus/pGNAndSPN/11255?type=PGN)";
CM_ BO_ 2147547971  "Source: isobus.net VDMA Data Dictionary (https://www.isobus.net/isobus/pGNAndSPN/11274?type=PGN)";
CM_ BO_ 2147547972  "Source: isobus.net VDMA Data Dictionary (https://www.isobus.net/isobus/pGNAndSPN/11279?type=PGN)";
CM_ BO_ 2147547973  "Source: isobus.net VDMA Data Dictionary (https://www.isobus.net/isobus/pGNAndSPN/11285?type=PGN)";
CM_ BO_ 2147547974  "Source: isobus.net VDMA Data Dictionary (https://www.isobus.net/isobus/pGNAndSPN/11289?type=PGN)";
CM_ BO_ 2147547975  "Source: isobus.net VDMA Data Dictionary (https://www.isobus.net/isobus/pGNAndSPN/11294?type=PGN)";
CM_ BO_ 2147547976  "Source: isobus.net VDMA Data Dictionary (https://www.isobus.net/isobus/pGNAndSPN/11298?type=PGN)";
CM_ BO_ 2147547977  "Source: isobus.net VDMA Data Dictionary (https://www.isobus.net/isobus/pGNAndSPN/11305?type=PGN)";
CM_ BO_ 2147547978  "Source: isobus.net VDMA Data Dictionary (https://www.isobus.net/isobus/pGNAndSPN/11324?type=PGN)";
CM_ BO_ 2147547979  "Source: isobus.net VDMA Data Dictionary (https://www.isobus.net/isobus/pGNAndSPN/11333?type=PGN)";
CM_ BO_ 2147547980  "Source: isobus.net VDMA Data Dictionary (https://www.isobus.net/isobus/pGNAndSPN/11335?type=PGN)";
CM_ BO_ 2147547981  "Source: isobus.net VDMA Data Dictionary (https://www.isobus.net/isobus/pGNAndSPN/11343?type=PGN)";
CM_ BO_ 2147547982  "Source: isobus.net VDMA Data Dictionary (https://www.isobus.net/isobus/pGNAndSPN/11345?type=PGN)";
CM_ BO_ 2147547983  "Source: isobus.net VDMA Data Dictionary (https://www.isobus.net/isobus/pGNAndSPN/11351?type=PGN)";
CM_ BO_ 2147547984  "Source: isobus.net VDMA Data Dictionary (https://www.isobus.net/isobus/pGNAndSPN/11361?type=PGN)";
CM_ BO_ 2147547985  "Source: isobus.net VDMA Data Dictionary (https://www.isobus.net/isobus/pGNAndSPN/11367?type=PGN)";
CM_ BO_ 2147547986  "Source: isobus.net VDMA Data Dictionary (https://www.isobus.net/isobus/pGNAndSPN/11377?type=PGN)";
CM_ BO_ 2147547987  "Source: isobus.net VDMA Data Dictionary (https://www.isobus.net/isobus/pGNAndSPN/11383?type=PGN)";
CM_ BO_ 2147547988  "Source: isobus.net VDMA Data Dictionary (https://www.isobus.net/isobus/pGNAndSPN/11393?type=PGN)";
CM_ BO_ 2147547989  "Source: isobus.net VDMA Data Dictionary (https://www.isobus.net/isobus/pGNAndSPN/11399?type=PGN)";
CM_ BO_ 2147547990  "Source: isobus.net VDMA Data Dictionary (https://www.isobus.net/isobus/pGNAndSPN/11409?type=PGN)";
CM_ BO_ 2147547991  "Source: isobus.net VDMA Data Dictionary (https://www.isobus.net/isobus/pGNAndSPN/11415?type=PGN)";
CM_ BO_ 2147547992  "Source: isobus.net VDMA Data Dictionary (https://www.isobus.net/isobus/pGNAndSPN/11425?type=PGN)";
CM_ BO_ 2147547993  "Source: isobus.net VDMA Data Dictionary (https://www.isobus.net/isobus/pGNAndSPN/11431?type=PGN)";
CM_ BO_ 2147547994  "Source: isobus.net VDMA Data Dictionary (https://www.isobus.net/isobus/pGNAndSPN/11441?type=PGN)";
CM_ BO_ 2147547995  "Source: isobus.net VDMA Data Dictionary (https://www.isobus.net/isobus/pGNAndSPN/11465?type=PGN)";
CM_ BO_ 2147547996  "Source: isobus.net VDMA Data Dictionary (https://www.isobus.net/isobus/pGNAndSPN/11489?type=PGN)";
CM_ BO_ 2147547997  "Source: isobus.net VDMA Data Dictionary (https://www.isobus.net/isobus/pGNAndSPN/11513?type=PGN)";
CM_ BO_ 2147547998  "Source: isobus.net VDMA Data Dictionary (https://www.isobus.net/isobus/pGNAndSPN/11537?type=PGN)";
CM_ BO_ 2147547999  "Source: isobus.net VDMA Data Dictionary (https://www.isobus.net/isobus/pGNAndSPN/11545?type=PGN)";
CM_ BO_ 2147548000  "Source: isobus.net VDMA Data Dictionary (https://www.isobus.net/isobus/pGNAndSPN/11553?type=PGN)";
CM_ BO_ 2147548001  "Source: isobus.net VDMA Data Dictionary (https://www.isobus.net/isobus/pGNAndSPN/11561?type=PGN)";
CM_ BO_ 2147548002  "Source: isobus.net VDMA Data Dictionary (https://www.isobus.net/isobus/pGNAndSPN/11569?type=PGN)";
CM_ BO_ 2147548003  "Source: isobus.net VDMA Data Dictionary (https://www.isobus.net/isobus/pGNAndSPN/11582?type=PGN)";
CM_ BO_ 2147548004  "Source: isobus.net VDMA Data Dictionary (https://www.isobus.net/isobus/pGNAndSPN/11595?type=PGN)";
CM_ BO_ 2147548005  "Source: isobus.net VDMA Data Dictionary (https://www.isobus.net/isobus/pGNAndSPN/11608?type=PGN)";
CM_ BO_ 2147548006  "Source: isobus.net VDMA Data Dictionary (https://www.isobus.net/isobus/pGNAndSPN/11621?type=PGN)";
CM_ BO_ 2147548007  "Source: isobus.net VDMA Data Dictionary (https://www.isobus.net/isobus/pGNAndSPN/11640?type=PGN)";
CM_ BO_ 2147548008  "Source: isobus.net VDMA Data Dictionary (https://www.isobus.net/isobus/pGNAndSPN/11647?type=PGN)";
CM_ BO_ 2147548009  "Source: isobus.net VDMA Data Dictionary (https://www.isobus.net/isobus/pGNAndSPN/11666?type=PGN)";
CM_ BO_ 2147548010  "Source: isobus.net VDMA Data Dictionary (https://www.isobus.net/isobus/pGNAndSPN/11673?type=PGN)";
CM_ BO_ 2147548011  "Source: isobus.net VDMA Data Dictionary (https://www.isobus.net/isobus/pGNAndSPN/11679?type=PGN)";
CM_ BO_ 2147548012  "Source: isobus.net VDMA Data Dictionary (https://www.isobus.net/isobus/pGNAndSPN/11684?type=PGN)";
CM_ BO_ 2147548013  "Source: isobus.net VDMA Data Dictionary (https://www.isobus.net/isobus/pGNAndSPN/11690?type=PGN)";
CM_ BO_ 2147548014  "Source: isobus.net VDMA Data Dictionary (https://www.isobus.net/isobus/pGNAndSPN/11694?type=PGN)";
CM_ BO_ 2147548015  "Source: isobus.net VDMA Data Dictionary (https://www.isobus.net/isobus/pGNAndSPN/11699?type=PGN)";
CM_ BO_ 2147548016  "Source: isobus.net VDMA Data Dictionary (https://www.isobus.net/isobus/pGNAndSPN/11703?type=PGN)";
CM_ BO_ 2147548017  "Source: isobus.net VDMA Data Dictionary (https://www.isobus.net/isobus/pGNAndSPN/11707?type=PGN)";
CM_ BO_ 2147548018  "Source: isobus.net VDMA Data Dictionary (https://www.isobus.net/isobus/pGNAndSPN/11712?type=PGN)";
CM_ BO_ 2147548019  "Source: isobus.net VDMA Data Dictionary (https://www.isobus.net/isobus/pGNAndSPN/11716?type=PGN)";
CM_ BO_ 2147548020  "Source: isobus.net VDMA Data Dictionary (https://www.isobus.net/isobus/pGNAndSPN/11722?type=PGN)";
CM_ BO_ 2147548021  "Source: isobus.net VDMA Data Dictionary (https://www.isobus.net/isobus/pGNAndSPN/11727?type=PGN)";
CM_ BO_ 2147548022  "Source: isobus.net VDMA Data Dictionary (https://www.isobus.net/isobus/pGNAndSPN/11737?type=PGN)";
CM_ BO_ 2147548023  "Source: isobus.net VDMA Data Dictionary (https://www.isobus.net/isobus/pGNAndSPN/11745?type=PGN)";
CM_ BO_ 2147548024  "Source: isobus.net VDMA Data Dictionary (https://www.isobus.net/isobus/pGNAndSPN/11753?type=PGN)";
CM_ BO_ 2147548025  "Source: isobus.net VDMA Data Dictionary (https://www.isobus.net/isobus/pGNAndSPN/11761?type=PGN)";
CM_ BO_ 2147548026  "Source: isobus.net VDMA Data Dictionary (https://www.isobus.net/isobus/pGNAndSPN/11769?type=PGN)";
CM_ BO_ 2147548027  "Source: isobus.net VDMA Data Dictionary (https://www.isobus.net/isobus/pGNAndSPN/11777?type=PGN)";
CM_ BO_ 2147548028  "Source: isobus.net VDMA Data Dictionary (https://www.isobus.net/isobus/pGNAndSPN/11779?type=PGN)";
CM_ BO_ 2147548029  "Source: isobus.net VDMA Data Dictionary (https://www.isobus.net/isobus/pGNAndSPN/11787?type=PGN)";
CM_ BO_ 2147548030  "Source: isobus.net VDMA Data Dictionary (https://www.isobus.net/isobus/pGNAndSPN/11795?type=PGN)";
CM_ BO_ 2147548031  "Source: isobus.net VDMA Data Dictionary (https://www.isobus.net/isobus/pGNAndSPN/11798?type=PGN)";
CM_ BO_ 2147548032  "Source: isobus.net VDMA Data Dictionary (https://www.isobus.net/isobus/pGNAndSPN/11809?type=PGN)";
CM_ BO_ 2147548033  "Source: isobus.net VDMA Data Dictionary (https://www.isobus.net/isobus/pGNAndSPN/11812?type=PGN)";
CM_ BO_ 2147548034  "Source: isobus.net VDMA Data Dictionary (https://www.isobus.net/isobus/pGNAndSPN/11817?type=PGN)";
CM_ BO_ 2147548035  "Source: isobus.net VDMA Data Dictionary (https://www.isobus.net/isobus/pGNAndSPN/11822?type=PGN)";
CM_ BO_ 2147548036  "Source: isobus.net VDMA Data Dictionary (https://www.isobus.net/isobus/pGNAndSPN/11826?type=PGN)";
CM_ BO_ 2147548037  "Source: isobus.net VDMA Data Dictionary (https://www.isobus.net/isobus/pGNAndSPN/11830?type=PGN)";
CM_ BO_ 2147548038  "Source: isobus.net VDMA Data Dictionary (https://www.isobus.net/isobus/pGNAndSPN/11831?type=PGN)";
CM_ BO_ 2147548039  "Source: isobus.net VDMA Data Dictionary (https://www.isobus.net/isobus/pGNAndSPN/11832?type=PGN)";
CM_ BO_ 2147548040  "Source: isobus.net VDMA Data Dictionary (https://www.isobus.net/isobus/pGNAndSPN/11845?type=PGN)";
CM_ BO_ 2147548041  "Source: isobus.net VDMA Data Dictionary (https://www.isobus.net/isobus/pGNAndSPN/11852?type=PGN)";
CM_ BO_ 2147548042  "Source: isobus.net VDMA Data Dictionary (https://www.isobus.net/isobus/pGNAndSPN/11857?type=PGN)";
CM_ BO_ 2147548043  "Source: isobus.net VDMA Data Dictionary (https://www.isobus.net/isobus/pGNAndSPN/11859?type=PGN)";
CM_ BO_ 2147548044  "Source: isobus.net VDMA Data Dictionary (https://www.isobus.net/isobus/pGNAndSPN/11861?type=PGN)";
CM_ BO_ 2147548045  "Source: isobus.net VDMA Data Dictionary (https://www.isobus.net/isobus/pGNAndSPN/11863?type=PGN)";
CM_ BO_ 2147548046  "Source: isobus.net VDMA Data Dictionary (https://www.isobus.net/isobus/pGNAndSPN/11865?type=PGN)";
CM_ BO_ 2147548047  "Source: isobus.net VDMA Data Dictionary (https://www.isobus.net/isobus/pGNAndSPN/11867?type=PGN)";
CM_ BO_ 2147548048  "Source: isobus.net VDMA Data Dictionary (https://www.isobus.net/isobus/pGNAndSPN/11869?type=PGN)";
CM_ BO_ 2147548049  "Source: isobus.net VDMA Data Dictionary (https://www.isobus.net/isobus/pGNAndSPN/11871?type=PGN)";
CM_ BO_ 2147548050  "Source: isobus.net VDMA Data Dictionary (https://www.isobus.net/isobus/pGNAndSPN/11873?type=PGN)";
CM_ BO_ 2147548051  "Source: isobus.net VDMA Data Dictionary (https://www.isobus.net/isobus/pGNAndSPN/11875?type=PGN)";
CM_ BO_ 2147548052  "Source: isobus.net VDMA Data Dictionary (https://www.isobus.net/isobus/pGNAndSPN/11877?type=PGN)";
CM_ BO_ 2147548053  "Source: isobus.net VDMA Data Dictionary (https://www.isobus.net/isobus/pGNAndSPN/11878?type=PGN)";
CM_ BO_ 2147548054  "Source: isobus.net VDMA Data Dictionary (https://www.isobus.net/isobus/pGNAndSPN/11881?type=PGN)";
CM_ BO_ 2147548055  "Source: isobus.net VDMA Data Dictionary (https://www.isobus.net/isobus/pGNAndSPN/11885?type=PGN)";
CM_ BO_ 2147548056  "Source: isobus.net VDMA Data Dictionary (https://www.isobus.net/isobus/pGNAndSPN/11886?type=PGN)";
CM_ BO_ 2147548057  "Source: isobus.net VDMA Data Dictionary (https://www.isobus.net/isobus/pGNAndSPN/11891?type=PGN)";
CM_ BO_ 2147548058  "Source: isobus.net VDMA Data Dictionary (https://www.isobus.net/isobus/pGNAndSPN/11895?type=PGN)";
CM_ BO_ 2147548059  "Source: isobus.net VDMA Data Dictionary (https://www.isobus.net/isobus/pGNAndSPN/11898?type=PGN)";
CM_ BO_ 2147548060  "Source: isobus.net VDMA Data Dictionary (https://www.isobus.net/isobus/pGNAndSPN/11905?type=PGN)";
CM_ BO_ 2147548061  "Source: isobus.net VDMA Data Dictionary (https://www.isobus.net/isobus/pGNAndSPN/11907?type=PGN)";
CM_ BO_ 2147548062  "Source: isobus.net VDMA Data Dictionary (https://www.isobus.net/isobus/pGNAndSPN/11912?type=PGN)";
CM_ BO_ 2147548063  "Source: isobus.net VDMA Data Dictionary (https://www.isobus.net/isobus/pGNAndSPN/11916?type=PGN)";
CM_ BO_ 2147548064  "Source: isobus.net VDMA Data Dictionary (https://www.isobus.net/isobus/pGNAndSPN/11919?type=PGN)";
CM_ BO_ 2147548065  "Source: isobus.net VDMA Data Dictionary (https://www.isobus.net/isobus/pGNAndSPN/11926?type=PGN)";
CM_ BO_ 2147548066  "Source: isobus.net VDMA Data Dictionary (https://www.isobus.net/isobus/pGNAndSPN/11928?type=PGN)";
CM_ BO_ 2147548067  "Source: isobus.net VDMA Data Dictionary (https://www.isobus.net/isobus/pGNAndSPN/11933?type=PGN)";
CM_ BO_ 2147548068  "Source: isobus.net VDMA Data Dictionary (https://www.isobus.net/isobus/pGNAndSPN/11937?type=PGN)";
CM_ BO_ 2147548069  "Source: isobus.net VDMA Data Dictionary (https://www.isobus.net/isobus/pGNAndSPN/11940?type=PGN)";
CM_ BO_ 2147548070  "Source: isobus.net VDMA Data Dictionary (https://www.isobus.net/isobus/pGNAndSPN/11947?type=PGN)";
CM_ BO_ 2147548071  "Source: isobus.net VDMA Data Dictionary (https://www.isobus.net/isobus/pGNAndSPN/11949?type=PGN)";
CM_ BO_ 2147548072  "Source: isobus.net VDMA Data Dictionary (https://www.isobus.net/isobus/pGNAndSPN/11954?type=PGN)";
CM_ BO_ 2147548073  "Source: isobus.net VDMA Data Dictionary (https://www.isobus.net/isobus/pGNAndSPN/11958?type=PGN)";
CM_ BO_ 2147548074  "Source: isobus.net VDMA Data Dictionary (https://www.isobus.net/isobus/pGNAndSPN/11961?type=PGN)";
CM_ BO_ 2147548075  "Source: isobus.net VDMA Data Dictionary (https://www.isobus.net/isobus/pGNAndSPN/11968?type=PGN)";
CM_ BO_ 2147548076  "Source: isobus.net VDMA Data Dictionary (https://www.isobus.net/isobus/pGNAndSPN/11970?type=PGN)";
CM_ BO_ 2147548077  "Source: isobus.net VDMA Data Dictionary (https://www.isobus.net/isobus/pGNAndSPN/11975?type=PGN)";
CM_ BO_ 2147548078  "Source: isobus.net VDMA Data Dictionary (https://www.isobus.net/isobus/pGNAndSPN/11979?type=PGN)";
CM_ BO_ 2147548079  "Source: isobus.net VDMA Data Dictionary (https://www.isobus.net/isobus/pGNAndSPN/11982?type=PGN)";
CM_ BO_ 2147548080  "Source: isobus.net VDMA Data Dictionary (https://www.isobus.net/isobus/pGNAndSPN/11989?type=PGN)";
CM_ BO_ 2147548081  "Source: isobus.net VDMA Data Dictionary (https://www.isobus.net/isobus/pGNAndSPN/11991?type=PGN)";
CM_ BO_ 2147548082  "Source: isobus.net VDMA Data Dictionary (https://www.isobus.net/isobus/pGNAndSPN/11995?type=PGN)";
CM_ BO_ 2147548083  "Source: isobus.net VDMA Data Dictionary (https://www.isobus.net/isobus/pGNAndSPN/11997?type=PGN)";
CM_ BO_ 2147548084  "Source: isobus.net VDMA Data Dictionary (https://www.isobus.net/isobus/pGNAndSPN/11999?type=PGN)";
CM_ BO_ 2147548085  "Source: isobus.net VDMA Data Dictionary (https://www.isobus.net/isobus/pGNAndSPN/12001?type=PGN)";
CM_ BO_ 2147548086  "Source: isobus.net VDMA Data Dictionary (https://www.isobus.net/isobus/pGNAndSPN/12003?type=PGN)";
CM_ BO_ 2147548087  "Source: isobus.net VDMA Data Dictionary (https://www.isobus.net/isobus/pGNAndSPN/12005?type=PGN)";
CM_ BO_ 2147548088  "Source: isobus.net VDMA Data Dictionary (https://www.isobus.net/isobus/pGNAndSPN/12009?type=PGN)";
CM_ BO_ 2147548089  "Source: isobus.net VDMA Data Dictionary (https://www.isobus.net/isobus/pGNAndSPN/12021?type=PGN)";
CM_ BO_ 2147548090  "Source: isobus.net VDMA Data Dictionary (https://www.isobus.net/isobus/pGNAndSPN/12024?type=PGN)";
CM_ BO_ 2147548091  "Source: isobus.net VDMA Data Dictionary (https://www.isobus.net/isobus/pGNAndSPN/12029?type=PGN)";
CM_ BO_ 2147548092  "Source: isobus.net VDMA Data Dictionary (https://www.isobus.net/isobus/pGNAndSPN/12033?type=PGN)";
CM_ BO_ 2147548093  "Source: isobus.net VDMA Data Dictionary (https://www.isobus.net/isobus/pGNAndSPN/12037?type=PGN)";
CM_ BO_ 2147548094  "Source: isobus.net VDMA Data Dictionary (https://www.isobus.net/isobus/pGNAndSPN/12041?type=PGN)";
CM_ BO_ 2147548095  "Source: isobus.net VDMA Data Dictionary (https://www.isobus.net/isobus/pGNAndSPN/12053?type=PGN)";
CM_ BO_ 2147548096  "Source: isobus.net VDMA Data Dictionary (https://www.isobus.net/isobus/pGNAndSPN/12056?type=PGN)";
CM_ BO_ 2147548097  "Source: isobus.net VDMA Data Dictionary (https://www.isobus.net/isobus/pGNAndSPN/12061?type=PGN)";
CM_ BO_ 2147548098  "Source: isobus.net VDMA Data Dictionary (https://www.isobus.net/isobus/pGNAndSPN/12065?type=PGN)";
CM_ BO_ 2147548099  "Source: isobus.net VDMA Data Dictionary (https://www.isobus.net/isobus/pGNAndSPN/12069?type=PGN)";
CM_ BO_ 2147548100  "Source: isobus.net VDMA Data Dictionary (https://www.isobus.net/isobus/pGNAndSPN/12073?type=PGN)";
CM_ BO_ 2147548101  "Source: isobus.net VDMA Data Dictionary (https://www.isobus.net/isobus/pGNAndSPN/12085?type=PGN)";
CM_ BO_ 2147548102  "Source: isobus.net VDMA Data Dictionary (https://www.isobus.net/isobus/pGNAndSPN/12088?type=PGN)";
CM_ BO_ 2147548103  "Source: isobus.net VDMA Data Dictionary (https://www.isobus.net/isobus/pGNAndSPN/12093?type=PGN)";
CM_ BO_ 2147548104  "Source: isobus.net VDMA Data Dictionary (https://www.isobus.net/isobus/pGNAndSPN/12097?type=PGN)";
CM_ BO_ 2147548105  "Source: isobus.net VDMA Data Dictionary (https://www.isobus.net/isobus/pGNAndSPN/12101?type=PGN)";
CM_ BO_ 2147548106  "Source: isobus.net VDMA Data Dictionary (https://www.isobus.net/isobus/pGNAndSPN/12102?type=PGN)";
CM_ SG_ 2147547826 High_Voltage_Energy_Storage_Pack "Generic 8-byte raw payload. Detail page: https://www.isobus.net/isobus/pGNAndSPN/10359?type=PGN. Signal-level enrichment via PR welcome  see CONTRIBUTING.md.";
CM_ SG_ 2147547827 AUTOSAR_Time_Synchronization_Raw "Generic 8-byte raw payload. Detail page: https://www.isobus.net/isobus/pGNAndSPN/10360?type=PGN. Signal-level enrichment via PR welcome  see CONTRIBUTING.md.";
CM_ SG_ 2147547828 EV_DC_Charging_Limits_1_RawPaylo "Generic 8-byte raw payload. Detail page: https://www.isobus.net/isobus/pGNAndSPN/10364?type=PGN. Signal-level enrichment via PR welcome  see CONTRIBUTING.md.";
CM_ SG_ 2147547829 EVSE_DC_Charging_Limits_1_RawPay "Generic 8-byte raw payload. Detail page: https://www.isobus.net/isobus/pGNAndSPN/10368?type=PGN. Signal-level enrichment via PR welcome  see CONTRIBUTING.md.";
CM_ SG_ 2147547830 EVSE_DC_Charging_Limits_2_RawPay "Generic 8-byte raw payload. Detail page: https://www.isobus.net/isobus/pGNAndSPN/10372?type=PGN. Signal-level enrichment via PR welcome  see CONTRIBUTING.md.";
CM_ SG_ 2147547831 EV_DC_Charging_Target_RawPayload "Generic 8-byte raw payload. Detail page: https://www.isobus.net/isobus/pGNAndSPN/10376?type=PGN. Signal-level enrichment via PR welcome  see CONTRIBUTING.md.";
CM_ SG_ 2147547832 EVSE_DC_Status_1_RawPayload "Generic 8-byte raw payload. Detail page: https://www.isobus.net/isobus/pGNAndSPN/10386?type=PGN. Signal-level enrichment via PR welcome  see CONTRIBUTING.md.";
CM_ SG_ 2147547833 EVSE_1_Contactor_Cmd_1_RawPayloa "Generic 8-byte raw payload. Detail page: https://www.isobus.net/isobus/pGNAndSPN/10387?type=PGN. Signal-level enrichment via PR welcome  see CONTRIBUTING.md.";
CM_ SG_ 2147547834 EVSE_1_Contactor_Status_1_RawPay "Generic 8-byte raw payload. Detail page: https://www.isobus.net/isobus/pGNAndSPN/10390?type=PGN. Signal-level enrichment via PR welcome  see CONTRIBUTING.md.";
CM_ SG_ 2147547835 Direct_Lamp_Control_Command_3_Ra "Generic 8-byte raw payload. Detail page: https://www.isobus.net/isobus/pGNAndSPN/10392?type=PGN. Signal-level enrichment via PR welcome  see CONTRIBUTING.md.";
CM_ SG_ 2147547836 Direct_Lamp_Control_Data_3_RawPa "Generic 8-byte raw payload. Detail page: https://www.isobus.net/isobus/pGNAndSPN/10394?type=PGN. Signal-level enrichment via PR welcome  see CONTRIBUTING.md.";
CM_ SG_ 2147547837 Motor_Generator_1_Lifetime_Data_ "Generic 8-byte raw payload. Detail page: https://www.isobus.net/isobus/pGNAndSPN/10398?type=PGN. Signal-level enrichment via PR welcome  see CONTRIBUTING.md.";
CM_ SG_ 2147547838 Motor_Generator_2_Lifetime_Data_ "Generic 8-byte raw payload. Detail page: https://www.isobus.net/isobus/pGNAndSPN/10402?type=PGN. Signal-level enrichment via PR welcome  see CONTRIBUTING.md.";
CM_ SG_ 2147547839 Motor_Generator_3_Lifetime_Data_ "Generic 8-byte raw payload. Detail page: https://www.isobus.net/isobus/pGNAndSPN/10406?type=PGN. Signal-level enrichment via PR welcome  see CONTRIBUTING.md.";
CM_ SG_ 2147547840 Motor_Generator_4_Lifetime_Data_ "Generic 8-byte raw payload. Detail page: https://www.isobus.net/isobus/pGNAndSPN/10410?type=PGN. Signal-level enrichment via PR welcome  see CONTRIBUTING.md.";
CM_ SG_ 2147547841 Motor_Generator_5_Lifetime_Data_ "Generic 8-byte raw payload. Detail page: https://www.isobus.net/isobus/pGNAndSPN/10414?type=PGN. Signal-level enrichment via PR welcome  see CONTRIBUTING.md.";
CM_ SG_ 2147547842 Motor_Generator_6_Lifetime_Data_ "Generic 8-byte raw payload. Detail page: https://www.isobus.net/isobus/pGNAndSPN/10418?type=PGN. Signal-level enrichment via PR welcome  see CONTRIBUTING.md.";
CM_ SG_ 2147547843 Air_Supply_Pressure_3_RawPayload "Generic 8-byte raw payload. Detail page: https://www.isobus.net/isobus/pGNAndSPN/10420?type=PGN. Signal-level enrichment via PR welcome  see CONTRIBUTING.md.";
CM_ SG_ 2147547844 EVSE_AC_Supply_Voltage_RawPayloa "Generic 8-byte raw payload. Detail page: https://www.isobus.net/isobus/pGNAndSPN/10423?type=PGN. Signal-level enrichment via PR welcome  see CONTRIBUTING.md.";
CM_ SG_ 2147547845 EVSE_AC_3_Phase_Load_RawPayload "Generic 8-byte raw payload. Detail page: https://www.isobus.net/isobus/pGNAndSPN/10427?type=PGN. Signal-level enrichment via PR welcome  see CONTRIBUTING.md.";
CM_ SG_ 2147547846 Electronic_Retarder_Controller_3 "Generic 8-byte raw payload. Detail page: https://www.isobus.net/isobus/pGNAndSPN/10429?type=PGN. Signal-level enrichment via PR welcome  see CONTRIBUTING.md.";
CM_ SG_ 2147547848 Electronic_Transmission_Controll "Generic 8-byte raw payload. Detail page: https://www.isobus.net/isobus/pGNAndSPN/10434?type=PGN. Signal-level enrichment via PR welcome  see CONTRIBUTING.md.";
CM_ SG_ 2147547851 Collision_Avoidance_System_4_Raw "Generic 8-byte raw payload. Detail page: https://www.isobus.net/isobus/pGNAndSPN/10435?type=PGN. Signal-level enrichment via PR welcome  see CONTRIBUTING.md.";
CM_ SG_ 2147547852 Collision_Avoidance_System_3_Raw "Generic 8-byte raw payload. Detail page: https://www.isobus.net/isobus/pGNAndSPN/10436?type=PGN. Signal-level enrichment via PR welcome  see CONTRIBUTING.md.";
CM_ SG_ 2147547853 Aftertreatment_1_SCR_Exhaust_Gas "Generic 8-byte raw payload. Detail page: https://www.isobus.net/isobus/pGNAndSPN/10438?type=PGN. Signal-level enrichment via PR welcome  see CONTRIBUTING.md.";
CM_ SG_ 2147547854 PTO_Information_2_RawPayload "Generic 8-byte raw payload. Detail page: https://www.isobus.net/isobus/pGNAndSPN/10440?type=PGN. Signal-level enrichment via PR welcome  see CONTRIBUTING.md.";
CM_ SG_ 2147547855 EVCC_Diagnostic_Data_1_RawPayloa "Generic 8-byte raw payload. Detail page: https://www.isobus.net/isobus/pGNAndSPN/10449?type=PGN. Signal-level enrichment via PR welcome  see CONTRIBUTING.md.";
CM_ SG_ 2147547856 Cab_Door_Control_2_RawPayload "Generic 8-byte raw payload. Detail page: https://www.isobus.net/isobus/pGNAndSPN/10452?type=PGN. Signal-level enrichment via PR welcome  see CONTRIBUTING.md.";
CM_ SG_ 2147547857 Engine_Average_Information_2_Raw "Generic 8-byte raw payload. Detail page: https://www.isobus.net/isobus/pGNAndSPN/10455?type=PGN. Signal-level enrichment via PR welcome  see CONTRIBUTING.md.";
CM_ SG_ 2147547858 Turbocharger_Information_9_RawPa "Generic 8-byte raw payload. Detail page: https://www.isobus.net/isobus/pGNAndSPN/10459?type=PGN. Signal-level enrichment via PR welcome  see CONTRIBUTING.md.";
CM_ SG_ 2147547859 Automated_Driving_System_Control "Generic 8-byte raw payload. Detail page: https://www.isobus.net/isobus/pGNAndSPN/10464?type=PGN. Signal-level enrichment via PR welcome  see CONTRIBUTING.md.";
CM_ SG_ 2147547860 EVSE_AC_Status_2_RawPayload "Generic 8-byte raw payload. Detail page: https://www.isobus.net/isobus/pGNAndSPN/10466?type=PGN. Signal-level enrichment via PR welcome  see CONTRIBUTING.md.";
CM_ SG_ 2147547861 EVSE_AC_Status_1_RawPayload "Generic 8-byte raw payload. Detail page: https://www.isobus.net/isobus/pGNAndSPN/10470?type=PGN. Signal-level enrichment via PR welcome  see CONTRIBUTING.md.";
CM_ SG_ 2147547862 EVSE_Status_1_RawPayload "Generic 8-byte raw payload. Detail page: https://www.isobus.net/isobus/pGNAndSPN/10478?type=PGN. Signal-level enrichment via PR welcome  see CONTRIBUTING.md.";
CM_ SG_ 2147547863 Object_Detection_Message_1_1_Raw "Generic 8-byte raw payload. Detail page: https://www.isobus.net/isobus/pGNAndSPN/10479?type=PGN. Signal-level enrichment via PR welcome  see CONTRIBUTING.md.";
CM_ SG_ 2147547864 Object_Detection_Message_2_1_Raw "Generic 8-byte raw payload. Detail page: https://www.isobus.net/isobus/pGNAndSPN/10480?type=PGN. Signal-level enrichment via PR welcome  see CONTRIBUTING.md.";
CM_ SG_ 2147547865 Object_Detection_Message_2_2_Raw "Generic 8-byte raw payload. Detail page: https://www.isobus.net/isobus/pGNAndSPN/10481?type=PGN. Signal-level enrichment via PR welcome  see CONTRIBUTING.md.";
CM_ SG_ 2147547866 Object_Detection_Message_2_3_Raw "Generic 8-byte raw payload. Detail page: https://www.isobus.net/isobus/pGNAndSPN/10482?type=PGN. Signal-level enrichment via PR welcome  see CONTRIBUTING.md.";
CM_ SG_ 2147547867 Object_Detection_Message_2_4_Raw "Generic 8-byte raw payload. Detail page: https://www.isobus.net/isobus/pGNAndSPN/10483?type=PGN. Signal-level enrichment via PR welcome  see CONTRIBUTING.md.";
CM_ SG_ 2147547868 Object_Detection_Message_2_5_Raw "Generic 8-byte raw payload. Detail page: https://www.isobus.net/isobus/pGNAndSPN/10484?type=PGN. Signal-level enrichment via PR welcome  see CONTRIBUTING.md.";
CM_ SG_ 2147547869 Object_Detection_Message_2_6_Raw "Generic 8-byte raw payload. Detail page: https://www.isobus.net/isobus/pGNAndSPN/10485?type=PGN. Signal-level enrichment via PR welcome  see CONTRIBUTING.md.";
CM_ SG_ 2147547870 Object_Detection_Message_2_7_Raw "Generic 8-byte raw payload. Detail page: https://www.isobus.net/isobus/pGNAndSPN/10486?type=PGN. Signal-level enrichment via PR welcome  see CONTRIBUTING.md.";
CM_ SG_ 2147547871 Object_Detection_Message_2_8_Raw "Generic 8-byte raw payload. Detail page: https://www.isobus.net/isobus/pGNAndSPN/10487?type=PGN. Signal-level enrichment via PR welcome  see CONTRIBUTING.md.";
CM_ SG_ 2147547872 Object_Detection_Message_2_9_Raw "Generic 8-byte raw payload. Detail page: https://www.isobus.net/isobus/pGNAndSPN/10488?type=PGN. Signal-level enrichment via PR welcome  see CONTRIBUTING.md.";
CM_ SG_ 2147547873 Object_Detection_Message_2_10_Ra "Generic 8-byte raw payload. Detail page: https://www.isobus.net/isobus/pGNAndSPN/10489?type=PGN. Signal-level enrichment via PR welcome  see CONTRIBUTING.md.";
CM_ SG_ 2147547874 Object_Detection_Message_2_11_Ra "Generic 8-byte raw payload. Detail page: https://www.isobus.net/isobus/pGNAndSPN/10490?type=PGN. Signal-level enrichment via PR welcome  see CONTRIBUTING.md.";
CM_ SG_ 2147547875 Object_Detection_Message_2_12_Ra "Generic 8-byte raw payload. Detail page: https://www.isobus.net/isobus/pGNAndSPN/10491?type=PGN. Signal-level enrichment via PR welcome  see CONTRIBUTING.md.";
CM_ SG_ 2147547876 Object_Detection_Message_2_13_Ra "Generic 8-byte raw payload. Detail page: https://www.isobus.net/isobus/pGNAndSPN/10492?type=PGN. Signal-level enrichment via PR welcome  see CONTRIBUTING.md.";
CM_ SG_ 2147547877 Object_Detection_Message_2_14_Ra "Generic 8-byte raw payload. Detail page: https://www.isobus.net/isobus/pGNAndSPN/10493?type=PGN. Signal-level enrichment via PR welcome  see CONTRIBUTING.md.";
CM_ SG_ 2147547878 Object_Detection_Message_2_15_Ra "Generic 8-byte raw payload. Detail page: https://www.isobus.net/isobus/pGNAndSPN/10494?type=PGN. Signal-level enrichment via PR welcome  see CONTRIBUTING.md.";
CM_ SG_ 2147547879 Object_Detection_Message_2_16_Ra "Generic 8-byte raw payload. Detail page: https://www.isobus.net/isobus/pGNAndSPN/10495?type=PGN. Signal-level enrichment via PR welcome  see CONTRIBUTING.md.";
CM_ SG_ 2147547880 Object_Detection_Message_2_17_Ra "Generic 8-byte raw payload. Detail page: https://www.isobus.net/isobus/pGNAndSPN/10496?type=PGN. Signal-level enrichment via PR welcome  see CONTRIBUTING.md.";
CM_ SG_ 2147547881 Object_Detection_Message_2_18_Ra "Generic 8-byte raw payload. Detail page: https://www.isobus.net/isobus/pGNAndSPN/10497?type=PGN. Signal-level enrichment via PR welcome  see CONTRIBUTING.md.";
CM_ SG_ 2147547882 Object_Detection_Message_2_19_Ra "Generic 8-byte raw payload. Detail page: https://www.isobus.net/isobus/pGNAndSPN/10498?type=PGN. Signal-level enrichment via PR welcome  see CONTRIBUTING.md.";
CM_ SG_ 2147547883 Object_Detection_Message_2_20_Ra "Generic 8-byte raw payload. Detail page: https://www.isobus.net/isobus/pGNAndSPN/10499?type=PGN. Signal-level enrichment via PR welcome  see CONTRIBUTING.md.";
CM_ SG_ 2147547884 Object_Detection_Message_2_21_Ra "Generic 8-byte raw payload. Detail page: https://www.isobus.net/isobus/pGNAndSPN/10500?type=PGN. Signal-level enrichment via PR welcome  see CONTRIBUTING.md.";
CM_ SG_ 2147547885 Temperature_Sensing_Module_1_Raw "Generic 8-byte raw payload. Detail page: https://www.isobus.net/isobus/pGNAndSPN/10508?type=PGN. Signal-level enrichment via PR welcome  see CONTRIBUTING.md.";
CM_ SG_ 2147547886 Temperature_Sensing_Module_2_Raw "Generic 8-byte raw payload. Detail page: https://www.isobus.net/isobus/pGNAndSPN/10516?type=PGN. Signal-level enrichment via PR welcome  see CONTRIBUTING.md.";
CM_ SG_ 2147547887 Aftertreatment_2_SCR_Service_Inf "Generic 8-byte raw payload. Detail page: https://www.isobus.net/isobus/pGNAndSPN/10517?type=PGN. Signal-level enrichment via PR welcome  see CONTRIBUTING.md.";
CM_ SG_ 2147547888 Aftertreatment_1_SCR_Service_Inf "Generic 8-byte raw payload. Detail page: https://www.isobus.net/isobus/pGNAndSPN/10519?type=PGN. Signal-level enrichment via PR welcome  see CONTRIBUTING.md.";
CM_ SG_ 2147547889 PSA_Times_Lifetime_Hours_RawPayl "Generic 8-byte raw payload. Detail page: https://www.isobus.net/isobus/pGNAndSPN/10522?type=PGN. Signal-level enrichment via PR welcome  see CONTRIBUTING.md.";
CM_ SG_ 2147547890 PSA_Times_Stored_100_Hours_RawPa "Generic 8-byte raw payload. Detail page: https://www.isobus.net/isobus/pGNAndSPN/10525?type=PGN. Signal-level enrichment via PR welcome  see CONTRIBUTING.md.";
CM_ SG_ 2147547891 PSA_Times_Active_100_Hours_RawPa "Generic 8-byte raw payload. Detail page: https://www.isobus.net/isobus/pGNAndSPN/10528?type=PGN. Signal-level enrichment via PR welcome  see CONTRIBUTING.md.";
CM_ SG_ 2147547892 Hybrid_Charge_Depleting_or_Incre "Generic 8-byte raw payload. Detail page: https://www.isobus.net/isobus/pGNAndSPN/10536?type=PGN. Signal-level enrichment via PR welcome  see CONTRIBUTING.md.";
CM_ SG_ 2147547893 Hybrid_Charge_Depleting_or_Incre "Generic 8-byte raw payload. Detail page: https://www.isobus.net/isobus/pGNAndSPN/10544?type=PGN. Signal-level enrichment via PR welcome  see CONTRIBUTING.md.";
CM_ SG_ 2147547894 Hybrid_Charge_Depleting_or_Incre "Generic 8-byte raw payload. Detail page: https://www.isobus.net/isobus/pGNAndSPN/10552?type=PGN. Signal-level enrichment via PR welcome  see CONTRIBUTING.md.";
CM_ SG_ 2147547895 Aftertreatment_1_Historical_Info "Generic 8-byte raw payload. Detail page: https://www.isobus.net/isobus/pGNAndSPN/10560?type=PGN. Signal-level enrichment via PR welcome  see CONTRIBUTING.md.";
CM_ SG_ 2147547896 Engine_Maximum_Net_Torque_Map_Ra "Generic 8-byte raw payload. Detail page: https://www.isobus.net/isobus/pGNAndSPN/10568?type=PGN. Signal-level enrichment via PR welcome  see CONTRIBUTING.md.";
CM_ SG_ 2147547897 Aftertreatment_1_SCR_2_NOx_Mass_ "Generic 8-byte raw payload. Detail page: https://www.isobus.net/isobus/pGNAndSPN/10572?type=PGN. Signal-level enrichment via PR welcome  see CONTRIBUTING.md.";
CM_ SG_ 2147547898 Aftertreatment_1_SCR_1_NOx_Mass_ "Generic 8-byte raw payload. Detail page: https://www.isobus.net/isobus/pGNAndSPN/10576?type=PGN. Signal-level enrichment via PR welcome  see CONTRIBUTING.md.";
CM_ SG_ 2147547899 Evaporative_System_Pressure_and_ "Generic 8-byte raw payload. Detail page: https://www.isobus.net/isobus/pGNAndSPN/10580?type=PGN. Signal-level enrichment via PR welcome  see CONTRIBUTING.md.";
CM_ SG_ 2147547900 GHG_Tracking_Lifetime_Array_Data "Generic 8-byte raw payload. Detail page: https://www.isobus.net/isobus/pGNAndSPN/10593?type=PGN. Signal-level enrichment via PR welcome  see CONTRIBUTING.md.";
CM_ SG_ 2147547901 GHG_Tracking_Stored_100_Hour_Arr "Generic 8-byte raw payload. Detail page: https://www.isobus.net/isobus/pGNAndSPN/10606?type=PGN. Signal-level enrichment via PR welcome  see CONTRIBUTING.md.";
CM_ SG_ 2147547902 GHG_Tracking_Active_100_Hour_Arr "Generic 8-byte raw payload. Detail page: https://www.isobus.net/isobus/pGNAndSPN/10619?type=PGN. Signal-level enrichment via PR welcome  see CONTRIBUTING.md.";
CM_ SG_ 2147547903 Green_House_Gas_Stored_100_Hour_ "Generic 8-byte raw payload. Detail page: https://www.isobus.net/isobus/pGNAndSPN/10622?type=PGN. Signal-level enrichment via PR welcome  see CONTRIBUTING.md.";
CM_ SG_ 2147547904 Green_House_Gas_Active_100_Hour_ "Generic 8-byte raw payload. Detail page: https://www.isobus.net/isobus/pGNAndSPN/10625?type=PGN. Signal-level enrichment via PR welcome  see CONTRIBUTING.md.";
CM_ SG_ 2147547905 Green_House_Gas_Lifetime_Active_ "Generic 8-byte raw payload. Detail page: https://www.isobus.net/isobus/pGNAndSPN/10628?type=PGN. Signal-level enrichment via PR welcome  see CONTRIBUTING.md.";
CM_ SG_ 2147547906 NOx_Tracking_Engine_Activity_Lif "Generic 8-byte raw payload. Detail page: https://www.isobus.net/isobus/pGNAndSPN/10645?type=PGN. Signal-level enrichment via PR welcome  see CONTRIBUTING.md.";
CM_ SG_ 2147547907 NOx_Tracking_Engine_Activity_Lif "Generic 8-byte raw payload. Detail page: https://www.isobus.net/isobus/pGNAndSPN/10662?type=PGN. Signal-level enrichment via PR welcome  see CONTRIBUTING.md.";
CM_ SG_ 2147547908 NOx_Tracking_Engine_Activity_Lif "Generic 8-byte raw payload. Detail page: https://www.isobus.net/isobus/pGNAndSPN/10679?type=PGN. Signal-level enrichment via PR welcome  see CONTRIBUTING.md.";
CM_ SG_ 2147547909 NOx_Tracking_Engine_Activity_Lif "Generic 8-byte raw payload. Detail page: https://www.isobus.net/isobus/pGNAndSPN/10696?type=PGN. Signal-level enrichment via PR welcome  see CONTRIBUTING.md.";
CM_ SG_ 2147547910 NOx_Tracking_Valid_NOx_Lifetime_ "Generic 8-byte raw payload. Detail page: https://www.isobus.net/isobus/pGNAndSPN/10713?type=PGN. Signal-level enrichment via PR welcome  see CONTRIBUTING.md.";
CM_ SG_ 2147547911 NOx_Tracking_Valid_NOx_Lifetime_ "Generic 8-byte raw payload. Detail page: https://www.isobus.net/isobus/pGNAndSPN/10730?type=PGN. Signal-level enrichment via PR welcome  see CONTRIBUTING.md.";
CM_ SG_ 2147547912 NOx_Tracking_Valid_NOx_Lifetime_ "Generic 8-byte raw payload. Detail page: https://www.isobus.net/isobus/pGNAndSPN/10747?type=PGN. Signal-level enrichment via PR welcome  see CONTRIBUTING.md.";
CM_ SG_ 2147547913 NOx_Tracking_Valid_NOx_Lifetime_ "Generic 8-byte raw payload. Detail page: https://www.isobus.net/isobus/pGNAndSPN/10764?type=PGN. Signal-level enrichment via PR welcome  see CONTRIBUTING.md.";
CM_ SG_ 2147547914 NOx_Tracking_Valid_NOx_Lifetime_ "Generic 8-byte raw payload. Detail page: https://www.isobus.net/isobus/pGNAndSPN/10781?type=PGN. Signal-level enrichment via PR welcome  see CONTRIBUTING.md.";
CM_ SG_ 2147547915 NOx_Tracking_Valid_NOx_Lifetime_ "Generic 8-byte raw payload. Detail page: https://www.isobus.net/isobus/pGNAndSPN/10798?type=PGN. Signal-level enrichment via PR welcome  see CONTRIBUTING.md.";
CM_ SG_ 2147547916 NOx_Tracking_Stored_100_Hour_Fue "Generic 8-byte raw payload. Detail page: https://www.isobus.net/isobus/pGNAndSPN/10815?type=PGN. Signal-level enrichment via PR welcome  see CONTRIBUTING.md.";
CM_ SG_ 2147547917 NOx_Tracking_Stored_100_Hour_Eng "Generic 8-byte raw payload. Detail page: https://www.isobus.net/isobus/pGNAndSPN/10832?type=PGN. Signal-level enrichment via PR welcome  see CONTRIBUTING.md.";
CM_ SG_ 2147547918 NOx_Tracking_Stored_100_Hour_Veh "Generic 8-byte raw payload. Detail page: https://www.isobus.net/isobus/pGNAndSPN/10849?type=PGN. Signal-level enrichment via PR welcome  see CONTRIBUTING.md.";
CM_ SG_ 2147547919 NOx_Tracking_Stored_100_Hour_Eng "Generic 8-byte raw payload. Detail page: https://www.isobus.net/isobus/pGNAndSPN/10866?type=PGN. Signal-level enrichment via PR welcome  see CONTRIBUTING.md.";
CM_ SG_ 2147547920 NOx_Tracking_Stored_100_Hour_Eng "Generic 8-byte raw payload. Detail page: https://www.isobus.net/isobus/pGNAndSPN/10883?type=PGN. Signal-level enrichment via PR welcome  see CONTRIBUTING.md.";
CM_ SG_ 2147547921 NOx_Tracking_Stored_100_Hour_Sys "Generic 8-byte raw payload. Detail page: https://www.isobus.net/isobus/pGNAndSPN/10900?type=PGN. Signal-level enrichment via PR welcome  see CONTRIBUTING.md.";
CM_ SG_ 2147547922 NOx_Tracking_Active_100_Hour_Fue "Generic 8-byte raw payload. Detail page: https://www.isobus.net/isobus/pGNAndSPN/10917?type=PGN. Signal-level enrichment via PR welcome  see CONTRIBUTING.md.";
CM_ SG_ 2147547923 NOx_Tracking_Active_100_Hour_Eng "Generic 8-byte raw payload. Detail page: https://www.isobus.net/isobus/pGNAndSPN/10934?type=PGN. Signal-level enrichment via PR welcome  see CONTRIBUTING.md.";
CM_ SG_ 2147547924 NOx_Tracking_Active_100_Hour_Veh "Generic 8-byte raw payload. Detail page: https://www.isobus.net/isobus/pGNAndSPN/10951?type=PGN. Signal-level enrichment via PR welcome  see CONTRIBUTING.md.";
CM_ SG_ 2147547925 NOx_Tracking_Active_100_Hour_Eng "Generic 8-byte raw payload. Detail page: https://www.isobus.net/isobus/pGNAndSPN/10968?type=PGN. Signal-level enrichment via PR welcome  see CONTRIBUTING.md.";
CM_ SG_ 2147547926 NOx_Tracking_Active_100_Hour_Eng "Generic 8-byte raw payload. Detail page: https://www.isobus.net/isobus/pGNAndSPN/10985?type=PGN. Signal-level enrichment via PR welcome  see CONTRIBUTING.md.";
CM_ SG_ 2147547927 NOx_Tracking_Active_100_Hour_Sys "Generic 8-byte raw payload. Detail page: https://www.isobus.net/isobus/pGNAndSPN/11002?type=PGN. Signal-level enrichment via PR welcome  see CONTRIBUTING.md.";
CM_ SG_ 2147547928 Motor_Generator_6_Inverter_Contr "Generic 8-byte raw payload. Detail page: https://www.isobus.net/isobus/pGNAndSPN/11009?type=PGN. Signal-level enrichment via PR welcome  see CONTRIBUTING.md.";
CM_ SG_ 2147547929 Motor_Generator_6_Inverter_Limit "Generic 8-byte raw payload. Detail page: https://www.isobus.net/isobus/pGNAndSPN/11015?type=PGN. Signal-level enrichment via PR welcome  see CONTRIBUTING.md.";
CM_ SG_ 2147547930 Motor_Generator_6_Inverter_Limit "Generic 8-byte raw payload. Detail page: https://www.isobus.net/isobus/pGNAndSPN/11021?type=PGN. Signal-level enrichment via PR welcome  see CONTRIBUTING.md.";
CM_ SG_ 2147547931 Motor_Generator_6_Inverter_Limit "Generic 8-byte raw payload. Detail page: https://www.isobus.net/isobus/pGNAndSPN/11027?type=PGN. Signal-level enrichment via PR welcome  see CONTRIBUTING.md.";
CM_ SG_ 2147547932 Motor_Generator_6_Inverter_Isola "Generic 8-byte raw payload. Detail page: https://www.isobus.net/isobus/pGNAndSPN/11031?type=PGN. Signal-level enrichment via PR welcome  see CONTRIBUTING.md.";
CM_ SG_ 2147547933 Motor_Generator_5_Inverter_Contr "Generic 8-byte raw payload. Detail page: https://www.isobus.net/isobus/pGNAndSPN/11038?type=PGN. Signal-level enrichment via PR welcome  see CONTRIBUTING.md.";
CM_ SG_ 2147547934 Motor_Generator_5_Inverter_Limit "Generic 8-byte raw payload. Detail page: https://www.isobus.net/isobus/pGNAndSPN/11044?type=PGN. Signal-level enrichment via PR welcome  see CONTRIBUTING.md.";
CM_ SG_ 2147547935 Motor_Generator_5_Inverter_Limit "Generic 8-byte raw payload. Detail page: https://www.isobus.net/isobus/pGNAndSPN/11050?type=PGN. Signal-level enrichment via PR welcome  see CONTRIBUTING.md.";
CM_ SG_ 2147547936 Motor_Generator_5_Inverter_Limit "Generic 8-byte raw payload. Detail page: https://www.isobus.net/isobus/pGNAndSPN/11056?type=PGN. Signal-level enrichment via PR welcome  see CONTRIBUTING.md.";
CM_ SG_ 2147547937 Motor_Generator_5_Inverter_Isola "Generic 8-byte raw payload. Detail page: https://www.isobus.net/isobus/pGNAndSPN/11060?type=PGN. Signal-level enrichment via PR welcome  see CONTRIBUTING.md.";
CM_ SG_ 2147547938 Motor_Generator_4_Inverter_Contr "Generic 8-byte raw payload. Detail page: https://www.isobus.net/isobus/pGNAndSPN/11067?type=PGN. Signal-level enrichment via PR welcome  see CONTRIBUTING.md.";
CM_ SG_ 2147547939 Motor_Generator_4_Inverter_Limit "Generic 8-byte raw payload. Detail page: https://www.isobus.net/isobus/pGNAndSPN/11073?type=PGN. Signal-level enrichment via PR welcome  see CONTRIBUTING.md.";
CM_ SG_ 2147547940 Motor_Generator_4_Inverter_Limit "Generic 8-byte raw payload. Detail page: https://www.isobus.net/isobus/pGNAndSPN/11079?type=PGN. Signal-level enrichment via PR welcome  see CONTRIBUTING.md.";
CM_ SG_ 2147547941 Motor_Generator_4_Inverter_Limit "Generic 8-byte raw payload. Detail page: https://www.isobus.net/isobus/pGNAndSPN/11085?type=PGN. Signal-level enrichment via PR welcome  see CONTRIBUTING.md.";
CM_ SG_ 2147547942 Motor_Generator_4_Inverter_Isola "Generic 8-byte raw payload. Detail page: https://www.isobus.net/isobus/pGNAndSPN/11089?type=PGN. Signal-level enrichment via PR welcome  see CONTRIBUTING.md.";
CM_ SG_ 2147547943 Motor_Generator_3_Inverter_Contr "Generic 8-byte raw payload. Detail page: https://www.isobus.net/isobus/pGNAndSPN/11096?type=PGN. Signal-level enrichment via PR welcome  see CONTRIBUTING.md.";
CM_ SG_ 2147547944 Motor_Generator_3_Inverter_Limit "Generic 8-byte raw payload. Detail page: https://www.isobus.net/isobus/pGNAndSPN/11102?type=PGN. Signal-level enrichment via PR welcome  see CONTRIBUTING.md.";
CM_ SG_ 2147547945 Motor_Generator_3_Inverter_Limit "Generic 8-byte raw payload. Detail page: https://www.isobus.net/isobus/pGNAndSPN/11108?type=PGN. Signal-level enrichment via PR welcome  see CONTRIBUTING.md.";
CM_ SG_ 2147547946 Motor_Generator_3_Inverter_Limit "Generic 8-byte raw payload. Detail page: https://www.isobus.net/isobus/pGNAndSPN/11114?type=PGN. Signal-level enrichment via PR welcome  see CONTRIBUTING.md.";
CM_ SG_ 2147547947 Motor_Generator_3_Inverter_Isola "Generic 8-byte raw payload. Detail page: https://www.isobus.net/isobus/pGNAndSPN/11118?type=PGN. Signal-level enrichment via PR welcome  see CONTRIBUTING.md.";
CM_ SG_ 2147547948 Diagnostic_Readiness_4_RawPayloa "Generic 8-byte raw payload. Detail page: https://www.isobus.net/isobus/pGNAndSPN/11119?type=PGN. Signal-level enrichment via PR welcome  see CONTRIBUTING.md.";
CM_ SG_ 2147547949 Turbocharger_Information_8_RawPa "Generic 8-byte raw payload. Detail page: https://www.isobus.net/isobus/pGNAndSPN/11123?type=PGN. Signal-level enrichment via PR welcome  see CONTRIBUTING.md.";
CM_ SG_ 2147547950 Winch_Information_2_RawPayload "Generic 8-byte raw payload. Detail page: https://www.isobus.net/isobus/pGNAndSPN/11124?type=PGN. Signal-level enrichment via PR welcome  see CONTRIBUTING.md.";
CM_ SG_ 2147547951 Motor_Generator_6_Inverter_Refer "Generic 8-byte raw payload. Detail page: https://www.isobus.net/isobus/pGNAndSPN/11129?type=PGN. Signal-level enrichment via PR welcome  see CONTRIBUTING.md.";
CM_ SG_ 2147547952 Motor_Generator_6_Inverter_Statu "Generic 8-byte raw payload. Detail page: https://www.isobus.net/isobus/pGNAndSPN/11135?type=PGN. Signal-level enrichment via PR welcome  see CONTRIBUTING.md.";
CM_ SG_ 2147547953 Motor_Generator_6_Inverter_Refer "Generic 8-byte raw payload. Detail page: https://www.isobus.net/isobus/pGNAndSPN/11139?type=PGN. Signal-level enrichment via PR welcome  see CONTRIBUTING.md.";
CM_ SG_ 2147547954 Motor_Generator_6_Inverter_Tempe "Generic 8-byte raw payload. Detail page: https://www.isobus.net/isobus/pGNAndSPN/11144?type=PGN. Signal-level enrichment via PR welcome  see CONTRIBUTING.md.";
CM_ SG_ 2147547955 Motor_Generator_6_Inverter_Motor "Generic 8-byte raw payload. Detail page: https://www.isobus.net/isobus/pGNAndSPN/11148?type=PGN. Signal-level enrichment via PR welcome  see CONTRIBUTING.md.";
CM_ SG_ 2147547956 Motor_Generator_6_Inverter_Isola "Generic 8-byte raw payload. Detail page: https://www.isobus.net/isobus/pGNAndSPN/11155?type=PGN. Signal-level enrichment via PR welcome  see CONTRIBUTING.md.";
CM_ SG_ 2147547957 Motor_Generator_6_Inverter_Activ "Generic 8-byte raw payload. Detail page: https://www.isobus.net/isobus/pGNAndSPN/11174?type=PGN. Signal-level enrichment via PR welcome  see CONTRIBUTING.md.";
CM_ SG_ 2147547958 Motor_Generator_5_Inverter_Refer "Generic 8-byte raw payload. Detail page: https://www.isobus.net/isobus/pGNAndSPN/11179?type=PGN. Signal-level enrichment via PR welcome  see CONTRIBUTING.md.";
CM_ SG_ 2147547959 Motor_Generator_5_Inverter_Statu "Generic 8-byte raw payload. Detail page: https://www.isobus.net/isobus/pGNAndSPN/11185?type=PGN. Signal-level enrichment via PR welcome  see CONTRIBUTING.md.";
CM_ SG_ 2147547960 Motor_Generator_5_Inverter_Refer "Generic 8-byte raw payload. Detail page: https://www.isobus.net/isobus/pGNAndSPN/11189?type=PGN. Signal-level enrichment via PR welcome  see CONTRIBUTING.md.";
CM_ SG_ 2147547961 Motor_Generator_5_Inverter_Tempe "Generic 8-byte raw payload. Detail page: https://www.isobus.net/isobus/pGNAndSPN/11194?type=PGN. Signal-level enrichment via PR welcome  see CONTRIBUTING.md.";
CM_ SG_ 2147547962 Motor_Generator_5_Inverter_Motor "Generic 8-byte raw payload. Detail page: https://www.isobus.net/isobus/pGNAndSPN/11198?type=PGN. Signal-level enrichment via PR welcome  see CONTRIBUTING.md.";
CM_ SG_ 2147547963 Motor_Generator_5_Inverter_Isola "Generic 8-byte raw payload. Detail page: https://www.isobus.net/isobus/pGNAndSPN/11205?type=PGN. Signal-level enrichment via PR welcome  see CONTRIBUTING.md.";
CM_ SG_ 2147547964 Motor_Generator_5_Inverter_Activ "Generic 8-byte raw payload. Detail page: https://www.isobus.net/isobus/pGNAndSPN/11224?type=PGN. Signal-level enrichment via PR welcome  see CONTRIBUTING.md.";
CM_ SG_ 2147547965 Motor_Generator_4_Inverter_Refer "Generic 8-byte raw payload. Detail page: https://www.isobus.net/isobus/pGNAndSPN/11229?type=PGN. Signal-level enrichment via PR welcome  see CONTRIBUTING.md.";
CM_ SG_ 2147547966 Motor_Generator_4_Inverter_Statu "Generic 8-byte raw payload. Detail page: https://www.isobus.net/isobus/pGNAndSPN/11235?type=PGN. Signal-level enrichment via PR welcome  see CONTRIBUTING.md.";
CM_ SG_ 2147547967 Motor_Generator_4_Inverter_Refer "Generic 8-byte raw payload. Detail page: https://www.isobus.net/isobus/pGNAndSPN/11239?type=PGN. Signal-level enrichment via PR welcome  see CONTRIBUTING.md.";
CM_ SG_ 2147547968 Motor_Generator_4_Inverter_Tempe "Generic 8-byte raw payload. Detail page: https://www.isobus.net/isobus/pGNAndSPN/11244?type=PGN. Signal-level enrichment via PR welcome  see CONTRIBUTING.md.";
CM_ SG_ 2147547969 Motor_Generator_4_Inverter_Motor "Generic 8-byte raw payload. Detail page: https://www.isobus.net/isobus/pGNAndSPN/11248?type=PGN. Signal-level enrichment via PR welcome  see CONTRIBUTING.md.";
CM_ SG_ 2147547970 Motor_Generator_4_Inverter_Isola "Generic 8-byte raw payload. Detail page: https://www.isobus.net/isobus/pGNAndSPN/11255?type=PGN. Signal-level enrichment via PR welcome  see CONTRIBUTING.md.";
CM_ SG_ 2147547971 Motor_Generator_4_Inverter_Activ "Generic 8-byte raw payload. Detail page: https://www.isobus.net/isobus/pGNAndSPN/11274?type=PGN. Signal-level enrichment via PR welcome  see CONTRIBUTING.md.";
CM_ SG_ 2147547972 Motor_Generator_3_Inverter_Refer "Generic 8-byte raw payload. Detail page: https://www.isobus.net/isobus/pGNAndSPN/11279?type=PGN. Signal-level enrichment via PR welcome  see CONTRIBUTING.md.";
CM_ SG_ 2147547973 Motor_Generator_3_Inverter_Statu "Generic 8-byte raw payload. Detail page: https://www.isobus.net/isobus/pGNAndSPN/11285?type=PGN. Signal-level enrichment via PR welcome  see CONTRIBUTING.md.";
CM_ SG_ 2147547974 Motor_Generator_3_Inverter_Refer "Generic 8-byte raw payload. Detail page: https://www.isobus.net/isobus/pGNAndSPN/11289?type=PGN. Signal-level enrichment via PR welcome  see CONTRIBUTING.md.";
CM_ SG_ 2147547975 Motor_Generator_3_Inverter_Tempe "Generic 8-byte raw payload. Detail page: https://www.isobus.net/isobus/pGNAndSPN/11294?type=PGN. Signal-level enrichment via PR welcome  see CONTRIBUTING.md.";
CM_ SG_ 2147547976 Motor_Generator_3_Inverter_Motor "Generic 8-byte raw payload. Detail page: https://www.isobus.net/isobus/pGNAndSPN/11298?type=PGN. Signal-level enrichment via PR welcome  see CONTRIBUTING.md.";
CM_ SG_ 2147547977 Motor_Generator_3_Inverter_Isola "Generic 8-byte raw payload. Detail page: https://www.isobus.net/isobus/pGNAndSPN/11305?type=PGN. Signal-level enrichment via PR welcome  see CONTRIBUTING.md.";
CM_ SG_ 2147547978 Motor_Generator_3_Inverter_Activ "Generic 8-byte raw payload. Detail page: https://www.isobus.net/isobus/pGNAndSPN/11324?type=PGN. Signal-level enrichment via PR welcome  see CONTRIBUTING.md.";
CM_ SG_ 2147547979 Automated_Driving_System_Status_ "Generic 8-byte raw payload. Detail page: https://www.isobus.net/isobus/pGNAndSPN/11333?type=PGN. Signal-level enrichment via PR welcome  see CONTRIBUTING.md.";
CM_ SG_ 2147547980 Cab_Climate_System_Information_2 "Generic 8-byte raw payload. Detail page: https://www.isobus.net/isobus/pGNAndSPN/11335?type=PGN. Signal-level enrichment via PR welcome  see CONTRIBUTING.md.";
CM_ SG_ 2147547981 Maintenance_Information_1_RawPay "Generic 8-byte raw payload. Detail page: https://www.isobus.net/isobus/pGNAndSPN/11343?type=PGN. Signal-level enrichment via PR welcome  see CONTRIBUTING.md.";
CM_ SG_ 2147547982 Hoist_Control_Information_RawPay "Generic 8-byte raw payload. Detail page: https://www.isobus.net/isobus/pGNAndSPN/11345?type=PGN. Signal-level enrichment via PR welcome  see CONTRIBUTING.md.";
CM_ SG_ 2147547983 High_Voltage_Energy_Storage_Pack "Generic 8-byte raw payload. Detail page: https://www.isobus.net/isobus/pGNAndSPN/11351?type=PGN. Signal-level enrichment via PR welcome  see CONTRIBUTING.md.";
CM_ SG_ 2147547984 High_Voltage_Energy_Storage_Pack "Generic 8-byte raw payload. Detail page: https://www.isobus.net/isobus/pGNAndSPN/11361?type=PGN. Signal-level enrichment via PR welcome  see CONTRIBUTING.md.";
CM_ SG_ 2147547985 High_Voltage_Energy_Storage_Pack "Generic 8-byte raw payload. Detail page: https://www.isobus.net/isobus/pGNAndSPN/11367?type=PGN. Signal-level enrichment via PR welcome  see CONTRIBUTING.md.";
CM_ SG_ 2147547986 High_Voltage_Energy_Storage_Pack "Generic 8-byte raw payload. Detail page: https://www.isobus.net/isobus/pGNAndSPN/11377?type=PGN. Signal-level enrichment via PR welcome  see CONTRIBUTING.md.";
CM_ SG_ 2147547987 High_Voltage_Energy_Storage_Pack "Generic 8-byte raw payload. Detail page: https://www.isobus.net/isobus/pGNAndSPN/11383?type=PGN. Signal-level enrichment via PR welcome  see CONTRIBUTING.md.";
CM_ SG_ 2147547988 High_Voltage_Energy_Storage_Pack "Generic 8-byte raw payload. Detail page: https://www.isobus.net/isobus/pGNAndSPN/11393?type=PGN. Signal-level enrichment via PR welcome  see CONTRIBUTING.md.";
CM_ SG_ 2147547989 High_Voltage_Energy_Storage_Pack "Generic 8-byte raw payload. Detail page: https://www.isobus.net/isobus/pGNAndSPN/11399?type=PGN. Signal-level enrichment via PR welcome  see CONTRIBUTING.md.";
CM_ SG_ 2147547990 High_Voltage_Energy_Storage_Pack "Generic 8-byte raw payload. Detail page: https://www.isobus.net/isobus/pGNAndSPN/11409?type=PGN. Signal-level enrichment via PR welcome  see CONTRIBUTING.md.";
CM_ SG_ 2147547991 High_Voltage_Energy_Storage_Pack "Generic 8-byte raw payload. Detail page: https://www.isobus.net/isobus/pGNAndSPN/11415?type=PGN. Signal-level enrichment via PR welcome  see CONTRIBUTING.md.";
CM_ SG_ 2147547992 High_Voltage_Energy_Storage_Pack "Generic 8-byte raw payload. Detail page: https://www.isobus.net/isobus/pGNAndSPN/11425?type=PGN. Signal-level enrichment via PR welcome  see CONTRIBUTING.md.";
CM_ SG_ 2147547993 High_Voltage_Energy_Storage_Pack "Generic 8-byte raw payload. Detail page: https://www.isobus.net/isobus/pGNAndSPN/11431?type=PGN. Signal-level enrichment via PR welcome  see CONTRIBUTING.md.";
CM_ SG_ 2147547994 High_Voltage_Energy_Storage_Pack "Generic 8-byte raw payload. Detail page: https://www.isobus.net/isobus/pGNAndSPN/11441?type=PGN. Signal-level enrichment via PR welcome  see CONTRIBUTING.md.";
CM_ SG_ 2147547995 Vehicle_Fire_Suppression_System_ "Generic 8-byte raw payload. Detail page: https://www.isobus.net/isobus/pGNAndSPN/11465?type=PGN. Signal-level enrichment via PR welcome  see CONTRIBUTING.md.";
CM_ SG_ 2147547996 Vehicle_Fire_Suppression_System_ "Generic 8-byte raw payload. Detail page: https://www.isobus.net/isobus/pGNAndSPN/11489?type=PGN. Signal-level enrichment via PR welcome  see CONTRIBUTING.md.";
CM_ SG_ 2147547997 Vehicle_Fire_Suppression_System_ "Generic 8-byte raw payload. Detail page: https://www.isobus.net/isobus/pGNAndSPN/11513?type=PGN. Signal-level enrichment via PR welcome  see CONTRIBUTING.md.";
CM_ SG_ 2147547998 Vehicle_Fire_Suppression_System_ "Generic 8-byte raw payload. Detail page: https://www.isobus.net/isobus/pGNAndSPN/11537?type=PGN. Signal-level enrichment via PR welcome  see CONTRIBUTING.md.";
CM_ SG_ 2147547999 Vehicle_Fire_Suppression_System_ "Generic 8-byte raw payload. Detail page: https://www.isobus.net/isobus/pGNAndSPN/11545?type=PGN. Signal-level enrichment via PR welcome  see CONTRIBUTING.md.";
CM_ SG_ 2147548000 Vehicle_Fire_Suppression_System_ "Generic 8-byte raw payload. Detail page: https://www.isobus.net/isobus/pGNAndSPN/11553?type=PGN. Signal-level enrichment via PR welcome  see CONTRIBUTING.md.";
CM_ SG_ 2147548001 Vehicle_Fire_Suppression_System_ "Generic 8-byte raw payload. Detail page: https://www.isobus.net/isobus/pGNAndSPN/11561?type=PGN. Signal-level enrichment via PR welcome  see CONTRIBUTING.md.";
CM_ SG_ 2147548002 Vehicle_Fire_Suppression_System_ "Generic 8-byte raw payload. Detail page: https://www.isobus.net/isobus/pGNAndSPN/11569?type=PGN. Signal-level enrichment via PR welcome  see CONTRIBUTING.md.";
CM_ SG_ 2147548003 Vehicle_Fire_Suppression_System_ "Generic 8-byte raw payload. Detail page: https://www.isobus.net/isobus/pGNAndSPN/11582?type=PGN. Signal-level enrichment via PR welcome  see CONTRIBUTING.md.";
CM_ SG_ 2147548004 Vehicle_Fire_Suppression_System_ "Generic 8-byte raw payload. Detail page: https://www.isobus.net/isobus/pGNAndSPN/11595?type=PGN. Signal-level enrichment via PR welcome  see CONTRIBUTING.md.";
CM_ SG_ 2147548005 Vehicle_Fire_Suppression_System_ "Generic 8-byte raw payload. Detail page: https://www.isobus.net/isobus/pGNAndSPN/11608?type=PGN. Signal-level enrichment via PR welcome  see CONTRIBUTING.md.";
CM_ SG_ 2147548006 Vehicle_Fire_Suppression_System_ "Generic 8-byte raw payload. Detail page: https://www.isobus.net/isobus/pGNAndSPN/11621?type=PGN. Signal-level enrichment via PR welcome  see CONTRIBUTING.md.";
CM_ SG_ 2147548007 Motor_Generator_2_Inverter_Activ "Generic 8-byte raw payload. Detail page: https://www.isobus.net/isobus/pGNAndSPN/11640?type=PGN. Signal-level enrichment via PR welcome  see CONTRIBUTING.md.";
CM_ SG_ 2147548008 Motor_Generator_2_Inverter_Isola "Generic 8-byte raw payload. Detail page: https://www.isobus.net/isobus/pGNAndSPN/11647?type=PGN. Signal-level enrichment via PR welcome  see CONTRIBUTING.md.";
CM_ SG_ 2147548009 Motor_Generator_1_Inverter_Activ "Generic 8-byte raw payload. Detail page: https://www.isobus.net/isobus/pGNAndSPN/11666?type=PGN. Signal-level enrichment via PR welcome  see CONTRIBUTING.md.";
CM_ SG_ 2147548010 Motor_Generator_1_Inverter_Isola "Generic 8-byte raw payload. Detail page: https://www.isobus.net/isobus/pGNAndSPN/11673?type=PGN. Signal-level enrichment via PR welcome  see CONTRIBUTING.md.";
CM_ SG_ 2147548011 High_Voltage_Bus_Information_Raw "Generic 8-byte raw payload. Detail page: https://www.isobus.net/isobus/pGNAndSPN/11679?type=PGN. Signal-level enrichment via PR welcome  see CONTRIBUTING.md.";
CM_ SG_ 2147548012 Motor_Generator_2_Inverter_Refer "Generic 8-byte raw payload. Detail page: https://www.isobus.net/isobus/pGNAndSPN/11684?type=PGN. Signal-level enrichment via PR welcome  see CONTRIBUTING.md.";
CM_ SG_ 2147548013 Motor_Generator_2_Inverter_Statu "Generic 8-byte raw payload. Detail page: https://www.isobus.net/isobus/pGNAndSPN/11690?type=PGN. Signal-level enrichment via PR welcome  see CONTRIBUTING.md.";
CM_ SG_ 2147548014 Motor_Generator_2_Inverter_Refer "Generic 8-byte raw payload. Detail page: https://www.isobus.net/isobus/pGNAndSPN/11694?type=PGN. Signal-level enrichment via PR welcome  see CONTRIBUTING.md.";
CM_ SG_ 2147548015 Motor_Generator_2_Inverter_Tempe "Generic 8-byte raw payload. Detail page: https://www.isobus.net/isobus/pGNAndSPN/11699?type=PGN. Signal-level enrichment via PR welcome  see CONTRIBUTING.md.";
CM_ SG_ 2147548016 Motor_Generator_2_Inverter_Motor "Generic 8-byte raw payload. Detail page: https://www.isobus.net/isobus/pGNAndSPN/11703?type=PGN. Signal-level enrichment via PR welcome  see CONTRIBUTING.md.";
CM_ SG_ 2147548017 Motor_Generator_1_Inverter_Motor "Generic 8-byte raw payload. Detail page: https://www.isobus.net/isobus/pGNAndSPN/11707?type=PGN. Signal-level enrichment via PR welcome  see CONTRIBUTING.md.";
CM_ SG_ 2147548018 Motor_Generator_1_Inverter_Tempe "Generic 8-byte raw payload. Detail page: https://www.isobus.net/isobus/pGNAndSPN/11712?type=PGN. Signal-level enrichment via PR welcome  see CONTRIBUTING.md.";
CM_ SG_ 2147548019 Motor_Generator_1_Inverter_Refer "Generic 8-byte raw payload. Detail page: https://www.isobus.net/isobus/pGNAndSPN/11716?type=PGN. Signal-level enrichment via PR welcome  see CONTRIBUTING.md.";
CM_ SG_ 2147548020 Motor_Generator_1_Inverter_Statu "Generic 8-byte raw payload. Detail page: https://www.isobus.net/isobus/pGNAndSPN/11722?type=PGN. Signal-level enrichment via PR welcome  see CONTRIBUTING.md.";
CM_ SG_ 2147548021 Motor_Generator_1_Inverter_Refer "Generic 8-byte raw payload. Detail page: https://www.isobus.net/isobus/pGNAndSPN/11727?type=PGN. Signal-level enrichment via PR welcome  see CONTRIBUTING.md.";
CM_ SG_ 2147548022 Personnel_Detect_Status_RawPaylo "Generic 8-byte raw payload. Detail page: https://www.isobus.net/isobus/pGNAndSPN/11737?type=PGN. Signal-level enrichment via PR welcome  see CONTRIBUTING.md.";
CM_ SG_ 2147548023 Engine_Cylinder_Pressure_Gamma_1 "Generic 8-byte raw payload. Detail page: https://www.isobus.net/isobus/pGNAndSPN/11745?type=PGN. Signal-level enrichment via PR welcome  see CONTRIBUTING.md.";
CM_ SG_ 2147548024 Engine_Cylinder_Pressure_Gamma_2 "Generic 8-byte raw payload. Detail page: https://www.isobus.net/isobus/pGNAndSPN/11753?type=PGN. Signal-level enrichment via PR welcome  see CONTRIBUTING.md.";
CM_ SG_ 2147548025 Engine_Cylinder_Pressure_Gamma_3 "Generic 8-byte raw payload. Detail page: https://www.isobus.net/isobus/pGNAndSPN/11761?type=PGN. Signal-level enrichment via PR welcome  see CONTRIBUTING.md.";
CM_ SG_ 2147548026 Engine_Cylinder_Pressure_Gamma_4 "Generic 8-byte raw payload. Detail page: https://www.isobus.net/isobus/pGNAndSPN/11769?type=PGN. Signal-level enrichment via PR welcome  see CONTRIBUTING.md.";
CM_ SG_ 2147548027 Engine_Cylinder_Pressure_Gamma_5 "Generic 8-byte raw payload. Detail page: https://www.isobus.net/isobus/pGNAndSPN/11777?type=PGN. Signal-level enrichment via PR welcome  see CONTRIBUTING.md.";
CM_ SG_ 2147548028 Wake_Up_and_Sleep_RawPayload "Generic 8-byte raw payload. Detail page: https://www.isobus.net/isobus/pGNAndSPN/11779?type=PGN. Signal-level enrichment via PR welcome  see CONTRIBUTING.md.";
CM_ SG_ 2147548029 Electrified_Accessory_Generator_ "Generic 8-byte raw payload. Detail page: https://www.isobus.net/isobus/pGNAndSPN/11787?type=PGN. Signal-level enrichment via PR welcome  see CONTRIBUTING.md.";
CM_ SG_ 2147548030 Electrified_Accessory_Generator_ "Generic 8-byte raw payload. Detail page: https://www.isobus.net/isobus/pGNAndSPN/11795?type=PGN. Signal-level enrichment via PR welcome  see CONTRIBUTING.md.";
CM_ SG_ 2147548031 Well_Stimulation_Pump_System_Fil "Generic 8-byte raw payload. Detail page: https://www.isobus.net/isobus/pGNAndSPN/11798?type=PGN. Signal-level enrichment via PR welcome  see CONTRIBUTING.md.";
CM_ SG_ 2147548032 PTO_Governor_Configuration_RawPa "Generic 8-byte raw payload. Detail page: https://www.isobus.net/isobus/pGNAndSPN/11809?type=PGN. Signal-level enrichment via PR welcome  see CONTRIBUTING.md.";
CM_ SG_ 2147548033 On_Board_Programming_2_RawPayloa "Generic 8-byte raw payload. Detail page: https://www.isobus.net/isobus/pGNAndSPN/11812?type=PGN. Signal-level enrichment via PR welcome  see CONTRIBUTING.md.";
CM_ SG_ 2147548034 Primary_or_Rear_Hitch_Yaw_RawPay "Generic 8-byte raw payload. Detail page: https://www.isobus.net/isobus/pGNAndSPN/11817?type=PGN. Signal-level enrichment via PR welcome  see CONTRIBUTING.md.";
CM_ SG_ 2147548035 Secondary_or_Front_Hitch_Yaw_Raw "Generic 8-byte raw payload. Detail page: https://www.isobus.net/isobus/pGNAndSPN/11822?type=PGN. Signal-level enrichment via PR welcome  see CONTRIBUTING.md.";
CM_ SG_ 2147548036 Operator_Status_RawPayload "Generic 8-byte raw payload. Detail page: https://www.isobus.net/isobus/pGNAndSPN/11826?type=PGN. Signal-level enrichment via PR welcome  see CONTRIBUTING.md.";
CM_ SG_ 2147548037 Engine_Idle_Management_Informati "Generic 8-byte raw payload. Detail page: https://www.isobus.net/isobus/pGNAndSPN/11830?type=PGN. Signal-level enrichment via PR welcome  see CONTRIBUTING.md.";
CM_ SG_ 2147548038 Alcohol_Interlock_To_Vehicle_Raw "Generic 8-byte raw payload. Detail page: https://www.isobus.net/isobus/pGNAndSPN/11831?type=PGN. Signal-level enrichment via PR welcome  see CONTRIBUTING.md.";
CM_ SG_ 2147548039 Vehicle_To_Alcohol_Interlock_Raw "Generic 8-byte raw payload. Detail page: https://www.isobus.net/isobus/pGNAndSPN/11832?type=PGN. Signal-level enrichment via PR welcome  see CONTRIBUTING.md.";
CM_ SG_ 2147548040 Marine_Control_Information_3_Raw "Generic 8-byte raw payload. Detail page: https://www.isobus.net/isobus/pGNAndSPN/11845?type=PGN. Signal-level enrichment via PR welcome  see CONTRIBUTING.md.";
CM_ SG_ 2147548041 Engine_Fluid_Level_Pressure_13_R "Generic 8-byte raw payload. Detail page: https://www.isobus.net/isobus/pGNAndSPN/11852?type=PGN. Signal-level enrichment via PR welcome  see CONTRIBUTING.md.";
CM_ SG_ 2147548042 High_Voltage_Energy_Storage_Syst "Generic 8-byte raw payload. Detail page: https://www.isobus.net/isobus/pGNAndSPN/11857?type=PGN. Signal-level enrichment via PR welcome  see CONTRIBUTING.md.";
CM_ SG_ 2147548043 Economy_Mode_Inactive_Hours_RawP "Generic 8-byte raw payload. Detail page: https://www.isobus.net/isobus/pGNAndSPN/11859?type=PGN. Signal-level enrichment via PR welcome  see CONTRIBUTING.md.";
CM_ SG_ 2147548044 Economy_Mode_Estimated_Instantan "Generic 8-byte raw payload. Detail page: https://www.isobus.net/isobus/pGNAndSPN/11861?type=PGN. Signal-level enrichment via PR welcome  see CONTRIBUTING.md.";
CM_ SG_ 2147548045 Economy_Mode_Active_Hours_RawPay "Generic 8-byte raw payload. Detail page: https://www.isobus.net/isobus/pGNAndSPN/11863?type=PGN. Signal-level enrichment via PR welcome  see CONTRIBUTING.md.";
CM_ SG_ 2147548046 Economy_Mode_Fuel_Used_RawPayloa "Generic 8-byte raw payload. Detail page: https://www.isobus.net/isobus/pGNAndSPN/11865?type=PGN. Signal-level enrichment via PR welcome  see CONTRIBUTING.md.";
CM_ SG_ 2147548047 Economy_Mode_Estimated_Fuel_Savi "Generic 8-byte raw payload. Detail page: https://www.isobus.net/isobus/pGNAndSPN/11867?type=PGN. Signal-level enrichment via PR welcome  see CONTRIBUTING.md.";
CM_ SG_ 2147548048 DC_DC_Converter_4_Voltage_RawPay "Generic 8-byte raw payload. Detail page: https://www.isobus.net/isobus/pGNAndSPN/11869?type=PGN. Signal-level enrichment via PR welcome  see CONTRIBUTING.md.";
CM_ SG_ 2147548049 DC_DC_Converter_3_Voltage_RawPay "Generic 8-byte raw payload. Detail page: https://www.isobus.net/isobus/pGNAndSPN/11871?type=PGN. Signal-level enrichment via PR welcome  see CONTRIBUTING.md.";
CM_ SG_ 2147548050 DC_DC_Converter_2_Voltage_RawPay "Generic 8-byte raw payload. Detail page: https://www.isobus.net/isobus/pGNAndSPN/11873?type=PGN. Signal-level enrichment via PR welcome  see CONTRIBUTING.md.";
CM_ SG_ 2147548051 DC_DC_Converter_1_Voltage_RawPay "Generic 8-byte raw payload. Detail page: https://www.isobus.net/isobus/pGNAndSPN/11875?type=PGN. Signal-level enrichment via PR welcome  see CONTRIBUTING.md.";
CM_ SG_ 2147548052 Electronic_Engine_Controller_22_ "Generic 8-byte raw payload. Detail page: https://www.isobus.net/isobus/pGNAndSPN/11877?type=PGN. Signal-level enrichment via PR welcome  see CONTRIBUTING.md.";
CM_ SG_ 2147548053 Engine_Hours_2_RawPayload "Generic 8-byte raw payload. Detail page: https://www.isobus.net/isobus/pGNAndSPN/11878?type=PGN. Signal-level enrichment via PR welcome  see CONTRIBUTING.md.";
CM_ SG_ 2147548054 Engine_Information_3_RawPayload "Generic 8-byte raw payload. Detail page: https://www.isobus.net/isobus/pGNAndSPN/11881?type=PGN. Signal-level enrichment via PR welcome  see CONTRIBUTING.md.";
CM_ SG_ 2147548055 Vehicle_Electrical_Power_15_RawP "Generic 8-byte raw payload. Detail page: https://www.isobus.net/isobus/pGNAndSPN/11885?type=PGN. Signal-level enrichment via PR welcome  see CONTRIBUTING.md.";
CM_ SG_ 2147548056 Exhaust_Oxygen_2_RawPayload "Generic 8-byte raw payload. Detail page: https://www.isobus.net/isobus/pGNAndSPN/11886?type=PGN. Signal-level enrichment via PR welcome  see CONTRIBUTING.md.";
CM_ SG_ 2147548057 DC_AC_Accessory_Inverter_1_Tempe "Generic 8-byte raw payload. Detail page: https://www.isobus.net/isobus/pGNAndSPN/11891?type=PGN. Signal-level enrichment via PR welcome  see CONTRIBUTING.md.";
CM_ SG_ 2147548058 DC_AC_Accessory_Inverter_1_DC_Si "Generic 8-byte raw payload. Detail page: https://www.isobus.net/isobus/pGNAndSPN/11895?type=PGN. Signal-level enrichment via PR welcome  see CONTRIBUTING.md.";
CM_ SG_ 2147548059 DC_AC_Accessory_Inverter_1_AC_Si "Generic 8-byte raw payload. Detail page: https://www.isobus.net/isobus/pGNAndSPN/11898?type=PGN. Signal-level enrichment via PR welcome  see CONTRIBUTING.md.";
CM_ SG_ 2147548060 DC_AC_Accessory_Inverter_1_Confi "Generic 8-byte raw payload. Detail page: https://www.isobus.net/isobus/pGNAndSPN/11905?type=PGN. Signal-level enrichment via PR welcome  see CONTRIBUTING.md.";
CM_ SG_ 2147548061 DC_AC_Accessory_Inverter_1_Lifet "Generic 8-byte raw payload. Detail page: https://www.isobus.net/isobus/pGNAndSPN/11907?type=PGN. Signal-level enrichment via PR welcome  see CONTRIBUTING.md.";
CM_ SG_ 2147548062 DC_AC_Accessory_Inverter_2_Tempe "Generic 8-byte raw payload. Detail page: https://www.isobus.net/isobus/pGNAndSPN/11912?type=PGN. Signal-level enrichment via PR welcome  see CONTRIBUTING.md.";
CM_ SG_ 2147548063 DC_AC_Accessory_Inverter_2_DC_Si "Generic 8-byte raw payload. Detail page: https://www.isobus.net/isobus/pGNAndSPN/11916?type=PGN. Signal-level enrichment via PR welcome  see CONTRIBUTING.md.";
CM_ SG_ 2147548064 DC_AC_Accessory_Inverter_2_AC_Si "Generic 8-byte raw payload. Detail page: https://www.isobus.net/isobus/pGNAndSPN/11919?type=PGN. Signal-level enrichment via PR welcome  see CONTRIBUTING.md.";
CM_ SG_ 2147548065 DC_AC_Accessory_Inverter_2_Confi "Generic 8-byte raw payload. Detail page: https://www.isobus.net/isobus/pGNAndSPN/11926?type=PGN. Signal-level enrichment via PR welcome  see CONTRIBUTING.md.";
CM_ SG_ 2147548066 DC_AC_Accessory_Inverter_2_Lifet "Generic 8-byte raw payload. Detail page: https://www.isobus.net/isobus/pGNAndSPN/11928?type=PGN. Signal-level enrichment via PR welcome  see CONTRIBUTING.md.";
CM_ SG_ 2147548067 DC_AC_Accessory_Inverter_3_Tempe "Generic 8-byte raw payload. Detail page: https://www.isobus.net/isobus/pGNAndSPN/11933?type=PGN. Signal-level enrichment via PR welcome  see CONTRIBUTING.md.";
CM_ SG_ 2147548068 DC_AC_Accessory_Inverter_3_DC_Si "Generic 8-byte raw payload. Detail page: https://www.isobus.net/isobus/pGNAndSPN/11937?type=PGN. Signal-level enrichment via PR welcome  see CONTRIBUTING.md.";
CM_ SG_ 2147548069 DC_AC_Accessory_Inverter_3_AC_Si "Generic 8-byte raw payload. Detail page: https://www.isobus.net/isobus/pGNAndSPN/11940?type=PGN. Signal-level enrichment via PR welcome  see CONTRIBUTING.md.";
CM_ SG_ 2147548070 DC_AC_Accessory_Inverter_3_Confi "Generic 8-byte raw payload. Detail page: https://www.isobus.net/isobus/pGNAndSPN/11947?type=PGN. Signal-level enrichment via PR welcome  see CONTRIBUTING.md.";
CM_ SG_ 2147548071 DC_AC_Accessory_Inverter_3_Lifet "Generic 8-byte raw payload. Detail page: https://www.isobus.net/isobus/pGNAndSPN/11949?type=PGN. Signal-level enrichment via PR welcome  see CONTRIBUTING.md.";
CM_ SG_ 2147548072 DC_AC_Accessory_Inverter_4_Tempe "Generic 8-byte raw payload. Detail page: https://www.isobus.net/isobus/pGNAndSPN/11954?type=PGN. Signal-level enrichment via PR welcome  see CONTRIBUTING.md.";
CM_ SG_ 2147548073 DC_AC_Accessory_Inverter_4_DC_Si "Generic 8-byte raw payload. Detail page: https://www.isobus.net/isobus/pGNAndSPN/11958?type=PGN. Signal-level enrichment via PR welcome  see CONTRIBUTING.md.";
CM_ SG_ 2147548074 DC_AC_Accessory_Inverter_4_AC_Si "Generic 8-byte raw payload. Detail page: https://www.isobus.net/isobus/pGNAndSPN/11961?type=PGN. Signal-level enrichment via PR welcome  see CONTRIBUTING.md.";
CM_ SG_ 2147548075 DC_AC_Accessory_Inverter_4_Confi "Generic 8-byte raw payload. Detail page: https://www.isobus.net/isobus/pGNAndSPN/11968?type=PGN. Signal-level enrichment via PR welcome  see CONTRIBUTING.md.";
CM_ SG_ 2147548076 DC_AC_Accessory_Inverter_4_Lifet "Generic 8-byte raw payload. Detail page: https://www.isobus.net/isobus/pGNAndSPN/11970?type=PGN. Signal-level enrichment via PR welcome  see CONTRIBUTING.md.";
CM_ SG_ 2147548077 DC_AC_Accessory_Inverter_5_Tempe "Generic 8-byte raw payload. Detail page: https://www.isobus.net/isobus/pGNAndSPN/11975?type=PGN. Signal-level enrichment via PR welcome  see CONTRIBUTING.md.";
CM_ SG_ 2147548078 DC_AC_Accessory_Inverter_5_DC_Si "Generic 8-byte raw payload. Detail page: https://www.isobus.net/isobus/pGNAndSPN/11979?type=PGN. Signal-level enrichment via PR welcome  see CONTRIBUTING.md.";
CM_ SG_ 2147548079 DC_AC_Accessory_Inverter_5_AC_Si "Generic 8-byte raw payload. Detail page: https://www.isobus.net/isobus/pGNAndSPN/11982?type=PGN. Signal-level enrichment via PR welcome  see CONTRIBUTING.md.";
CM_ SG_ 2147548080 DC_AC_Accessory_Inverter_5_Confi "Generic 8-byte raw payload. Detail page: https://www.isobus.net/isobus/pGNAndSPN/11989?type=PGN. Signal-level enrichment via PR welcome  see CONTRIBUTING.md.";
CM_ SG_ 2147548081 DC_AC_Accessory_Inverter_5_Lifet "Generic 8-byte raw payload. Detail page: https://www.isobus.net/isobus/pGNAndSPN/11991?type=PGN. Signal-level enrichment via PR welcome  see CONTRIBUTING.md.";
CM_ SG_ 2147548082 Well_Stimulation_Pump_Sensor_Cal "Generic 8-byte raw payload. Detail page: https://www.isobus.net/isobus/pGNAndSPN/11995?type=PGN. Signal-level enrichment via PR welcome  see CONTRIBUTING.md.";
CM_ SG_ 2147548083 Well_Stimulation_Pump_Fluid_Volu "Generic 8-byte raw payload. Detail page: https://www.isobus.net/isobus/pGNAndSPN/11997?type=PGN. Signal-level enrichment via PR welcome  see CONTRIBUTING.md.";
CM_ SG_ 2147548084 Well_Stimulation_Pump_Serial_Num "Generic 8-byte raw payload. Detail page: https://www.isobus.net/isobus/pGNAndSPN/11999?type=PGN. Signal-level enrichment via PR welcome  see CONTRIBUTING.md.";
CM_ SG_ 2147548085 Well_Stimulation_Pump_Trip_Hours "Generic 8-byte raw payload. Detail page: https://www.isobus.net/isobus/pGNAndSPN/12001?type=PGN. Signal-level enrichment via PR welcome  see CONTRIBUTING.md.";
CM_ SG_ 2147548086 Aftertreatment_1_Outlet_Gas_4_Ra "Generic 8-byte raw payload. Detail page: https://www.isobus.net/isobus/pGNAndSPN/12003?type=PGN. Signal-level enrichment via PR welcome  see CONTRIBUTING.md.";
CM_ SG_ 2147548087 Aftertreatment_1_Intake_Gas_4_Ra "Generic 8-byte raw payload. Detail page: https://www.isobus.net/isobus/pGNAndSPN/12005?type=PGN. Signal-level enrichment via PR welcome  see CONTRIBUTING.md.";
CM_ SG_ 2147548088 DC_DC_Converter_4_Lifetime_Data_ "Generic 8-byte raw payload. Detail page: https://www.isobus.net/isobus/pGNAndSPN/12009?type=PGN. Signal-level enrichment via PR welcome  see CONTRIBUTING.md.";
CM_ SG_ 2147548089 DC_DC_Converter_4_Configuration_ "Generic 8-byte raw payload. Detail page: https://www.isobus.net/isobus/pGNAndSPN/12021?type=PGN. Signal-level enrichment via PR welcome  see CONTRIBUTING.md.";
CM_ SG_ 2147548090 DC_DC_Converter_4_SLI_Battery_Li "Generic 8-byte raw payload. Detail page: https://www.isobus.net/isobus/pGNAndSPN/12024?type=PGN. Signal-level enrichment via PR welcome  see CONTRIBUTING.md.";
CM_ SG_ 2147548091 DC_DC_Converter_4_Temperatures_R "Generic 8-byte raw payload. Detail page: https://www.isobus.net/isobus/pGNAndSPN/12029?type=PGN. Signal-level enrichment via PR welcome  see CONTRIBUTING.md.";
CM_ SG_ 2147548092 DC_DC_Converter_4_Low_Side_Limit "Generic 8-byte raw payload. Detail page: https://www.isobus.net/isobus/pGNAndSPN/12033?type=PGN. Signal-level enrichment via PR welcome  see CONTRIBUTING.md.";
CM_ SG_ 2147548093 DC_DC_Converter_4_High_Side_Limi "Generic 8-byte raw payload. Detail page: https://www.isobus.net/isobus/pGNAndSPN/12037?type=PGN. Signal-level enrichment via PR welcome  see CONTRIBUTING.md.";
CM_ SG_ 2147548094 DC_DC_Converter_3_Lifetime_Data_ "Generic 8-byte raw payload. Detail page: https://www.isobus.net/isobus/pGNAndSPN/12041?type=PGN. Signal-level enrichment via PR welcome  see CONTRIBUTING.md.";
CM_ SG_ 2147548095 DC_DC_Converter_3_Configuration_ "Generic 8-byte raw payload. Detail page: https://www.isobus.net/isobus/pGNAndSPN/12053?type=PGN. Signal-level enrichment via PR welcome  see CONTRIBUTING.md.";
CM_ SG_ 2147548096 DC_DC_Converter_3_SLI_Battery_Li "Generic 8-byte raw payload. Detail page: https://www.isobus.net/isobus/pGNAndSPN/12056?type=PGN. Signal-level enrichment via PR welcome  see CONTRIBUTING.md.";
CM_ SG_ 2147548097 DC_DC_Converter_3_Temperatures_R "Generic 8-byte raw payload. Detail page: https://www.isobus.net/isobus/pGNAndSPN/12061?type=PGN. Signal-level enrichment via PR welcome  see CONTRIBUTING.md.";
CM_ SG_ 2147548098 DC_DC_Converter_3_Low_Side_Limit "Generic 8-byte raw payload. Detail page: https://www.isobus.net/isobus/pGNAndSPN/12065?type=PGN. Signal-level enrichment via PR welcome  see CONTRIBUTING.md.";
CM_ SG_ 2147548099 DC_DC_Converter_3_High_Side_Limi "Generic 8-byte raw payload. Detail page: https://www.isobus.net/isobus/pGNAndSPN/12069?type=PGN. Signal-level enrichment via PR welcome  see CONTRIBUTING.md.";
CM_ SG_ 2147548100 DC_DC_Converter_2_Lifetime_Data_ "Generic 8-byte raw payload. Detail page: https://www.isobus.net/isobus/pGNAndSPN/12073?type=PGN. Signal-level enrichment via PR welcome  see CONTRIBUTING.md.";
CM_ SG_ 2147548101 DC_DC_Converter_2_Configuration_ "Generic 8-byte raw payload. Detail page: https://www.isobus.net/isobus/pGNAndSPN/12085?type=PGN. Signal-level enrichment via PR welcome  see CONTRIBUTING.md.";
CM_ SG_ 2147548102 DC_DC_Converter_2_SLI_Battery_Li "Generic 8-byte raw payload. Detail page: https://www.isobus.net/isobus/pGNAndSPN/12088?type=PGN. Signal-level enrichment via PR welcome  see CONTRIBUTING.md.";
CM_ SG_ 2147548103 DC_DC_Converter_2_Temperatures_R "Generic 8-byte raw payload. Detail page: https://www.isobus.net/isobus/pGNAndSPN/12093?type=PGN. Signal-level enrichment via PR welcome  see CONTRIBUTING.md.";
CM_ SG_ 2147548104 DC_DC_Converter_2_Low_Side_Limit "Generic 8-byte raw payload. Detail page: https://www.isobus.net/isobus/pGNAndSPN/12097?type=PGN. Signal-level enrichment via PR welcome  see CONTRIBUTING.md.";
CM_ SG_ 2147548105 DC_DC_Converter_2_High_Side_Limi "Generic 8-byte raw payload. Detail page: https://www.isobus.net/isobus/pGNAndSPN/12101?type=PGN. Signal-level enrichment via PR welcome  see CONTRIBUTING.md.";
CM_ SG_ 2147548106 CiA_602_2_AUTOSAR_CAN_NM_Obsolet "Generic 8-byte raw payload. Detail page: https://www.isobus.net/isobus/pGNAndSPN/12102?type=PGN. Signal-level enrichment via PR welcome  see CONTRIBUTING.md.";

BA_DEF_ BO_ "SystemMessageLongSymbol" STRING;
BA_DEF_ SG_ "SystemSignalLongSymbol" STRING;
BA_ "SystemMessageLongSymbol" BO_ 2147547826 "VDMA_FAB2_High_Voltage_Energy_Storage_Pack";
BA_ "SystemMessageLongSymbol" BO_ 2147547827 "VDMA_FAB3_AUTOSAR_Time_Synchronization";
BA_ "SystemMessageLongSymbol" BO_ 2147547828 "VDMA_FAB4_EV_DC_Charging_Limits_1";
BA_ "SystemMessageLongSymbol" BO_ 2147547829 "VDMA_FAB5_EVSE_DC_Charging_Limits_1";
BA_ "SystemMessageLongSymbol" BO_ 2147547830 "VDMA_FAB6_EVSE_DC_Charging_Limits_2";
BA_ "SystemMessageLongSymbol" BO_ 2147547834 "VDMA_FABA_EVSE_1_Contactor_Status_1";
BA_ "SystemMessageLongSymbol" BO_ 2147547835 "VDMA_FABB_Direct_Lamp_Control_Command_3";
BA_ "SystemMessageLongSymbol" BO_ 2147547836 "VDMA_FABC_Direct_Lamp_Control_Data_3";
BA_ "SystemMessageLongSymbol" BO_ 2147547837 "VDMA_FABD_Motor_Generator_1_Lifetime_Data";
BA_ "SystemMessageLongSymbol" BO_ 2147547838 "VDMA_FABE_Motor_Generator_2_Lifetime_Data";
BA_ "SystemMessageLongSymbol" BO_ 2147547839 "VDMA_FABF_Motor_Generator_3_Lifetime_Data";
BA_ "SystemMessageLongSymbol" BO_ 2147547840 "VDMA_FAC0_Motor_Generator_4_Lifetime_Data";
BA_ "SystemMessageLongSymbol" BO_ 2147547841 "VDMA_FAC1_Motor_Generator_5_Lifetime_Data";
BA_ "SystemMessageLongSymbol" BO_ 2147547842 "VDMA_FAC2_Motor_Generator_6_Lifetime_Data";
BA_ "SystemMessageLongSymbol" BO_ 2147547846 "VDMA_FAC6_Electronic_Retarder_Controller_3";
BA_ "SystemMessageLongSymbol" BO_ 2147547848 "VDMA_FAC8_Electronic_Transmission_Controll";
BA_ "SystemMessageLongSymbol" BO_ 2147547851 "VDMA_FACB_Collision_Avoidance_System_4";
BA_ "SystemMessageLongSymbol" BO_ 2147547852 "VDMA_FACC_Collision_Avoidance_System_3";
BA_ "SystemMessageLongSymbol" BO_ 2147547853 "VDMA_FACD_Aftertreatment_1_SCR_Exhaust_Gas";
BA_ "SystemMessageLongSymbol" BO_ 2147547857 "VDMA_FAD1_Engine_Average_Information_2";
BA_ "SystemMessageLongSymbol" BO_ 2147547858 "VDMA_FAD2_Turbocharger_Information_9";
BA_ "SystemMessageLongSymbol" BO_ 2147547859 "VDMA_FAD3_Automated_Driving_System_Control";
BA_ "SystemMessageLongSymbol" BO_ 2147547863 "VDMA_FAD7_Object_Detection_Message_1_1";
BA_ "SystemMessageLongSymbol" BO_ 2147547864 "VDMA_FAD8_Object_Detection_Message_2_1";
BA_ "SystemMessageLongSymbol" BO_ 2147547865 "VDMA_FAD9_Object_Detection_Message_2_2";
BA_ "SystemMessageLongSymbol" BO_ 2147547866 "VDMA_FADA_Object_Detection_Message_2_3";
BA_ "SystemMessageLongSymbol" BO_ 2147547867 "VDMA_FADB_Object_Detection_Message_2_4";
BA_ "SystemMessageLongSymbol" BO_ 2147547868 "VDMA_FADC_Object_Detection_Message_2_5";
BA_ "SystemMessageLongSymbol" BO_ 2147547869 "VDMA_FADD_Object_Detection_Message_2_6";
BA_ "SystemMessageLongSymbol" BO_ 2147547870 "VDMA_FADE_Object_Detection_Message_2_7";
BA_ "SystemMessageLongSymbol" BO_ 2147547871 "VDMA_FADF_Object_Detection_Message_2_8";
BA_ "SystemMessageLongSymbol" BO_ 2147547872 "VDMA_FAE0_Object_Detection_Message_2_9";
BA_ "SystemMessageLongSymbol" BO_ 2147547873 "VDMA_FAE1_Object_Detection_Message_2_10";
BA_ "SystemMessageLongSymbol" BO_ 2147547874 "VDMA_FAE2_Object_Detection_Message_2_11";
BA_ "SystemMessageLongSymbol" BO_ 2147547875 "VDMA_FAE3_Object_Detection_Message_2_12";
BA_ "SystemMessageLongSymbol" BO_ 2147547876 "VDMA_FAE4_Object_Detection_Message_2_13";
BA_ "SystemMessageLongSymbol" BO_ 2147547877 "VDMA_FAE5_Object_Detection_Message_2_14";
BA_ "SystemMessageLongSymbol" BO_ 2147547878 "VDMA_FAE6_Object_Detection_Message_2_15";
BA_ "SystemMessageLongSymbol" BO_ 2147547879 "VDMA_FAE7_Object_Detection_Message_2_16";
BA_ "SystemMessageLongSymbol" BO_ 2147547880 "VDMA_FAE8_Object_Detection_Message_2_17";
BA_ "SystemMessageLongSymbol" BO_ 2147547881 "VDMA_FAE9_Object_Detection_Message_2_18";
BA_ "SystemMessageLongSymbol" BO_ 2147547882 "VDMA_FAEA_Object_Detection_Message_2_19";
BA_ "SystemMessageLongSymbol" BO_ 2147547883 "VDMA_FAEB_Object_Detection_Message_2_20";
BA_ "SystemMessageLongSymbol" BO_ 2147547884 "VDMA_FAEC_Object_Detection_Message_2_21";
BA_ "SystemMessageLongSymbol" BO_ 2147547885 "VDMA_FAED_Temperature_Sensing_Module_1";
BA_ "SystemMessageLongSymbol" BO_ 2147547886 "VDMA_FAEE_Temperature_Sensing_Module_2";
BA_ "SystemMessageLongSymbol" BO_ 2147547887 "VDMA_FAEF_Aftertreatment_2_SCR_Service_Inf";
BA_ "SystemMessageLongSymbol" BO_ 2147547888 "VDMA_FAF0_Aftertreatment_1_SCR_Service_Inf";
BA_ "SystemMessageLongSymbol" BO_ 2147547889 "VDMA_FAF1_PSA_Times_Lifetime_Hours";
BA_ "SystemMessageLongSymbol" BO_ 2147547890 "VDMA_FAF2_PSA_Times_Stored_100_Hours";
BA_ "SystemMessageLongSymbol" BO_ 2147547891 "VDMA_FAF3_PSA_Times_Active_100_Hours";
BA_ "SystemMessageLongSymbol" BO_ 2147547892 "VDMA_FAF4_Hybrid_Charge_Depleting_or_Incre";
BA_ "SystemMessageLongSymbol" BO_ 2147547893 "VDMA_FAF5_Hybrid_Charge_Depleting_or_Incre";
BA_ "SystemMessageLongSymbol" BO_ 2147547894 "VDMA_FAF6_Hybrid_Charge_Depleting_or_Incre";
BA_ "SystemMessageLongSymbol" BO_ 2147547895 "VDMA_FAF7_Aftertreatment_1_Historical_Info";
BA_ "SystemMessageLongSymbol" BO_ 2147547896 "VDMA_FAF8_Engine_Maximum_Net_Torque_Map";
BA_ "SystemMessageLongSymbol" BO_ 2147547897 "VDMA_FAF9_Aftertreatment_1_SCR_2_NOx_Mass_";
BA_ "SystemMessageLongSymbol" BO_ 2147547898 "VDMA_FAFA_Aftertreatment_1_SCR_1_NOx_Mass_";
BA_ "SystemMessageLongSymbol" BO_ 2147547899 "VDMA_FAFB_Evaporative_System_Pressure_and_";
BA_ "SystemMessageLongSymbol" BO_ 2147547900 "VDMA_FAFC_GHG_Tracking_Lifetime_Array_Data";
BA_ "SystemMessageLongSymbol" BO_ 2147547901 "VDMA_FAFD_GHG_Tracking_Stored_100_Hour_Arr";
BA_ "SystemMessageLongSymbol" BO_ 2147547902 "VDMA_FAFE_GHG_Tracking_Active_100_Hour_Arr";
BA_ "SystemMessageLongSymbol" BO_ 2147547903 "VDMA_FAFF_Green_House_Gas_Stored_100_Hour_";
BA_ "SystemMessageLongSymbol" BO_ 2147547904 "VDMA_FB00_Green_House_Gas_Active_100_Hour_";
BA_ "SystemMessageLongSymbol" BO_ 2147547905 "VDMA_FB01_Green_House_Gas_Lifetime_Active_";
BA_ "SystemMessageLongSymbol" BO_ 2147547906 "VDMA_FB02_NOx_Tracking_Engine_Activity_Lif";
BA_ "SystemMessageLongSymbol" BO_ 2147547907 "VDMA_FB03_NOx_Tracking_Engine_Activity_Lif";
BA_ "SystemMessageLongSymbol" BO_ 2147547908 "VDMA_FB04_NOx_Tracking_Engine_Activity_Lif";
BA_ "SystemMessageLongSymbol" BO_ 2147547909 "VDMA_FB05_NOx_Tracking_Engine_Activity_Lif";
BA_ "SystemMessageLongSymbol" BO_ 2147547910 "VDMA_FB06_NOx_Tracking_Valid_NOx_Lifetime_";
BA_ "SystemMessageLongSymbol" BO_ 2147547911 "VDMA_FB07_NOx_Tracking_Valid_NOx_Lifetime_";
BA_ "SystemMessageLongSymbol" BO_ 2147547912 "VDMA_FB08_NOx_Tracking_Valid_NOx_Lifetime_";
BA_ "SystemMessageLongSymbol" BO_ 2147547913 "VDMA_FB09_NOx_Tracking_Valid_NOx_Lifetime_";
BA_ "SystemMessageLongSymbol" BO_ 2147547914 "VDMA_FB0A_NOx_Tracking_Valid_NOx_Lifetime_";
BA_ "SystemMessageLongSymbol" BO_ 2147547915 "VDMA_FB0B_NOx_Tracking_Valid_NOx_Lifetime_";
BA_ "SystemMessageLongSymbol" BO_ 2147547916 "VDMA_FB0C_NOx_Tracking_Stored_100_Hour_Fue";
BA_ "SystemMessageLongSymbol" BO_ 2147547917 "VDMA_FB0D_NOx_Tracking_Stored_100_Hour_Eng";
BA_ "SystemMessageLongSymbol" BO_ 2147547918 "VDMA_FB0E_NOx_Tracking_Stored_100_Hour_Veh";
BA_ "SystemMessageLongSymbol" BO_ 2147547919 "VDMA_FB0F_NOx_Tracking_Stored_100_Hour_Eng";
BA_ "SystemMessageLongSymbol" BO_ 2147547920 "VDMA_FB10_NOx_Tracking_Stored_100_Hour_Eng";
BA_ "SystemMessageLongSymbol" BO_ 2147547921 "VDMA_FB11_NOx_Tracking_Stored_100_Hour_Sys";
BA_ "SystemMessageLongSymbol" BO_ 2147547922 "VDMA_FB12_NOx_Tracking_Active_100_Hour_Fue";
BA_ "SystemMessageLongSymbol" BO_ 2147547923 "VDMA_FB13_NOx_Tracking_Active_100_Hour_Eng";
BA_ "SystemMessageLongSymbol" BO_ 2147547924 "VDMA_FB14_NOx_Tracking_Active_100_Hour_Veh";
BA_ "SystemMessageLongSymbol" BO_ 2147547925 "VDMA_FB15_NOx_Tracking_Active_100_Hour_Eng";
BA_ "SystemMessageLongSymbol" BO_ 2147547926 "VDMA_FB16_NOx_Tracking_Active_100_Hour_Eng";
BA_ "SystemMessageLongSymbol" BO_ 2147547927 "VDMA_FB17_NOx_Tracking_Active_100_Hour_Sys";
BA_ "SystemMessageLongSymbol" BO_ 2147547928 "VDMA_FB18_Motor_Generator_6_Inverter_Contr";
BA_ "SystemMessageLongSymbol" BO_ 2147547929 "VDMA_FB19_Motor_Generator_6_Inverter_Limit";
BA_ "SystemMessageLongSymbol" BO_ 2147547930 "VDMA_FB1A_Motor_Generator_6_Inverter_Limit";
BA_ "SystemMessageLongSymbol" BO_ 2147547931 "VDMA_FB1B_Motor_Generator_6_Inverter_Limit";
BA_ "SystemMessageLongSymbol" BO_ 2147547932 "VDMA_FB1C_Motor_Generator_6_Inverter_Isola";
BA_ "SystemMessageLongSymbol" BO_ 2147547933 "VDMA_FB1D_Motor_Generator_5_Inverter_Contr";
BA_ "SystemMessageLongSymbol" BO_ 2147547934 "VDMA_FB1E_Motor_Generator_5_Inverter_Limit";
BA_ "SystemMessageLongSymbol" BO_ 2147547935 "VDMA_FB1F_Motor_Generator_5_Inverter_Limit";
BA_ "SystemMessageLongSymbol" BO_ 2147547936 "VDMA_FB20_Motor_Generator_5_Inverter_Limit";
BA_ "SystemMessageLongSymbol" BO_ 2147547937 "VDMA_FB21_Motor_Generator_5_Inverter_Isola";
BA_ "SystemMessageLongSymbol" BO_ 2147547938 "VDMA_FB22_Motor_Generator_4_Inverter_Contr";
BA_ "SystemMessageLongSymbol" BO_ 2147547939 "VDMA_FB23_Motor_Generator_4_Inverter_Limit";
BA_ "SystemMessageLongSymbol" BO_ 2147547940 "VDMA_FB24_Motor_Generator_4_Inverter_Limit";
BA_ "SystemMessageLongSymbol" BO_ 2147547941 "VDMA_FB25_Motor_Generator_4_Inverter_Limit";
BA_ "SystemMessageLongSymbol" BO_ 2147547942 "VDMA_FB26_Motor_Generator_4_Inverter_Isola";
BA_ "SystemMessageLongSymbol" BO_ 2147547943 "VDMA_FB27_Motor_Generator_3_Inverter_Contr";
BA_ "SystemMessageLongSymbol" BO_ 2147547944 "VDMA_FB28_Motor_Generator_3_Inverter_Limit";
BA_ "SystemMessageLongSymbol" BO_ 2147547945 "VDMA_FB29_Motor_Generator_3_Inverter_Limit";
BA_ "SystemMessageLongSymbol" BO_ 2147547946 "VDMA_FB2A_Motor_Generator_3_Inverter_Limit";
BA_ "SystemMessageLongSymbol" BO_ 2147547947 "VDMA_FB2B_Motor_Generator_3_Inverter_Isola";
BA_ "SystemMessageLongSymbol" BO_ 2147547949 "VDMA_FB2D_Turbocharger_Information_8";
BA_ "SystemMessageLongSymbol" BO_ 2147547951 "VDMA_FB2F_Motor_Generator_6_Inverter_Refer";
BA_ "SystemMessageLongSymbol" BO_ 2147547952 "VDMA_FB30_Motor_Generator_6_Inverter_Statu";
BA_ "SystemMessageLongSymbol" BO_ 2147547953 "VDMA_FB31_Motor_Generator_6_Inverter_Refer";
BA_ "SystemMessageLongSymbol" BO_ 2147547954 "VDMA_FB32_Motor_Generator_6_Inverter_Tempe";
BA_ "SystemMessageLongSymbol" BO_ 2147547955 "VDMA_FB33_Motor_Generator_6_Inverter_Motor";
BA_ "SystemMessageLongSymbol" BO_ 2147547956 "VDMA_FB34_Motor_Generator_6_Inverter_Isola";
BA_ "SystemMessageLongSymbol" BO_ 2147547957 "VDMA_FB35_Motor_Generator_6_Inverter_Activ";
BA_ "SystemMessageLongSymbol" BO_ 2147547958 "VDMA_FB36_Motor_Generator_5_Inverter_Refer";
BA_ "SystemMessageLongSymbol" BO_ 2147547959 "VDMA_FB37_Motor_Generator_5_Inverter_Statu";
BA_ "SystemMessageLongSymbol" BO_ 2147547960 "VDMA_FB38_Motor_Generator_5_Inverter_Refer";
BA_ "SystemMessageLongSymbol" BO_ 2147547961 "VDMA_FB39_Motor_Generator_5_Inverter_Tempe";
BA_ "SystemMessageLongSymbol" BO_ 2147547962 "VDMA_FB3A_Motor_Generator_5_Inverter_Motor";
BA_ "SystemMessageLongSymbol" BO_ 2147547963 "VDMA_FB3B_Motor_Generator_5_Inverter_Isola";
BA_ "SystemMessageLongSymbol" BO_ 2147547964 "VDMA_FB3C_Motor_Generator_5_Inverter_Activ";
BA_ "SystemMessageLongSymbol" BO_ 2147547965 "VDMA_FB3D_Motor_Generator_4_Inverter_Refer";
BA_ "SystemMessageLongSymbol" BO_ 2147547966 "VDMA_FB3E_Motor_Generator_4_Inverter_Statu";
BA_ "SystemMessageLongSymbol" BO_ 2147547967 "VDMA_FB3F_Motor_Generator_4_Inverter_Refer";
BA_ "SystemMessageLongSymbol" BO_ 2147547968 "VDMA_FB40_Motor_Generator_4_Inverter_Tempe";
BA_ "SystemMessageLongSymbol" BO_ 2147547969 "VDMA_FB41_Motor_Generator_4_Inverter_Motor";
BA_ "SystemMessageLongSymbol" BO_ 2147547970 "VDMA_FB42_Motor_Generator_4_Inverter_Isola";
BA_ "SystemMessageLongSymbol" BO_ 2147547971 "VDMA_FB43_Motor_Generator_4_Inverter_Activ";
BA_ "SystemMessageLongSymbol" BO_ 2147547972 "VDMA_FB44_Motor_Generator_3_Inverter_Refer";
BA_ "SystemMessageLongSymbol" BO_ 2147547973 "VDMA_FB45_Motor_Generator_3_Inverter_Statu";
BA_ "SystemMessageLongSymbol" BO_ 2147547974 "VDMA_FB46_Motor_Generator_3_Inverter_Refer";
BA_ "SystemMessageLongSymbol" BO_ 2147547975 "VDMA_FB47_Motor_Generator_3_Inverter_Tempe";
BA_ "SystemMessageLongSymbol" BO_ 2147547976 "VDMA_FB48_Motor_Generator_3_Inverter_Motor";
BA_ "SystemMessageLongSymbol" BO_ 2147547977 "VDMA_FB49_Motor_Generator_3_Inverter_Isola";
BA_ "SystemMessageLongSymbol" BO_ 2147547978 "VDMA_FB4A_Motor_Generator_3_Inverter_Activ";
BA_ "SystemMessageLongSymbol" BO_ 2147547979 "VDMA_FB4B_Automated_Driving_System_Status_";
BA_ "SystemMessageLongSymbol" BO_ 2147547980 "VDMA_FB4C_Cab_Climate_System_Information_2";
BA_ "SystemMessageLongSymbol" BO_ 2147547981 "VDMA_FB4D_Maintenance_Information_1";
BA_ "SystemMessageLongSymbol" BO_ 2147547982 "VDMA_FB4E_Hoist_Control_Information";
BA_ "SystemMessageLongSymbol" BO_ 2147547983 "VDMA_FB4F_High_Voltage_Energy_Storage_Pack";
BA_ "SystemMessageLongSymbol" BO_ 2147547984 "VDMA_FB50_High_Voltage_Energy_Storage_Pack";
BA_ "SystemMessageLongSymbol" BO_ 2147547985 "VDMA_FB51_High_Voltage_Energy_Storage_Pack";
BA_ "SystemMessageLongSymbol" BO_ 2147547986 "VDMA_FB52_High_Voltage_Energy_Storage_Pack";
BA_ "SystemMessageLongSymbol" BO_ 2147547987 "VDMA_FB53_High_Voltage_Energy_Storage_Pack";
BA_ "SystemMessageLongSymbol" BO_ 2147547988 "VDMA_FB54_High_Voltage_Energy_Storage_Pack";
BA_ "SystemMessageLongSymbol" BO_ 2147547989 "VDMA_FB55_High_Voltage_Energy_Storage_Pack";
BA_ "SystemMessageLongSymbol" BO_ 2147547990 "VDMA_FB56_High_Voltage_Energy_Storage_Pack";
BA_ "SystemMessageLongSymbol" BO_ 2147547991 "VDMA_FB57_High_Voltage_Energy_Storage_Pack";
BA_ "SystemMessageLongSymbol" BO_ 2147547992 "VDMA_FB58_High_Voltage_Energy_Storage_Pack";
BA_ "SystemMessageLongSymbol" BO_ 2147547993 "VDMA_FB59_High_Voltage_Energy_Storage_Pack";
BA_ "SystemMessageLongSymbol" BO_ 2147547994 "VDMA_FB5A_High_Voltage_Energy_Storage_Pack";
BA_ "SystemMessageLongSymbol" BO_ 2147547995 "VDMA_FB5B_Vehicle_Fire_Suppression_System_";
BA_ "SystemMessageLongSymbol" BO_ 2147547996 "VDMA_FB5C_Vehicle_Fire_Suppression_System_";
BA_ "SystemMessageLongSymbol" BO_ 2147547997 "VDMA_FB5D_Vehicle_Fire_Suppression_System_";
BA_ "SystemMessageLongSymbol" BO_ 2147547998 "VDMA_FB5E_Vehicle_Fire_Suppression_System_";
BA_ "SystemMessageLongSymbol" BO_ 2147547999 "VDMA_FB5F_Vehicle_Fire_Suppression_System_";
BA_ "SystemMessageLongSymbol" BO_ 2147548000 "VDMA_FB60_Vehicle_Fire_Suppression_System_";
BA_ "SystemMessageLongSymbol" BO_ 2147548001 "VDMA_FB61_Vehicle_Fire_Suppression_System_";
BA_ "SystemMessageLongSymbol" BO_ 2147548002 "VDMA_FB62_Vehicle_Fire_Suppression_System_";
BA_ "SystemMessageLongSymbol" BO_ 2147548003 "VDMA_FB63_Vehicle_Fire_Suppression_System_";
BA_ "SystemMessageLongSymbol" BO_ 2147548004 "VDMA_FB64_Vehicle_Fire_Suppression_System_";
BA_ "SystemMessageLongSymbol" BO_ 2147548005 "VDMA_FB65_Vehicle_Fire_Suppression_System_";
BA_ "SystemMessageLongSymbol" BO_ 2147548006 "VDMA_FB66_Vehicle_Fire_Suppression_System_";
BA_ "SystemMessageLongSymbol" BO_ 2147548007 "VDMA_FB67_Motor_Generator_2_Inverter_Activ";
BA_ "SystemMessageLongSymbol" BO_ 2147548008 "VDMA_FB68_Motor_Generator_2_Inverter_Isola";
BA_ "SystemMessageLongSymbol" BO_ 2147548009 "VDMA_FB69_Motor_Generator_1_Inverter_Activ";
BA_ "SystemMessageLongSymbol" BO_ 2147548010 "VDMA_FB6A_Motor_Generator_1_Inverter_Isola";
BA_ "SystemMessageLongSymbol" BO_ 2147548011 "VDMA_FB6B_High_Voltage_Bus_Information";
BA_ "SystemMessageLongSymbol" BO_ 2147548012 "VDMA_FB6C_Motor_Generator_2_Inverter_Refer";
BA_ "SystemMessageLongSymbol" BO_ 2147548013 "VDMA_FB6D_Motor_Generator_2_Inverter_Statu";
BA_ "SystemMessageLongSymbol" BO_ 2147548014 "VDMA_FB6E_Motor_Generator_2_Inverter_Refer";
BA_ "SystemMessageLongSymbol" BO_ 2147548015 "VDMA_FB6F_Motor_Generator_2_Inverter_Tempe";
BA_ "SystemMessageLongSymbol" BO_ 2147548016 "VDMA_FB70_Motor_Generator_2_Inverter_Motor";
BA_ "SystemMessageLongSymbol" BO_ 2147548017 "VDMA_FB71_Motor_Generator_1_Inverter_Motor";
BA_ "SystemMessageLongSymbol" BO_ 2147548018 "VDMA_FB72_Motor_Generator_1_Inverter_Tempe";
BA_ "SystemMessageLongSymbol" BO_ 2147548019 "VDMA_FB73_Motor_Generator_1_Inverter_Refer";
BA_ "SystemMessageLongSymbol" BO_ 2147548020 "VDMA_FB74_Motor_Generator_1_Inverter_Statu";
BA_ "SystemMessageLongSymbol" BO_ 2147548021 "VDMA_FB75_Motor_Generator_1_Inverter_Refer";
BA_ "SystemMessageLongSymbol" BO_ 2147548022 "VDMA_FB76_Personnel_Detect_Status";
BA_ "SystemMessageLongSymbol" BO_ 2147548023 "VDMA_FB77_Engine_Cylinder_Pressure_Gamma_1";
BA_ "SystemMessageLongSymbol" BO_ 2147548024 "VDMA_FB78_Engine_Cylinder_Pressure_Gamma_2";
BA_ "SystemMessageLongSymbol" BO_ 2147548025 "VDMA_FB79_Engine_Cylinder_Pressure_Gamma_3";
BA_ "SystemMessageLongSymbol" BO_ 2147548026 "VDMA_FB7A_Engine_Cylinder_Pressure_Gamma_4";
BA_ "SystemMessageLongSymbol" BO_ 2147548027 "VDMA_FB7B_Engine_Cylinder_Pressure_Gamma_5";
BA_ "SystemMessageLongSymbol" BO_ 2147548029 "VDMA_FB7D_Electrified_Accessory_Generator_";
BA_ "SystemMessageLongSymbol" BO_ 2147548030 "VDMA_FB7E_Electrified_Accessory_Generator_";
BA_ "SystemMessageLongSymbol" BO_ 2147548031 "VDMA_FB7F_Well_Stimulation_Pump_System_Fil";
BA_ "SystemMessageLongSymbol" BO_ 2147548032 "VDMA_FB80_PTO_Governor_Configuration";
BA_ "SystemMessageLongSymbol" BO_ 2147548034 "VDMA_FB82_Primary_or_Rear_Hitch_Yaw";
BA_ "SystemMessageLongSymbol" BO_ 2147548035 "VDMA_FB83_Secondary_or_Front_Hitch_Yaw";
BA_ "SystemMessageLongSymbol" BO_ 2147548037 "VDMA_FB85_Engine_Idle_Management_Informati";
BA_ "SystemMessageLongSymbol" BO_ 2147548038 "VDMA_FB86_Alcohol_Interlock_To_Vehicle";
BA_ "SystemMessageLongSymbol" BO_ 2147548039 "VDMA_FB87_Vehicle_To_Alcohol_Interlock";
BA_ "SystemMessageLongSymbol" BO_ 2147548040 "VDMA_FB88_Marine_Control_Information_3";
BA_ "SystemMessageLongSymbol" BO_ 2147548041 "VDMA_FB89_Engine_Fluid_Level_Pressure_13";
BA_ "SystemMessageLongSymbol" BO_ 2147548042 "VDMA_FB8A_High_Voltage_Energy_Storage_Syst";
BA_ "SystemMessageLongSymbol" BO_ 2147548043 "VDMA_FB8B_Economy_Mode_Inactive_Hours";
BA_ "SystemMessageLongSymbol" BO_ 2147548044 "VDMA_FB8C_Economy_Mode_Estimated_Instantan";
BA_ "SystemMessageLongSymbol" BO_ 2147548045 "VDMA_FB8D_Economy_Mode_Active_Hours";
BA_ "SystemMessageLongSymbol" BO_ 2147548047 "VDMA_FB8F_Economy_Mode_Estimated_Fuel_Savi";
BA_ "SystemMessageLongSymbol" BO_ 2147548048 "VDMA_FB90_DC_DC_Converter_4_Voltage";
BA_ "SystemMessageLongSymbol" BO_ 2147548049 "VDMA_FB91_DC_DC_Converter_3_Voltage";
BA_ "SystemMessageLongSymbol" BO_ 2147548050 "VDMA_FB92_DC_DC_Converter_2_Voltage";
BA_ "SystemMessageLongSymbol" BO_ 2147548051 "VDMA_FB93_DC_DC_Converter_1_Voltage";
BA_ "SystemMessageLongSymbol" BO_ 2147548052 "VDMA_FB94_Electronic_Engine_Controller_22";
BA_ "SystemMessageLongSymbol" BO_ 2147548055 "VDMA_FB97_Vehicle_Electrical_Power_15";
BA_ "SystemMessageLongSymbol" BO_ 2147548057 "VDMA_FB99_DC_AC_Accessory_Inverter_1_Tempe";
BA_ "SystemMessageLongSymbol" BO_ 2147548058 "VDMA_FB9A_DC_AC_Accessory_Inverter_1_DC_Si";
BA_ "SystemMessageLongSymbol" BO_ 2147548059 "VDMA_FB9B_DC_AC_Accessory_Inverter_1_AC_Si";
BA_ "SystemMessageLongSymbol" BO_ 2147548060 "VDMA_FB9C_DC_AC_Accessory_Inverter_1_Confi";
BA_ "SystemMessageLongSymbol" BO_ 2147548061 "VDMA_FB9D_DC_AC_Accessory_Inverter_1_Lifet";
BA_ "SystemMessageLongSymbol" BO_ 2147548062 "VDMA_FB9E_DC_AC_Accessory_Inverter_2_Tempe";
BA_ "SystemMessageLongSymbol" BO_ 2147548063 "VDMA_FB9F_DC_AC_Accessory_Inverter_2_DC_Si";
BA_ "SystemMessageLongSymbol" BO_ 2147548064 "VDMA_FBA0_DC_AC_Accessory_Inverter_2_AC_Si";
BA_ "SystemMessageLongSymbol" BO_ 2147548065 "VDMA_FBA1_DC_AC_Accessory_Inverter_2_Confi";
BA_ "SystemMessageLongSymbol" BO_ 2147548066 "VDMA_FBA2_DC_AC_Accessory_Inverter_2_Lifet";
BA_ "SystemMessageLongSymbol" BO_ 2147548067 "VDMA_FBA3_DC_AC_Accessory_Inverter_3_Tempe";
BA_ "SystemMessageLongSymbol" BO_ 2147548068 "VDMA_FBA4_DC_AC_Accessory_Inverter_3_DC_Si";
BA_ "SystemMessageLongSymbol" BO_ 2147548069 "VDMA_FBA5_DC_AC_Accessory_Inverter_3_AC_Si";
BA_ "SystemMessageLongSymbol" BO_ 2147548070 "VDMA_FBA6_DC_AC_Accessory_Inverter_3_Confi";
BA_ "SystemMessageLongSymbol" BO_ 2147548071 "VDMA_FBA7_DC_AC_Accessory_Inverter_3_Lifet";
BA_ "SystemMessageLongSymbol" BO_ 2147548072 "VDMA_FBA8_DC_AC_Accessory_Inverter_4_Tempe";
BA_ "SystemMessageLongSymbol" BO_ 2147548073 "VDMA_FBA9_DC_AC_Accessory_Inverter_4_DC_Si";
BA_ "SystemMessageLongSymbol" BO_ 2147548074 "VDMA_FBAA_DC_AC_Accessory_Inverter_4_AC_Si";
BA_ "SystemMessageLongSymbol" BO_ 2147548075 "VDMA_FBAB_DC_AC_Accessory_Inverter_4_Confi";
BA_ "SystemMessageLongSymbol" BO_ 2147548076 "VDMA_FBAC_DC_AC_Accessory_Inverter_4_Lifet";
BA_ "SystemMessageLongSymbol" BO_ 2147548077 "VDMA_FBAD_DC_AC_Accessory_Inverter_5_Tempe";
BA_ "SystemMessageLongSymbol" BO_ 2147548078 "VDMA_FBAE_DC_AC_Accessory_Inverter_5_DC_Si";
BA_ "SystemMessageLongSymbol" BO_ 2147548079 "VDMA_FBAF_DC_AC_Accessory_Inverter_5_AC_Si";
BA_ "SystemMessageLongSymbol" BO_ 2147548080 "VDMA_FBB0_DC_AC_Accessory_Inverter_5_Confi";
BA_ "SystemMessageLongSymbol" BO_ 2147548081 "VDMA_FBB1_DC_AC_Accessory_Inverter_5_Lifet";
BA_ "SystemMessageLongSymbol" BO_ 2147548082 "VDMA_FBB2_Well_Stimulation_Pump_Sensor_Cal";
BA_ "SystemMessageLongSymbol" BO_ 2147548083 "VDMA_FBB3_Well_Stimulation_Pump_Fluid_Volu";
BA_ "SystemMessageLongSymbol" BO_ 2147548084 "VDMA_FBB4_Well_Stimulation_Pump_Serial_Num";
BA_ "SystemMessageLongSymbol" BO_ 2147548085 "VDMA_FBB5_Well_Stimulation_Pump_Trip_Hours";
BA_ "SystemMessageLongSymbol" BO_ 2147548086 "VDMA_FBB6_Aftertreatment_1_Outlet_Gas_4";
BA_ "SystemMessageLongSymbol" BO_ 2147548087 "VDMA_FBB7_Aftertreatment_1_Intake_Gas_4";
BA_ "SystemMessageLongSymbol" BO_ 2147548088 "VDMA_FBB8_DC_DC_Converter_4_Lifetime_Data";
BA_ "SystemMessageLongSymbol" BO_ 2147548089 "VDMA_FBB9_DC_DC_Converter_4_Configuration_";
BA_ "SystemMessageLongSymbol" BO_ 2147548090 "VDMA_FBBA_DC_DC_Converter_4_SLI_Battery_Li";
BA_ "SystemMessageLongSymbol" BO_ 2147548091 "VDMA_FBBB_DC_DC_Converter_4_Temperatures";
BA_ "SystemMessageLongSymbol" BO_ 2147548092 "VDMA_FBBC_DC_DC_Converter_4_Low_Side_Limit";
BA_ "SystemMessageLongSymbol" BO_ 2147548093 "VDMA_FBBD_DC_DC_Converter_4_High_Side_Limi";
BA_ "SystemMessageLongSymbol" BO_ 2147548094 "VDMA_FBBE_DC_DC_Converter_3_Lifetime_Data";
BA_ "SystemMessageLongSymbol" BO_ 2147548095 "VDMA_FBBF_DC_DC_Converter_3_Configuration_";
BA_ "SystemMessageLongSymbol" BO_ 2147548096 "VDMA_FBC0_DC_DC_Converter_3_SLI_Battery_Li";
BA_ "SystemMessageLongSymbol" BO_ 2147548097 "VDMA_FBC1_DC_DC_Converter_3_Temperatures";
BA_ "SystemMessageLongSymbol" BO_ 2147548098 "VDMA_FBC2_DC_DC_Converter_3_Low_Side_Limit";
BA_ "SystemMessageLongSymbol" BO_ 2147548099 "VDMA_FBC3_DC_DC_Converter_3_High_Side_Limi";
BA_ "SystemMessageLongSymbol" BO_ 2147548100 "VDMA_FBC4_DC_DC_Converter_2_Lifetime_Data";
BA_ "SystemMessageLongSymbol" BO_ 2147548101 "VDMA_FBC5_DC_DC_Converter_2_Configuration_";
BA_ "SystemMessageLongSymbol" BO_ 2147548102 "VDMA_FBC6_DC_DC_Converter_2_SLI_Battery_Li";
BA_ "SystemMessageLongSymbol" BO_ 2147548103 "VDMA_FBC7_DC_DC_Converter_2_Temperatures";
BA_ "SystemMessageLongSymbol" BO_ 2147548104 "VDMA_FBC8_DC_DC_Converter_2_Low_Side_Limit";
BA_ "SystemMessageLongSymbol" BO_ 2147548105 "VDMA_FBC9_DC_DC_Converter_2_High_Side_Limi";
BA_ "SystemMessageLongSymbol" BO_ 2147548106 "VDMA_FBCA_CiA_602_2_AUTOSAR_CAN_NM_Obsolet";
BA_ "SystemSignalLongSymbol" SG_ 2147547826 High_Voltage_Energy_Storage_Pack "High_Voltage_Energy_Storage_Pack_RawPayload";
BA_ "SystemSignalLongSymbol" SG_ 2147547827 AUTOSAR_Time_Synchronization_Raw "AUTOSAR_Time_Synchronization_RawPayload";
BA_ "SystemSignalLongSymbol" SG_ 2147547828 EV_DC_Charging_Limits_1_RawPaylo "EV_DC_Charging_Limits_1_RawPayload";
BA_ "SystemSignalLongSymbol" SG_ 2147547829 EVSE_DC_Charging_Limits_1_RawPay "EVSE_DC_Charging_Limits_1_RawPayload";
BA_ "SystemSignalLongSymbol" SG_ 2147547830 EVSE_DC_Charging_Limits_2_RawPay "EVSE_DC_Charging_Limits_2_RawPayload";
BA_ "SystemSignalLongSymbol" SG_ 2147547833 EVSE_1_Contactor_Cmd_1_RawPayloa "EVSE_1_Contactor_Cmd_1_RawPayload";
BA_ "SystemSignalLongSymbol" SG_ 2147547834 EVSE_1_Contactor_Status_1_RawPay "EVSE_1_Contactor_Status_1_RawPayload";
BA_ "SystemSignalLongSymbol" SG_ 2147547835 Direct_Lamp_Control_Command_3_Ra "Direct_Lamp_Control_Command_3_RawPayload";
BA_ "SystemSignalLongSymbol" SG_ 2147547836 Direct_Lamp_Control_Data_3_RawPa "Direct_Lamp_Control_Data_3_RawPayload";
BA_ "SystemSignalLongSymbol" SG_ 2147547837 Motor_Generator_1_Lifetime_Data_ "Motor_Generator_1_Lifetime_Data_RawPayload";
BA_ "SystemSignalLongSymbol" SG_ 2147547838 Motor_Generator_2_Lifetime_Data_ "Motor_Generator_2_Lifetime_Data_RawPayload";
BA_ "SystemSignalLongSymbol" SG_ 2147547839 Motor_Generator_3_Lifetime_Data_ "Motor_Generator_3_Lifetime_Data_RawPayload";
BA_ "SystemSignalLongSymbol" SG_ 2147547840 Motor_Generator_4_Lifetime_Data_ "Motor_Generator_4_Lifetime_Data_RawPayload";
BA_ "SystemSignalLongSymbol" SG_ 2147547841 Motor_Generator_5_Lifetime_Data_ "Motor_Generator_5_Lifetime_Data_RawPayload";
BA_ "SystemSignalLongSymbol" SG_ 2147547842 Motor_Generator_6_Lifetime_Data_ "Motor_Generator_6_Lifetime_Data_RawPayload";
BA_ "SystemSignalLongSymbol" SG_ 2147547844 EVSE_AC_Supply_Voltage_RawPayloa "EVSE_AC_Supply_Voltage_RawPayload";
BA_ "SystemSignalLongSymbol" SG_ 2147547846 Electronic_Retarder_Controller_3 "Electronic_Retarder_Controller_3_RawPayload";
BA_ "SystemSignalLongSymbol" SG_ 2147547848 Electronic_Transmission_Controll "Electronic_Transmission_Controll_RawPayload";
BA_ "SystemSignalLongSymbol" SG_ 2147547851 Collision_Avoidance_System_4_Raw "Collision_Avoidance_System_4_RawPayload";
BA_ "SystemSignalLongSymbol" SG_ 2147547852 Collision_Avoidance_System_3_Raw "Collision_Avoidance_System_3_RawPayload";
BA_ "SystemSignalLongSymbol" SG_ 2147547853 Aftertreatment_1_SCR_Exhaust_Gas "Aftertreatment_1_SCR_Exhaust_Gas_RawPayload";
BA_ "SystemSignalLongSymbol" SG_ 2147547855 EVCC_Diagnostic_Data_1_RawPayloa "EVCC_Diagnostic_Data_1_RawPayload";
BA_ "SystemSignalLongSymbol" SG_ 2147547857 Engine_Average_Information_2_Raw "Engine_Average_Information_2_RawPayload";
BA_ "SystemSignalLongSymbol" SG_ 2147547858 Turbocharger_Information_9_RawPa "Turbocharger_Information_9_RawPayload";
BA_ "SystemSignalLongSymbol" SG_ 2147547859 Automated_Driving_System_Control "Automated_Driving_System_Control_RawPayload";
BA_ "SystemSignalLongSymbol" SG_ 2147547863 Object_Detection_Message_1_1_Raw "Object_Detection_Message_1_1_RawPayload";
BA_ "SystemSignalLongSymbol" SG_ 2147547864 Object_Detection_Message_2_1_Raw "Object_Detection_Message_2_1_RawPayload";
BA_ "SystemSignalLongSymbol" SG_ 2147547865 Object_Detection_Message_2_2_Raw "Object_Detection_Message_2_2_RawPayload";
BA_ "SystemSignalLongSymbol" SG_ 2147547866 Object_Detection_Message_2_3_Raw "Object_Detection_Message_2_3_RawPayload";
BA_ "SystemSignalLongSymbol" SG_ 2147547867 Object_Detection_Message_2_4_Raw "Object_Detection_Message_2_4_RawPayload";
BA_ "SystemSignalLongSymbol" SG_ 2147547868 Object_Detection_Message_2_5_Raw "Object_Detection_Message_2_5_RawPayload";
BA_ "SystemSignalLongSymbol" SG_ 2147547869 Object_Detection_Message_2_6_Raw "Object_Detection_Message_2_6_RawPayload";
BA_ "SystemSignalLongSymbol" SG_ 2147547870 Object_Detection_Message_2_7_Raw "Object_Detection_Message_2_7_RawPayload";
BA_ "SystemSignalLongSymbol" SG_ 2147547871 Object_Detection_Message_2_8_Raw "Object_Detection_Message_2_8_RawPayload";
BA_ "SystemSignalLongSymbol" SG_ 2147547872 Object_Detection_Message_2_9_Raw "Object_Detection_Message_2_9_RawPayload";
BA_ "SystemSignalLongSymbol" SG_ 2147547873 Object_Detection_Message_2_10_Ra "Object_Detection_Message_2_10_RawPayload";
BA_ "SystemSignalLongSymbol" SG_ 2147547874 Object_Detection_Message_2_11_Ra "Object_Detection_Message_2_11_RawPayload";
BA_ "SystemSignalLongSymbol" SG_ 2147547875 Object_Detection_Message_2_12_Ra "Object_Detection_Message_2_12_RawPayload";
BA_ "SystemSignalLongSymbol" SG_ 2147547876 Object_Detection_Message_2_13_Ra "Object_Detection_Message_2_13_RawPayload";
BA_ "SystemSignalLongSymbol" SG_ 2147547877 Object_Detection_Message_2_14_Ra "Object_Detection_Message_2_14_RawPayload";
BA_ "SystemSignalLongSymbol" SG_ 2147547878 Object_Detection_Message_2_15_Ra "Object_Detection_Message_2_15_RawPayload";
BA_ "SystemSignalLongSymbol" SG_ 2147547879 Object_Detection_Message_2_16_Ra "Object_Detection_Message_2_16_RawPayload";
BA_ "SystemSignalLongSymbol" SG_ 2147547880 Object_Detection_Message_2_17_Ra "Object_Detection_Message_2_17_RawPayload";
BA_ "SystemSignalLongSymbol" SG_ 2147547881 Object_Detection_Message_2_18_Ra "Object_Detection_Message_2_18_RawPayload";
BA_ "SystemSignalLongSymbol" SG_ 2147547882 Object_Detection_Message_2_19_Ra "Object_Detection_Message_2_19_RawPayload";
BA_ "SystemSignalLongSymbol" SG_ 2147547883 Object_Detection_Message_2_20_Ra "Object_Detection_Message_2_20_RawPayload";
BA_ "SystemSignalLongSymbol" SG_ 2147547884 Object_Detection_Message_2_21_Ra "Object_Detection_Message_2_21_RawPayload";
BA_ "SystemSignalLongSymbol" SG_ 2147547885 Temperature_Sensing_Module_1_Raw "Temperature_Sensing_Module_1_RawPayload";
BA_ "SystemSignalLongSymbol" SG_ 2147547886 Temperature_Sensing_Module_2_Raw "Temperature_Sensing_Module_2_RawPayload";
BA_ "SystemSignalLongSymbol" SG_ 2147547887 Aftertreatment_2_SCR_Service_Inf "Aftertreatment_2_SCR_Service_Inf_RawPayload";
BA_ "SystemSignalLongSymbol" SG_ 2147547888 Aftertreatment_1_SCR_Service_Inf "Aftertreatment_1_SCR_Service_Inf_RawPayload";
BA_ "SystemSignalLongSymbol" SG_ 2147547889 PSA_Times_Lifetime_Hours_RawPayl "PSA_Times_Lifetime_Hours_RawPayload";
BA_ "SystemSignalLongSymbol" SG_ 2147547890 PSA_Times_Stored_100_Hours_RawPa "PSA_Times_Stored_100_Hours_RawPayload";
BA_ "SystemSignalLongSymbol" SG_ 2147547891 PSA_Times_Active_100_Hours_RawPa "PSA_Times_Active_100_Hours_RawPayload";
BA_ "SystemSignalLongSymbol" SG_ 2147547892 Hybrid_Charge_Depleting_or_Incre "Hybrid_Charge_Depleting_or_Incre_RawPayload";
BA_ "SystemSignalLongSymbol" SG_ 2147547893 Hybrid_Charge_Depleting_or_Incre "Hybrid_Charge_Depleting_or_Incre_RawPayload";
BA_ "SystemSignalLongSymbol" SG_ 2147547894 Hybrid_Charge_Depleting_or_Incre "Hybrid_Charge_Depleting_or_Incre_RawPayload";
BA_ "SystemSignalLongSymbol" SG_ 2147547895 Aftertreatment_1_Historical_Info "Aftertreatment_1_Historical_Info_RawPayload";
BA_ "SystemSignalLongSymbol" SG_ 2147547896 Engine_Maximum_Net_Torque_Map_Ra "Engine_Maximum_Net_Torque_Map_RawPayload";
BA_ "SystemSignalLongSymbol" SG_ 2147547897 Aftertreatment_1_SCR_2_NOx_Mass_ "Aftertreatment_1_SCR_2_NOx_Mass__RawPayload";
BA_ "SystemSignalLongSymbol" SG_ 2147547898 Aftertreatment_1_SCR_1_NOx_Mass_ "Aftertreatment_1_SCR_1_NOx_Mass__RawPayload";
BA_ "SystemSignalLongSymbol" SG_ 2147547899 Evaporative_System_Pressure_and_ "Evaporative_System_Pressure_and__RawPayload";
BA_ "SystemSignalLongSymbol" SG_ 2147547900 GHG_Tracking_Lifetime_Array_Data "GHG_Tracking_Lifetime_Array_Data_RawPayload";
BA_ "SystemSignalLongSymbol" SG_ 2147547901 GHG_Tracking_Stored_100_Hour_Arr "GHG_Tracking_Stored_100_Hour_Arr_RawPayload";
BA_ "SystemSignalLongSymbol" SG_ 2147547902 GHG_Tracking_Active_100_Hour_Arr "GHG_Tracking_Active_100_Hour_Arr_RawPayload";
BA_ "SystemSignalLongSymbol" SG_ 2147547903 Green_House_Gas_Stored_100_Hour_ "Green_House_Gas_Stored_100_Hour__RawPayload";
BA_ "SystemSignalLongSymbol" SG_ 2147547904 Green_House_Gas_Active_100_Hour_ "Green_House_Gas_Active_100_Hour__RawPayload";
BA_ "SystemSignalLongSymbol" SG_ 2147547905 Green_House_Gas_Lifetime_Active_ "Green_House_Gas_Lifetime_Active__RawPayload";
BA_ "SystemSignalLongSymbol" SG_ 2147547906 NOx_Tracking_Engine_Activity_Lif "NOx_Tracking_Engine_Activity_Lif_RawPayload";
BA_ "SystemSignalLongSymbol" SG_ 2147547907 NOx_Tracking_Engine_Activity_Lif "NOx_Tracking_Engine_Activity_Lif_RawPayload";
BA_ "SystemSignalLongSymbol" SG_ 2147547908 NOx_Tracking_Engine_Activity_Lif "NOx_Tracking_Engine_Activity_Lif_RawPayload";
BA_ "SystemSignalLongSymbol" SG_ 2147547909 NOx_Tracking_Engine_Activity_Lif "NOx_Tracking_Engine_Activity_Lif_RawPayload";
BA_ "SystemSignalLongSymbol" SG_ 2147547910 NOx_Tracking_Valid_NOx_Lifetime_ "NOx_Tracking_Valid_NOx_Lifetime__RawPayload";
BA_ "SystemSignalLongSymbol" SG_ 2147547911 NOx_Tracking_Valid_NOx_Lifetime_ "NOx_Tracking_Valid_NOx_Lifetime__RawPayload";
BA_ "SystemSignalLongSymbol" SG_ 2147547912 NOx_Tracking_Valid_NOx_Lifetime_ "NOx_Tracking_Valid_NOx_Lifetime__RawPayload";
BA_ "SystemSignalLongSymbol" SG_ 2147547913 NOx_Tracking_Valid_NOx_Lifetime_ "NOx_Tracking_Valid_NOx_Lifetime__RawPayload";
BA_ "SystemSignalLongSymbol" SG_ 2147547914 NOx_Tracking_Valid_NOx_Lifetime_ "NOx_Tracking_Valid_NOx_Lifetime__RawPayload";
BA_ "SystemSignalLongSymbol" SG_ 2147547915 NOx_Tracking_Valid_NOx_Lifetime_ "NOx_Tracking_Valid_NOx_Lifetime__RawPayload";
BA_ "SystemSignalLongSymbol" SG_ 2147547916 NOx_Tracking_Stored_100_Hour_Fue "NOx_Tracking_Stored_100_Hour_Fue_RawPayload";
BA_ "SystemSignalLongSymbol" SG_ 2147547917 NOx_Tracking_Stored_100_Hour_Eng "NOx_Tracking_Stored_100_Hour_Eng_RawPayload";
BA_ "SystemSignalLongSymbol" SG_ 2147547918 NOx_Tracking_Stored_100_Hour_Veh "NOx_Tracking_Stored_100_Hour_Veh_RawPayload";
BA_ "SystemSignalLongSymbol" SG_ 2147547919 NOx_Tracking_Stored_100_Hour_Eng "NOx_Tracking_Stored_100_Hour_Eng_RawPayload";
BA_ "SystemSignalLongSymbol" SG_ 2147547920 NOx_Tracking_Stored_100_Hour_Eng "NOx_Tracking_Stored_100_Hour_Eng_RawPayload";
BA_ "SystemSignalLongSymbol" SG_ 2147547921 NOx_Tracking_Stored_100_Hour_Sys "NOx_Tracking_Stored_100_Hour_Sys_RawPayload";
BA_ "SystemSignalLongSymbol" SG_ 2147547922 NOx_Tracking_Active_100_Hour_Fue "NOx_Tracking_Active_100_Hour_Fue_RawPayload";
BA_ "SystemSignalLongSymbol" SG_ 2147547923 NOx_Tracking_Active_100_Hour_Eng "NOx_Tracking_Active_100_Hour_Eng_RawPayload";
BA_ "SystemSignalLongSymbol" SG_ 2147547924 NOx_Tracking_Active_100_Hour_Veh "NOx_Tracking_Active_100_Hour_Veh_RawPayload";
BA_ "SystemSignalLongSymbol" SG_ 2147547925 NOx_Tracking_Active_100_Hour_Eng "NOx_Tracking_Active_100_Hour_Eng_RawPayload";
BA_ "SystemSignalLongSymbol" SG_ 2147547926 NOx_Tracking_Active_100_Hour_Eng "NOx_Tracking_Active_100_Hour_Eng_RawPayload";
BA_ "SystemSignalLongSymbol" SG_ 2147547927 NOx_Tracking_Active_100_Hour_Sys "NOx_Tracking_Active_100_Hour_Sys_RawPayload";
BA_ "SystemSignalLongSymbol" SG_ 2147547928 Motor_Generator_6_Inverter_Contr "Motor_Generator_6_Inverter_Contr_RawPayload";
BA_ "SystemSignalLongSymbol" SG_ 2147547929 Motor_Generator_6_Inverter_Limit "Motor_Generator_6_Inverter_Limit_RawPayload";
BA_ "SystemSignalLongSymbol" SG_ 2147547930 Motor_Generator_6_Inverter_Limit "Motor_Generator_6_Inverter_Limit_RawPayload";
BA_ "SystemSignalLongSymbol" SG_ 2147547931 Motor_Generator_6_Inverter_Limit "Motor_Generator_6_Inverter_Limit_RawPayload";
BA_ "SystemSignalLongSymbol" SG_ 2147547932 Motor_Generator_6_Inverter_Isola "Motor_Generator_6_Inverter_Isola_RawPayload";
BA_ "SystemSignalLongSymbol" SG_ 2147547933 Motor_Generator_5_Inverter_Contr "Motor_Generator_5_Inverter_Contr_RawPayload";
BA_ "SystemSignalLongSymbol" SG_ 2147547934 Motor_Generator_5_Inverter_Limit "Motor_Generator_5_Inverter_Limit_RawPayload";
BA_ "SystemSignalLongSymbol" SG_ 2147547935 Motor_Generator_5_Inverter_Limit "Motor_Generator_5_Inverter_Limit_RawPayload";
BA_ "SystemSignalLongSymbol" SG_ 2147547936 Motor_Generator_5_Inverter_Limit "Motor_Generator_5_Inverter_Limit_RawPayload";
BA_ "SystemSignalLongSymbol" SG_ 2147547937 Motor_Generator_5_Inverter_Isola "Motor_Generator_5_Inverter_Isola_RawPayload";
BA_ "SystemSignalLongSymbol" SG_ 2147547938 Motor_Generator_4_Inverter_Contr "Motor_Generator_4_Inverter_Contr_RawPayload";
BA_ "SystemSignalLongSymbol" SG_ 2147547939 Motor_Generator_4_Inverter_Limit "Motor_Generator_4_Inverter_Limit_RawPayload";
BA_ "SystemSignalLongSymbol" SG_ 2147547940 Motor_Generator_4_Inverter_Limit "Motor_Generator_4_Inverter_Limit_RawPayload";
BA_ "SystemSignalLongSymbol" SG_ 2147547941 Motor_Generator_4_Inverter_Limit "Motor_Generator_4_Inverter_Limit_RawPayload";
BA_ "SystemSignalLongSymbol" SG_ 2147547942 Motor_Generator_4_Inverter_Isola "Motor_Generator_4_Inverter_Isola_RawPayload";
BA_ "SystemSignalLongSymbol" SG_ 2147547943 Motor_Generator_3_Inverter_Contr "Motor_Generator_3_Inverter_Contr_RawPayload";
BA_ "SystemSignalLongSymbol" SG_ 2147547944 Motor_Generator_3_Inverter_Limit "Motor_Generator_3_Inverter_Limit_RawPayload";
BA_ "SystemSignalLongSymbol" SG_ 2147547945 Motor_Generator_3_Inverter_Limit "Motor_Generator_3_Inverter_Limit_RawPayload";
BA_ "SystemSignalLongSymbol" SG_ 2147547946 Motor_Generator_3_Inverter_Limit "Motor_Generator_3_Inverter_Limit_RawPayload";
BA_ "SystemSignalLongSymbol" SG_ 2147547947 Motor_Generator_3_Inverter_Isola "Motor_Generator_3_Inverter_Isola_RawPayload";
BA_ "SystemSignalLongSymbol" SG_ 2147547948 Diagnostic_Readiness_4_RawPayloa "Diagnostic_Readiness_4_RawPayload";
BA_ "SystemSignalLongSymbol" SG_ 2147547949 Turbocharger_Information_8_RawPa "Turbocharger_Information_8_RawPayload";
BA_ "SystemSignalLongSymbol" SG_ 2147547951 Motor_Generator_6_Inverter_Refer "Motor_Generator_6_Inverter_Refer_RawPayload";
BA_ "SystemSignalLongSymbol" SG_ 2147547952 Motor_Generator_6_Inverter_Statu "Motor_Generator_6_Inverter_Statu_RawPayload";
BA_ "SystemSignalLongSymbol" SG_ 2147547953 Motor_Generator_6_Inverter_Refer "Motor_Generator_6_Inverter_Refer_RawPayload";
BA_ "SystemSignalLongSymbol" SG_ 2147547954 Motor_Generator_6_Inverter_Tempe "Motor_Generator_6_Inverter_Tempe_RawPayload";
BA_ "SystemSignalLongSymbol" SG_ 2147547955 Motor_Generator_6_Inverter_Motor "Motor_Generator_6_Inverter_Motor_RawPayload";
BA_ "SystemSignalLongSymbol" SG_ 2147547956 Motor_Generator_6_Inverter_Isola "Motor_Generator_6_Inverter_Isola_RawPayload";
BA_ "SystemSignalLongSymbol" SG_ 2147547957 Motor_Generator_6_Inverter_Activ "Motor_Generator_6_Inverter_Activ_RawPayload";
BA_ "SystemSignalLongSymbol" SG_ 2147547958 Motor_Generator_5_Inverter_Refer "Motor_Generator_5_Inverter_Refer_RawPayload";
BA_ "SystemSignalLongSymbol" SG_ 2147547959 Motor_Generator_5_Inverter_Statu "Motor_Generator_5_Inverter_Statu_RawPayload";
BA_ "SystemSignalLongSymbol" SG_ 2147547960 Motor_Generator_5_Inverter_Refer "Motor_Generator_5_Inverter_Refer_RawPayload";
BA_ "SystemSignalLongSymbol" SG_ 2147547961 Motor_Generator_5_Inverter_Tempe "Motor_Generator_5_Inverter_Tempe_RawPayload";
BA_ "SystemSignalLongSymbol" SG_ 2147547962 Motor_Generator_5_Inverter_Motor "Motor_Generator_5_Inverter_Motor_RawPayload";
BA_ "SystemSignalLongSymbol" SG_ 2147547963 Motor_Generator_5_Inverter_Isola "Motor_Generator_5_Inverter_Isola_RawPayload";
BA_ "SystemSignalLongSymbol" SG_ 2147547964 Motor_Generator_5_Inverter_Activ "Motor_Generator_5_Inverter_Activ_RawPayload";
BA_ "SystemSignalLongSymbol" SG_ 2147547965 Motor_Generator_4_Inverter_Refer "Motor_Generator_4_Inverter_Refer_RawPayload";
BA_ "SystemSignalLongSymbol" SG_ 2147547966 Motor_Generator_4_Inverter_Statu "Motor_Generator_4_Inverter_Statu_RawPayload";
BA_ "SystemSignalLongSymbol" SG_ 2147547967 Motor_Generator_4_Inverter_Refer "Motor_Generator_4_Inverter_Refer_RawPayload";
BA_ "SystemSignalLongSymbol" SG_ 2147547968 Motor_Generator_4_Inverter_Tempe "Motor_Generator_4_Inverter_Tempe_RawPayload";
BA_ "SystemSignalLongSymbol" SG_ 2147547969 Motor_Generator_4_Inverter_Motor "Motor_Generator_4_Inverter_Motor_RawPayload";
BA_ "SystemSignalLongSymbol" SG_ 2147547970 Motor_Generator_4_Inverter_Isola "Motor_Generator_4_Inverter_Isola_RawPayload";
BA_ "SystemSignalLongSymbol" SG_ 2147547971 Motor_Generator_4_Inverter_Activ "Motor_Generator_4_Inverter_Activ_RawPayload";
BA_ "SystemSignalLongSymbol" SG_ 2147547972 Motor_Generator_3_Inverter_Refer "Motor_Generator_3_Inverter_Refer_RawPayload";
BA_ "SystemSignalLongSymbol" SG_ 2147547973 Motor_Generator_3_Inverter_Statu "Motor_Generator_3_Inverter_Statu_RawPayload";
BA_ "SystemSignalLongSymbol" SG_ 2147547974 Motor_Generator_3_Inverter_Refer "Motor_Generator_3_Inverter_Refer_RawPayload";
BA_ "SystemSignalLongSymbol" SG_ 2147547975 Motor_Generator_3_Inverter_Tempe "Motor_Generator_3_Inverter_Tempe_RawPayload";
BA_ "SystemSignalLongSymbol" SG_ 2147547976 Motor_Generator_3_Inverter_Motor "Motor_Generator_3_Inverter_Motor_RawPayload";
BA_ "SystemSignalLongSymbol" SG_ 2147547977 Motor_Generator_3_Inverter_Isola "Motor_Generator_3_Inverter_Isola_RawPayload";
BA_ "SystemSignalLongSymbol" SG_ 2147547978 Motor_Generator_3_Inverter_Activ "Motor_Generator_3_Inverter_Activ_RawPayload";
BA_ "SystemSignalLongSymbol" SG_ 2147547979 Automated_Driving_System_Status_ "Automated_Driving_System_Status__RawPayload";
BA_ "SystemSignalLongSymbol" SG_ 2147547980 Cab_Climate_System_Information_2 "Cab_Climate_System_Information_2_RawPayload";
BA_ "SystemSignalLongSymbol" SG_ 2147547981 Maintenance_Information_1_RawPay "Maintenance_Information_1_RawPayload";
BA_ "SystemSignalLongSymbol" SG_ 2147547982 Hoist_Control_Information_RawPay "Hoist_Control_Information_RawPayload";
BA_ "SystemSignalLongSymbol" SG_ 2147547983 High_Voltage_Energy_Storage_Pack "High_Voltage_Energy_Storage_Pack_RawPayload";
BA_ "SystemSignalLongSymbol" SG_ 2147547984 High_Voltage_Energy_Storage_Pack "High_Voltage_Energy_Storage_Pack_RawPayload";
BA_ "SystemSignalLongSymbol" SG_ 2147547985 High_Voltage_Energy_Storage_Pack "High_Voltage_Energy_Storage_Pack_RawPayload";
BA_ "SystemSignalLongSymbol" SG_ 2147547986 High_Voltage_Energy_Storage_Pack "High_Voltage_Energy_Storage_Pack_RawPayload";
BA_ "SystemSignalLongSymbol" SG_ 2147547987 High_Voltage_Energy_Storage_Pack "High_Voltage_Energy_Storage_Pack_RawPayload";
BA_ "SystemSignalLongSymbol" SG_ 2147547988 High_Voltage_Energy_Storage_Pack "High_Voltage_Energy_Storage_Pack_RawPayload";
BA_ "SystemSignalLongSymbol" SG_ 2147547989 High_Voltage_Energy_Storage_Pack "High_Voltage_Energy_Storage_Pack_RawPayload";
BA_ "SystemSignalLongSymbol" SG_ 2147547990 High_Voltage_Energy_Storage_Pack "High_Voltage_Energy_Storage_Pack_RawPayload";
BA_ "SystemSignalLongSymbol" SG_ 2147547991 High_Voltage_Energy_Storage_Pack "High_Voltage_Energy_Storage_Pack_RawPayload";
BA_ "SystemSignalLongSymbol" SG_ 2147547992 High_Voltage_Energy_Storage_Pack "High_Voltage_Energy_Storage_Pack_RawPayload";
BA_ "SystemSignalLongSymbol" SG_ 2147547993 High_Voltage_Energy_Storage_Pack "High_Voltage_Energy_Storage_Pack_RawPayload";
BA_ "SystemSignalLongSymbol" SG_ 2147547994 High_Voltage_Energy_Storage_Pack "High_Voltage_Energy_Storage_Pack_RawPayload";
BA_ "SystemSignalLongSymbol" SG_ 2147547995 Vehicle_Fire_Suppression_System_ "Vehicle_Fire_Suppression_System__RawPayload";
BA_ "SystemSignalLongSymbol" SG_ 2147547996 Vehicle_Fire_Suppression_System_ "Vehicle_Fire_Suppression_System__RawPayload";
BA_ "SystemSignalLongSymbol" SG_ 2147547997 Vehicle_Fire_Suppression_System_ "Vehicle_Fire_Suppression_System__RawPayload";
BA_ "SystemSignalLongSymbol" SG_ 2147547998 Vehicle_Fire_Suppression_System_ "Vehicle_Fire_Suppression_System__RawPayload";
BA_ "SystemSignalLongSymbol" SG_ 2147547999 Vehicle_Fire_Suppression_System_ "Vehicle_Fire_Suppression_System__RawPayload";
BA_ "SystemSignalLongSymbol" SG_ 2147548000 Vehicle_Fire_Suppression_System_ "Vehicle_Fire_Suppression_System__RawPayload";
BA_ "SystemSignalLongSymbol" SG_ 2147548001 Vehicle_Fire_Suppression_System_ "Vehicle_Fire_Suppression_System__RawPayload";
BA_ "SystemSignalLongSymbol" SG_ 2147548002 Vehicle_Fire_Suppression_System_ "Vehicle_Fire_Suppression_System__RawPayload";
BA_ "SystemSignalLongSymbol" SG_ 2147548003 Vehicle_Fire_Suppression_System_ "Vehicle_Fire_Suppression_System__RawPayload";
BA_ "SystemSignalLongSymbol" SG_ 2147548004 Vehicle_Fire_Suppression_System_ "Vehicle_Fire_Suppression_System__RawPayload";
BA_ "SystemSignalLongSymbol" SG_ 2147548005 Vehicle_Fire_Suppression_System_ "Vehicle_Fire_Suppression_System__RawPayload";
BA_ "SystemSignalLongSymbol" SG_ 2147548006 Vehicle_Fire_Suppression_System_ "Vehicle_Fire_Suppression_System__RawPayload";
BA_ "SystemSignalLongSymbol" SG_ 2147548007 Motor_Generator_2_Inverter_Activ "Motor_Generator_2_Inverter_Activ_RawPayload";
BA_ "SystemSignalLongSymbol" SG_ 2147548008 Motor_Generator_2_Inverter_Isola "Motor_Generator_2_Inverter_Isola_RawPayload";
BA_ "SystemSignalLongSymbol" SG_ 2147548009 Motor_Generator_1_Inverter_Activ "Motor_Generator_1_Inverter_Activ_RawPayload";
BA_ "SystemSignalLongSymbol" SG_ 2147548010 Motor_Generator_1_Inverter_Isola "Motor_Generator_1_Inverter_Isola_RawPayload";
BA_ "SystemSignalLongSymbol" SG_ 2147548011 High_Voltage_Bus_Information_Raw "High_Voltage_Bus_Information_RawPayload";
BA_ "SystemSignalLongSymbol" SG_ 2147548012 Motor_Generator_2_Inverter_Refer "Motor_Generator_2_Inverter_Refer_RawPayload";
BA_ "SystemSignalLongSymbol" SG_ 2147548013 Motor_Generator_2_Inverter_Statu "Motor_Generator_2_Inverter_Statu_RawPayload";
BA_ "SystemSignalLongSymbol" SG_ 2147548014 Motor_Generator_2_Inverter_Refer "Motor_Generator_2_Inverter_Refer_RawPayload";
BA_ "SystemSignalLongSymbol" SG_ 2147548015 Motor_Generator_2_Inverter_Tempe "Motor_Generator_2_Inverter_Tempe_RawPayload";
BA_ "SystemSignalLongSymbol" SG_ 2147548016 Motor_Generator_2_Inverter_Motor "Motor_Generator_2_Inverter_Motor_RawPayload";
BA_ "SystemSignalLongSymbol" SG_ 2147548017 Motor_Generator_1_Inverter_Motor "Motor_Generator_1_Inverter_Motor_RawPayload";
BA_ "SystemSignalLongSymbol" SG_ 2147548018 Motor_Generator_1_Inverter_Tempe "Motor_Generator_1_Inverter_Tempe_RawPayload";
BA_ "SystemSignalLongSymbol" SG_ 2147548019 Motor_Generator_1_Inverter_Refer "Motor_Generator_1_Inverter_Refer_RawPayload";
BA_ "SystemSignalLongSymbol" SG_ 2147548020 Motor_Generator_1_Inverter_Statu "Motor_Generator_1_Inverter_Statu_RawPayload";
BA_ "SystemSignalLongSymbol" SG_ 2147548021 Motor_Generator_1_Inverter_Refer "Motor_Generator_1_Inverter_Refer_RawPayload";
BA_ "SystemSignalLongSymbol" SG_ 2147548022 Personnel_Detect_Status_RawPaylo "Personnel_Detect_Status_RawPayload";
BA_ "SystemSignalLongSymbol" SG_ 2147548023 Engine_Cylinder_Pressure_Gamma_1 "Engine_Cylinder_Pressure_Gamma_1_RawPayload";
BA_ "SystemSignalLongSymbol" SG_ 2147548024 Engine_Cylinder_Pressure_Gamma_2 "Engine_Cylinder_Pressure_Gamma_2_RawPayload";
BA_ "SystemSignalLongSymbol" SG_ 2147548025 Engine_Cylinder_Pressure_Gamma_3 "Engine_Cylinder_Pressure_Gamma_3_RawPayload";
BA_ "SystemSignalLongSymbol" SG_ 2147548026 Engine_Cylinder_Pressure_Gamma_4 "Engine_Cylinder_Pressure_Gamma_4_RawPayload";
BA_ "SystemSignalLongSymbol" SG_ 2147548027 Engine_Cylinder_Pressure_Gamma_5 "Engine_Cylinder_Pressure_Gamma_5_RawPayload";
BA_ "SystemSignalLongSymbol" SG_ 2147548029 Electrified_Accessory_Generator_ "Electrified_Accessory_Generator__RawPayload";
BA_ "SystemSignalLongSymbol" SG_ 2147548030 Electrified_Accessory_Generator_ "Electrified_Accessory_Generator__RawPayload";
BA_ "SystemSignalLongSymbol" SG_ 2147548031 Well_Stimulation_Pump_System_Fil "Well_Stimulation_Pump_System_Fil_RawPayload";
BA_ "SystemSignalLongSymbol" SG_ 2147548032 PTO_Governor_Configuration_RawPa "PTO_Governor_Configuration_RawPayload";
BA_ "SystemSignalLongSymbol" SG_ 2147548033 On_Board_Programming_2_RawPayloa "On_Board_Programming_2_RawPayload";
BA_ "SystemSignalLongSymbol" SG_ 2147548034 Primary_or_Rear_Hitch_Yaw_RawPay "Primary_or_Rear_Hitch_Yaw_RawPayload";
BA_ "SystemSignalLongSymbol" SG_ 2147548035 Secondary_or_Front_Hitch_Yaw_Raw "Secondary_or_Front_Hitch_Yaw_RawPayload";
BA_ "SystemSignalLongSymbol" SG_ 2147548037 Engine_Idle_Management_Informati "Engine_Idle_Management_Informati_RawPayload";
BA_ "SystemSignalLongSymbol" SG_ 2147548038 Alcohol_Interlock_To_Vehicle_Raw "Alcohol_Interlock_To_Vehicle_RawPayload";
BA_ "SystemSignalLongSymbol" SG_ 2147548039 Vehicle_To_Alcohol_Interlock_Raw "Vehicle_To_Alcohol_Interlock_RawPayload";
BA_ "SystemSignalLongSymbol" SG_ 2147548040 Marine_Control_Information_3_Raw "Marine_Control_Information_3_RawPayload";
BA_ "SystemSignalLongSymbol" SG_ 2147548041 Engine_Fluid_Level_Pressure_13_R "Engine_Fluid_Level_Pressure_13_RawPayload";
BA_ "SystemSignalLongSymbol" SG_ 2147548042 High_Voltage_Energy_Storage_Syst "High_Voltage_Energy_Storage_Syst_RawPayload";
BA_ "SystemSignalLongSymbol" SG_ 2147548043 Economy_Mode_Inactive_Hours_RawP "Economy_Mode_Inactive_Hours_RawPayload";
BA_ "SystemSignalLongSymbol" SG_ 2147548044 Economy_Mode_Estimated_Instantan "Economy_Mode_Estimated_Instantan_RawPayload";
BA_ "SystemSignalLongSymbol" SG_ 2147548045 Economy_Mode_Active_Hours_RawPay "Economy_Mode_Active_Hours_RawPayload";
BA_ "SystemSignalLongSymbol" SG_ 2147548046 Economy_Mode_Fuel_Used_RawPayloa "Economy_Mode_Fuel_Used_RawPayload";
BA_ "SystemSignalLongSymbol" SG_ 2147548047 Economy_Mode_Estimated_Fuel_Savi "Economy_Mode_Estimated_Fuel_Savi_RawPayload";
BA_ "SystemSignalLongSymbol" SG_ 2147548048 DC_DC_Converter_4_Voltage_RawPay "DC_DC_Converter_4_Voltage_RawPayload";
BA_ "SystemSignalLongSymbol" SG_ 2147548049 DC_DC_Converter_3_Voltage_RawPay "DC_DC_Converter_3_Voltage_RawPayload";
BA_ "SystemSignalLongSymbol" SG_ 2147548050 DC_DC_Converter_2_Voltage_RawPay "DC_DC_Converter_2_Voltage_RawPayload";
BA_ "SystemSignalLongSymbol" SG_ 2147548051 DC_DC_Converter_1_Voltage_RawPay "DC_DC_Converter_1_Voltage_RawPayload";
BA_ "SystemSignalLongSymbol" SG_ 2147548052 Electronic_Engine_Controller_22_ "Electronic_Engine_Controller_22_RawPayload";
BA_ "SystemSignalLongSymbol" SG_ 2147548055 Vehicle_Electrical_Power_15_RawP "Vehicle_Electrical_Power_15_RawPayload";
BA_ "SystemSignalLongSymbol" SG_ 2147548057 DC_AC_Accessory_Inverter_1_Tempe "DC_AC_Accessory_Inverter_1_Tempe_RawPayload";
BA_ "SystemSignalLongSymbol" SG_ 2147548058 DC_AC_Accessory_Inverter_1_DC_Si "DC_AC_Accessory_Inverter_1_DC_Si_RawPayload";
BA_ "SystemSignalLongSymbol" SG_ 2147548059 DC_AC_Accessory_Inverter_1_AC_Si "DC_AC_Accessory_Inverter_1_AC_Si_RawPayload";
BA_ "SystemSignalLongSymbol" SG_ 2147548060 DC_AC_Accessory_Inverter_1_Confi "DC_AC_Accessory_Inverter_1_Confi_RawPayload";
BA_ "SystemSignalLongSymbol" SG_ 2147548061 DC_AC_Accessory_Inverter_1_Lifet "DC_AC_Accessory_Inverter_1_Lifet_RawPayload";
BA_ "SystemSignalLongSymbol" SG_ 2147548062 DC_AC_Accessory_Inverter_2_Tempe "DC_AC_Accessory_Inverter_2_Tempe_RawPayload";
BA_ "SystemSignalLongSymbol" SG_ 2147548063 DC_AC_Accessory_Inverter_2_DC_Si "DC_AC_Accessory_Inverter_2_DC_Si_RawPayload";
BA_ "SystemSignalLongSymbol" SG_ 2147548064 DC_AC_Accessory_Inverter_2_AC_Si "DC_AC_Accessory_Inverter_2_AC_Si_RawPayload";
BA_ "SystemSignalLongSymbol" SG_ 2147548065 DC_AC_Accessory_Inverter_2_Confi "DC_AC_Accessory_Inverter_2_Confi_RawPayload";
BA_ "SystemSignalLongSymbol" SG_ 2147548066 DC_AC_Accessory_Inverter_2_Lifet "DC_AC_Accessory_Inverter_2_Lifet_RawPayload";
BA_ "SystemSignalLongSymbol" SG_ 2147548067 DC_AC_Accessory_Inverter_3_Tempe "DC_AC_Accessory_Inverter_3_Tempe_RawPayload";
BA_ "SystemSignalLongSymbol" SG_ 2147548068 DC_AC_Accessory_Inverter_3_DC_Si "DC_AC_Accessory_Inverter_3_DC_Si_RawPayload";
BA_ "SystemSignalLongSymbol" SG_ 2147548069 DC_AC_Accessory_Inverter_3_AC_Si "DC_AC_Accessory_Inverter_3_AC_Si_RawPayload";
BA_ "SystemSignalLongSymbol" SG_ 2147548070 DC_AC_Accessory_Inverter_3_Confi "DC_AC_Accessory_Inverter_3_Confi_RawPayload";
BA_ "SystemSignalLongSymbol" SG_ 2147548071 DC_AC_Accessory_Inverter_3_Lifet "DC_AC_Accessory_Inverter_3_Lifet_RawPayload";
BA_ "SystemSignalLongSymbol" SG_ 2147548072 DC_AC_Accessory_Inverter_4_Tempe "DC_AC_Accessory_Inverter_4_Tempe_RawPayload";
BA_ "SystemSignalLongSymbol" SG_ 2147548073 DC_AC_Accessory_Inverter_4_DC_Si "DC_AC_Accessory_Inverter_4_DC_Si_RawPayload";
BA_ "SystemSignalLongSymbol" SG_ 2147548074 DC_AC_Accessory_Inverter_4_AC_Si "DC_AC_Accessory_Inverter_4_AC_Si_RawPayload";
BA_ "SystemSignalLongSymbol" SG_ 2147548075 DC_AC_Accessory_Inverter_4_Confi "DC_AC_Accessory_Inverter_4_Confi_RawPayload";
BA_ "SystemSignalLongSymbol" SG_ 2147548076 DC_AC_Accessory_Inverter_4_Lifet "DC_AC_Accessory_Inverter_4_Lifet_RawPayload";
BA_ "SystemSignalLongSymbol" SG_ 2147548077 DC_AC_Accessory_Inverter_5_Tempe "DC_AC_Accessory_Inverter_5_Tempe_RawPayload";
BA_ "SystemSignalLongSymbol" SG_ 2147548078 DC_AC_Accessory_Inverter_5_DC_Si "DC_AC_Accessory_Inverter_5_DC_Si_RawPayload";
BA_ "SystemSignalLongSymbol" SG_ 2147548079 DC_AC_Accessory_Inverter_5_AC_Si "DC_AC_Accessory_Inverter_5_AC_Si_RawPayload";
BA_ "SystemSignalLongSymbol" SG_ 2147548080 DC_AC_Accessory_Inverter_5_Confi "DC_AC_Accessory_Inverter_5_Confi_RawPayload";
BA_ "SystemSignalLongSymbol" SG_ 2147548081 DC_AC_Accessory_Inverter_5_Lifet "DC_AC_Accessory_Inverter_5_Lifet_RawPayload";
BA_ "SystemSignalLongSymbol" SG_ 2147548082 Well_Stimulation_Pump_Sensor_Cal "Well_Stimulation_Pump_Sensor_Cal_RawPayload";
BA_ "SystemSignalLongSymbol" SG_ 2147548083 Well_Stimulation_Pump_Fluid_Volu "Well_Stimulation_Pump_Fluid_Volu_RawPayload";
BA_ "SystemSignalLongSymbol" SG_ 2147548084 Well_Stimulation_Pump_Serial_Num "Well_Stimulation_Pump_Serial_Num_RawPayload";
BA_ "SystemSignalLongSymbol" SG_ 2147548085 Well_Stimulation_Pump_Trip_Hours "Well_Stimulation_Pump_Trip_Hours_RawPayload";
BA_ "SystemSignalLongSymbol" SG_ 2147548086 Aftertreatment_1_Outlet_Gas_4_Ra "Aftertreatment_1_Outlet_Gas_4_RawPayload";
BA_ "SystemSignalLongSymbol" SG_ 2147548087 Aftertreatment_1_Intake_Gas_4_Ra "Aftertreatment_1_Intake_Gas_4_RawPayload";
BA_ "SystemSignalLongSymbol" SG_ 2147548088 DC_DC_Converter_4_Lifetime_Data_ "DC_DC_Converter_4_Lifetime_Data_RawPayload";
BA_ "SystemSignalLongSymbol" SG_ 2147548089 DC_DC_Converter_4_Configuration_ "DC_DC_Converter_4_Configuration__RawPayload";
BA_ "SystemSignalLongSymbol" SG_ 2147548090 DC_DC_Converter_4_SLI_Battery_Li "DC_DC_Converter_4_SLI_Battery_Li_RawPayload";
BA_ "SystemSignalLongSymbol" SG_ 2147548091 DC_DC_Converter_4_Temperatures_R "DC_DC_Converter_4_Temperatures_RawPayload";
BA_ "SystemSignalLongSymbol" SG_ 2147548092 DC_DC_Converter_4_Low_Side_Limit "DC_DC_Converter_4_Low_Side_Limit_RawPayload";
BA_ "SystemSignalLongSymbol" SG_ 2147548093 DC_DC_Converter_4_High_Side_Limi "DC_DC_Converter_4_High_Side_Limi_RawPayload";
BA_ "SystemSignalLongSymbol" SG_ 2147548094 DC_DC_Converter_3_Lifetime_Data_ "DC_DC_Converter_3_Lifetime_Data_RawPayload";
BA_ "SystemSignalLongSymbol" SG_ 2147548095 DC_DC_Converter_3_Configuration_ "DC_DC_Converter_3_Configuration__RawPayload";
BA_ "SystemSignalLongSymbol" SG_ 2147548096 DC_DC_Converter_3_SLI_Battery_Li "DC_DC_Converter_3_SLI_Battery_Li_RawPayload";
BA_ "SystemSignalLongSymbol" SG_ 2147548097 DC_DC_Converter_3_Temperatures_R "DC_DC_Converter_3_Temperatures_RawPayload";
BA_ "SystemSignalLongSymbol" SG_ 2147548098 DC_DC_Converter_3_Low_Side_Limit "DC_DC_Converter_3_Low_Side_Limit_RawPayload";
BA_ "SystemSignalLongSymbol" SG_ 2147548099 DC_DC_Converter_3_High_Side_Limi "DC_DC_Converter_3_High_Side_Limi_RawPayload";
BA_ "SystemSignalLongSymbol" SG_ 2147548100 DC_DC_Converter_2_Lifetime_Data_ "DC_DC_Converter_2_Lifetime_Data_RawPayload";
BA_ "SystemSignalLongSymbol" SG_ 2147548101 DC_DC_Converter_2_Configuration_ "DC_DC_Converter_2_Configuration__RawPayload";
BA_ "SystemSignalLongSymbol" SG_ 2147548102 DC_DC_Converter_2_SLI_Battery_Li "DC_DC_Converter_2_SLI_Battery_Li_RawPayload";
BA_ "SystemSignalLongSymbol" SG_ 2147548103 DC_DC_Converter_2_Temperatures_R "DC_DC_Converter_2_Temperatures_RawPayload";
BA_ "SystemSignalLongSymbol" SG_ 2147548104 DC_DC_Converter_2_Low_Side_Limit "DC_DC_Converter_2_Low_Side_Limit_RawPayload";
BA_ "SystemSignalLongSymbol" SG_ 2147548105 DC_DC_Converter_2_High_Side_Limi "DC_DC_Converter_2_High_Side_Limi_RawPayload";
BA_ "SystemSignalLongSymbol" SG_ 2147548106 CiA_602_2_AUTOSAR_CAN_NM_Obsolet "CiA_602_2_AUTOSAR_CAN_NM_Obsolet_RawPayload";
