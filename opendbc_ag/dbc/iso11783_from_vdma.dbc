VERSION "created by canmatrix"

NS_ :

BS_:

BU_:

BO_ 2147548773 VDMA_FE65_General_Purpose_Messag: 8 Vector__XXX
 SG_ General_Purpose_Message_1_6_RawP : 0|64@1+ (1,0) [0|18446744073709551615] "" Vector__XXX

BO_ 2147548774 VDMA_FE66_Battery_Main_Switch_In: 8 Vector__XXX
 SG_ Battery_Main_Switch_Information_ : 0|64@1+ (1,0) [0|18446744073709551615] "" Vector__XXX

BO_ 2147548775 VDMA_FE67_Climate_Control_Config: 8 Vector__XXX
 SG_ Climate_Control_Configuration_Ra : 0|64@1+ (1,0) [0|18446744073709551615] "" Vector__XXX

BO_ 2147548776 VDMA_FE68_Vehicle_Fluids: 8 Vector__XXX
 SG_ Vehicle_Fluids_RawPayload : 0|64@1+ (1,0) [0|18446744073709551615] "" Vector__XXX

BO_ 2147548777 VDMA_FE69_Engine_Temperature_3: 8 Vector__XXX
 SG_ Engine_Temperature_3_RawPayload : 0|64@1+ (1,0) [0|18446744073709551615] "" Vector__XXX

BO_ 2147548778 VDMA_FE6A_Engine_Fuel_Lube_Syste: 8 Vector__XXX
 SG_ Engine_Fuel_Lube_Systems_RawPayl : 0|64@1+ (1,0) [0|18446744073709551615] "" Vector__XXX

BO_ 2147548779 VDMA_FE6B_Driver_s_Identificatio: 8 Vector__XXX
 SG_ Driver_s_Identification_RawPaylo : 0|64@1+ (1,0) [0|18446744073709551615] "" Vector__XXX

BO_ 2147548781 VDMA_FE6D_Heater_Information: 8 Vector__XXX
 SG_ Heater_Information_RawPayload : 0|64@1+ (1,0) [0|18446744073709551615] "" Vector__XXX

BO_ 2147548782 VDMA_FE6E_High_Resolution_Wheel_: 8 Vector__XXX
 SG_ High_Resolution_Wheel_Speed_RawP : 0|64@1+ (1,0) [0|18446744073709551615] "" Vector__XXX

BO_ 2147548783 VDMA_FE6F_Adaptive_Cruise_Contro: 8 Vector__XXX
 SG_ Adaptive_Cruise_Control_1_RawPay : 0|64@1+ (1,0) [0|18446744073709551615] "" Vector__XXX

BO_ 2147548784 VDMA_FE70_Combination_Vehicle_We: 8 Vector__XXX
 SG_ Combination_Vehicle_Weight_RawPa : 0|64@1+ (1,0) [0|18446744073709551615] "" Vector__XXX

BO_ 2147548785 VDMA_FE71_Laser_Tracer_Position: 8 Vector__XXX
 SG_ Laser_Tracer_Position_RawPayload : 0|64@1+ (1,0) [0|18446744073709551615] "" Vector__XXX

BO_ 2147548786 VDMA_FE72_Laser_Leveling_System_: 8 Vector__XXX
 SG_ Laser_Leveling_System_Blade_Cont : 0|64@1+ (1,0) [0|18446744073709551615] "" Vector__XXX

BO_ 2147548787 VDMA_FE73_Laser_Receiver_Mast_Po: 8 Vector__XXX
 SG_ Laser_Receiver_Mast_Position_Raw : 0|64@1+ (1,0) [0|18446744073709551615] "" Vector__XXX

BO_ 2147548788 VDMA_FE74_Modify_Leveling_System: 8 Vector__XXX
 SG_ Modify_Leveling_System_Control_S : 0|64@1+ (1,0) [0|18446744073709551615] "" Vector__XXX

BO_ 2147548789 VDMA_FE75_Laser_Leveling_System_: 8 Vector__XXX
 SG_ Laser_Leveling_System_Vertical_D : 0|64@1+ (1,0) [0|18446744073709551615] "" Vector__XXX

BO_ 2147548790 VDMA_FE76_Laser_Leveling_System_: 8 Vector__XXX
 SG_ Laser_Leveling_System_Vertical_P : 0|64@1+ (1,0) [0|18446744073709551615] "" Vector__XXX

BO_ 2147548791 VDMA_FE77_Auxiliary_Pressures: 8 Vector__XXX
 SG_ Auxiliary_Pressures_RawPayload : 0|64@1+ (1,0) [0|18446744073709551615] "" Vector__XXX

BO_ 2147548792 VDMA_FE78_Tire_Pressure_Control_: 8 Vector__XXX
 SG_ Tire_Pressure_Control_Unit_Mode_ : 0|64@1+ (1,0) [0|18446744073709551615] "" Vector__XXX

BO_ 2147548793 VDMA_FE79_Tire_Pressure_Control_: 8 Vector__XXX
 SG_ Tire_Pressure_Control_Unit_Targe : 0|64@1+ (1,0) [0|18446744073709551615] "" Vector__XXX

BO_ 2147548794 VDMA_FE7A_Tire_Pressure_Control_: 8 Vector__XXX
 SG_ Tire_Pressure_Control_Unit_Curre : 0|64@1+ (1,0) [0|18446744073709551615] "" Vector__XXX

BO_ 2147548795 VDMA_FE7B_Combustion_Time_1: 8 Vector__XXX
 SG_ Combustion_Time_1_RawPayload : 0|64@1+ (1,0) [0|18446744073709551615] "" Vector__XXX

BO_ 2147548796 VDMA_FE7C_Combustion_Time_2: 8 Vector__XXX
 SG_ Combustion_Time_2_RawPayload : 0|64@1+ (1,0) [0|18446744073709551615] "" Vector__XXX

BO_ 2147548797 VDMA_FE7D_Combustion_Time_3: 8 Vector__XXX
 SG_ Combustion_Time_3_RawPayload : 0|64@1+ (1,0) [0|18446744073709551615] "" Vector__XXX

BO_ 2147548798 VDMA_FE7E_Combustion_Time_4: 8 Vector__XXX
 SG_ Combustion_Time_4_RawPayload : 0|64@1+ (1,0) [0|18446744073709551615] "" Vector__XXX

BO_ 2147548799 VDMA_FE7F_Combustion_Time_5: 8 Vector__XXX
 SG_ Combustion_Time_5_RawPayload : 0|64@1+ (1,0) [0|18446744073709551615] "" Vector__XXX

BO_ 2147548800 VDMA_FE80_Combustion_Time_6: 8 Vector__XXX
 SG_ Combustion_Time_6_RawPayload : 0|64@1+ (1,0) [0|18446744073709551615] "" Vector__XXX

BO_ 2147548801 VDMA_FE81_Fuel_Information_2_Gas: 8 Vector__XXX
 SG_ Fuel_Information_2_Gaseous_RawPa : 0|64@1+ (1,0) [0|18446744073709551615] "" Vector__XXX

BO_ 2147548802 VDMA_FE82_Ignition_Timing_1: 8 Vector__XXX
 SG_ Ignition_Timing_1_RawPayload : 0|64@1+ (1,0) [0|18446744073709551615] "" Vector__XXX

BO_ 2147548803 VDMA_FE83_Ignition_Timing_2: 8 Vector__XXX
 SG_ Ignition_Timing_2_RawPayload : 0|64@1+ (1,0) [0|18446744073709551615] "" Vector__XXX

BO_ 2147548804 VDMA_FE84_Ignition_Timing_3: 8 Vector__XXX
 SG_ Ignition_Timing_3_RawPayload : 0|64@1+ (1,0) [0|18446744073709551615] "" Vector__XXX

BO_ 2147548805 VDMA_FE85_Ignition_Timing_4: 8 Vector__XXX
 SG_ Ignition_Timing_4_RawPayload : 0|64@1+ (1,0) [0|18446744073709551615] "" Vector__XXX

BO_ 2147548806 VDMA_FE86_Ignition_Timing_5: 8 Vector__XXX
 SG_ Ignition_Timing_5_RawPayload : 0|64@1+ (1,0) [0|18446744073709551615] "" Vector__XXX

BO_ 2147548807 VDMA_FE87_Ignition_Timing_6: 8 Vector__XXX
 SG_ Ignition_Timing_6_RawPayload : 0|64@1+ (1,0) [0|18446744073709551615] "" Vector__XXX

BO_ 2147548808 VDMA_FE88_Ignition_Transformer_S: 8 Vector__XXX
 SG_ Ignition_Transformer_Secondary_O : 0|64@1+ (1,0) [0|18446744073709551615] "" Vector__XXX

BO_ 2147548809 VDMA_FE89_Ignition_Transformer_S: 8 Vector__XXX
 SG_ Ignition_Transformer_Secondary_O : 0|64@1+ (1,0) [0|18446744073709551615] "" Vector__XXX

BO_ 2147548810 VDMA_FE8A_Ignition_Transformer_S: 8 Vector__XXX
 SG_ Ignition_Transformer_Secondary_O : 0|64@1+ (1,0) [0|18446744073709551615] "" Vector__XXX

BO_ 2147548811 VDMA_FE8B_Gaseous_Fuel_Pressure_: 8 Vector__XXX
 SG_ Gaseous_Fuel_Pressure_1_RawPaylo : 0|64@1+ (1,0) [0|18446744073709551615] "" Vector__XXX

BO_ 2147548812 VDMA_FE8C_Auxiliary_Analog_Infor: 8 Vector__XXX
 SG_ Auxiliary_Analog_Information_Raw : 0|64@1+ (1,0) [0|18446744073709551615] "" Vector__XXX

BO_ 2147548813 VDMA_FE8D_Vehicle_Electrical_Pow: 8 Vector__XXX
 SG_ Vehicle_Electrical_Power_2_RawPa : 0|64@1+ (1,0) [0|18446744073709551615] "" Vector__XXX

BO_ 2147548814 VDMA_FE8E_Service_2: 8 Vector__XXX
 SG_ Service_2_RawPayload : 0|64@1+ (1,0) [0|18446744073709551615] "" Vector__XXX

BO_ 2147548815 VDMA_FE8F_Supply_Pressure_2: 8 Vector__XXX
 SG_ Supply_Pressure_2_RawPayload : 0|64@1+ (1,0) [0|18446744073709551615] "" Vector__XXX

BO_ 2147548816 VDMA_FE90_Engine_Torque_History: 8 Vector__XXX
 SG_ Engine_Torque_History_RawPayload : 0|64@1+ (1,0) [0|18446744073709551615] "" Vector__XXX

BO_ 2147548817 VDMA_FE91_Fuel_Leakage: 8 Vector__XXX
 SG_ Fuel_Leakage_RawPayload : 0|64@1+ (1,0) [0|18446744073709551615] "" Vector__XXX

BO_ 2147548818 VDMA_FE92_Engine_Information_1: 8 Vector__XXX
 SG_ Engine_Information_1_RawPayload : 0|64@1+ (1,0) [0|18446744073709551615] "" Vector__XXX

BO_ 2147548819 VDMA_FE93_Engine_Electrical_Syst: 8 Vector__XXX
 SG_ Engine_Electrical_System_Module_ : 0|64@1+ (1,0) [0|18446744073709551615] "" Vector__XXX

BO_ 2147548820 VDMA_FE94_Engine_Auxiliary_Coola: 8 Vector__XXX
 SG_ Engine_Auxiliary_Coolant_RawPayl : 0|64@1+ (1,0) [0|18446744073709551615] "" Vector__XXX

BO_ 2147548821 VDMA_FE95_Rebuild_Information: 8 Vector__XXX
 SG_ Rebuild_Information_RawPayload : 0|64@1+ (1,0) [0|18446744073709551615] "" Vector__XXX

BO_ 2147548822 VDMA_FE96_Turbocharger_Wastegate: 8 Vector__XXX
 SG_ Turbocharger_Wastegate_RawPayloa : 0|64@1+ (1,0) [0|18446744073709551615] "" Vector__XXX

BO_ 2147548823 VDMA_FE97_Turbocharger_Informati: 8 Vector__XXX
 SG_ Turbocharger_Information_5_RawPa : 0|64@1+ (1,0) [0|18446744073709551615] "" Vector__XXX

BO_ 2147548824 VDMA_FE98_Turbocharger_Informati: 8 Vector__XXX
 SG_ Turbocharger_Information_4_RawPa : 0|64@1+ (1,0) [0|18446744073709551615] "" Vector__XXX

BO_ 2147548825 VDMA_FE99_Turbocharger_Informati: 8 Vector__XXX
 SG_ Turbocharger_Information_3_RawPa : 0|64@1+ (1,0) [0|18446744073709551615] "" Vector__XXX

BO_ 2147548826 VDMA_FE9A_Turbocharger_Informati: 8 Vector__XXX
 SG_ Turbocharger_Information_2_RawPa : 0|64@1+ (1,0) [0|18446744073709551615] "" Vector__XXX

BO_ 2147548827 VDMA_FE9B_Turbocharger_Informati: 8 Vector__XXX
 SG_ Turbocharger_Information_1_RawPa : 0|64@1+ (1,0) [0|18446744073709551615] "" Vector__XXX

BO_ 2147548828 VDMA_FE9C_Main_Bearing_Temperatu: 8 Vector__XXX
 SG_ Main_Bearing_Temperature_3_RawPa : 0|64@1+ (1,0) [0|18446744073709551615] "" Vector__XXX

BO_ 2147548829 VDMA_FE9D_Main_Bearing_Temperatu: 8 Vector__XXX
 SG_ Main_Bearing_Temperature_2_RawPa : 0|64@1+ (1,0) [0|18446744073709551615] "" Vector__XXX

BO_ 2147548830 VDMA_FE9E_Main_Bearing_Temperatu: 8 Vector__XXX
 SG_ Main_Bearing_Temperature_1_RawPa : 0|64@1+ (1,0) [0|18446744073709551615] "" Vector__XXX

BO_ 2147548831 VDMA_FE9F_Exhaust_Port_Temperatu: 8 Vector__XXX
 SG_ Exhaust_Port_Temperature_5_RawPa : 0|64@1+ (1,0) [0|18446744073709551615] "" Vector__XXX

BO_ 2147548832 VDMA_FEA0_Exhaust_Port_Temperatu: 8 Vector__XXX
 SG_ Exhaust_Port_Temperature_4_RawPa : 0|64@1+ (1,0) [0|18446744073709551615] "" Vector__XXX

BO_ 2147548833 VDMA_FEA1_Exhaust_Port_Temperatu: 8 Vector__XXX
 SG_ Exhaust_Port_Temperature_3_RawPa : 0|64@1+ (1,0) [0|18446744073709551615] "" Vector__XXX

BO_ 2147548834 VDMA_FEA2_Exhaust_Port_Temperatu: 8 Vector__XXX
 SG_ Exhaust_Port_Temperature_2_RawPa : 0|64@1+ (1,0) [0|18446744073709551615] "" Vector__XXX

BO_ 2147548835 VDMA_FEA3_Exhaust_Port_Temperatu: 8 Vector__XXX
 SG_ Exhaust_Port_Temperature_1_RawPa : 0|64@1+ (1,0) [0|18446744073709551615] "" Vector__XXX

BO_ 2147548836 VDMA_FEA4_Engine_Temperature_2: 8 Vector__XXX
 SG_ Engine_Temperature_2_RawPayload : 0|64@1+ (1,0) [0|18446744073709551615] "" Vector__XXX

BO_ 2147548837 VDMA_FEA5_Intake_Manifold_Inform: 8 Vector__XXX
 SG_ Intake_Manifold_Information_2_Ra : 0|64@1+ (1,0) [0|18446744073709551615] "" Vector__XXX

BO_ 2147548838 VDMA_FEA6_Intake_Manifold_Inform: 8 Vector__XXX
 SG_ Intake_Manifold_Information_1_Ra : 0|64@1+ (1,0) [0|18446744073709551615] "" Vector__XXX

BO_ 2147548839 VDMA_FEA7_Alternator_Temperature: 8 Vector__XXX
 SG_ Alternator_Temperature_1_RawPayl : 0|64@1+ (1,0) [0|18446744073709551615] "" Vector__XXX

BO_ 2147548840 VDMA_FEA8_Articulation_Control: 8 Vector__XXX
 SG_ Articulation_Control_RawPayload : 0|64@1+ (1,0) [0|18446744073709551615] "" Vector__XXX

BO_ 2147548841 VDMA_FEA9_Exhaust_Oxygen_1: 8 Vector__XXX
 SG_ Exhaust_Oxygen_1_RawPayload : 0|64@1+ (1,0) [0|18446744073709551615] "" Vector__XXX

BO_ 2147548842 VDMA_FEAA_Alternate_Fuel_2: 8 Vector__XXX
 SG_ Alternate_Fuel_2_RawPayload : 0|64@1+ (1,0) [0|18446744073709551615] "" Vector__XXX

BO_ 2147548843 VDMA_FEAB_Electronic_Transmissio: 8 Vector__XXX
 SG_ Electronic_Transmission_Controll : 0|64@1+ (1,0) [0|18446744073709551615] "" Vector__XXX

BO_ 2147548844 VDMA_FEAC_Wheel_Brake_Lining_Rem: 8 Vector__XXX
 SG_ Wheel_Brake_Lining_Remaining_Inf : 0|64@1+ (1,0) [0|18446744073709551615] "" Vector__XXX

BO_ 2147548845 VDMA_FEAD_Wheel_Application_Pres: 8 Vector__XXX
 SG_ Wheel_Application_Pressure_High_ : 0|64@1+ (1,0) [0|18446744073709551615] "" Vector__XXX

BO_ 2147548846 VDMA_FEAE_Air_Supply_Pressure: 8 Vector__XXX
 SG_ Air_Supply_Pressure_RawPayload : 0|64@1+ (1,0) [0|18446744073709551615] "" Vector__XXX

BO_ 2147548847 VDMA_FEAF_Fuel_Consumption_Gaseo: 8 Vector__XXX
 SG_ Fuel_Consumption_Gaseous_RawPayl : 0|64@1+ (1,0) [0|18446744073709551615] "" Vector__XXX

BO_ 2147548848 VDMA_FEB0_Trip_Time_Information_: 8 Vector__XXX
 SG_ Trip_Time_Information_2_RawPaylo : 0|64@1+ (1,0) [0|18446744073709551615] "" Vector__XXX

BO_ 2147548849 VDMA_FEB1_ECU_History: 8 Vector__XXX
 SG_ ECU_History_RawPayload : 0|64@1+ (1,0) [0|18446744073709551615] "" Vector__XXX

BO_ 2147548850 VDMA_FEB2_Fuel_Information_1_Gas: 8 Vector__XXX
 SG_ Fuel_Information_1_Gaseous_RawPa : 0|64@1+ (1,0) [0|18446744073709551615] "" Vector__XXX

BO_ 2147548851 VDMA_FEB3_Fuel_Information_1_Liq: 8 Vector__XXX
 SG_ Fuel_Information_1_Liquid_RawPay : 0|64@1+ (1,0) [0|18446744073709551615] "" Vector__XXX

BO_ 2147548852 VDMA_FEB4_Trip_Time_Information_: 8 Vector__XXX
 SG_ Trip_Time_Information_1_RawPaylo : 0|64@1+ (1,0) [0|18446744073709551615] "" Vector__XXX

BO_ 2147548853 VDMA_FEB5_Trip_Shutdown_Informat: 8 Vector__XXX
 SG_ Trip_Shutdown_Information_RawPay : 0|64@1+ (1,0) [0|18446744073709551615] "" Vector__XXX

BO_ 2147548854 VDMA_FEB6_Trip_Vehicle_Speed_Cru: 8 Vector__XXX
 SG_ Trip_Vehicle_Speed_Cruise_Distan : 0|64@1+ (1,0) [0|18446744073709551615] "" Vector__XXX

BO_ 2147548855 VDMA_FEB7_Engine_Speed_Load_Fact: 8 Vector__XXX
 SG_ Engine_Speed_Load_Factor_Informa : 0|64@1+ (1,0) [0|18446744073709551615] "" Vector__XXX

BO_ 2147548856 VDMA_FEB8_Trip_Fuel_Information_: 8 Vector__XXX
 SG_ Trip_Fuel_Information_Gaseous_Ra : 0|64@1+ (1,0) [0|18446744073709551615] "" Vector__XXX

BO_ 2147548857 VDMA_FEB9_Trip_Fuel_Information_: 8 Vector__XXX
 SG_ Trip_Fuel_Information_Liquid_Raw : 0|64@1+ (1,0) [0|18446744073709551615] "" Vector__XXX

BO_ 2147548858 VDMA_FEBA_Trip_Distance_Informat: 8 Vector__XXX
 SG_ Trip_Distance_Information_RawPay : 0|64@1+ (1,0) [0|18446744073709551615] "" Vector__XXX

BO_ 2147548859 VDMA_FEBB_Trip_Fan_Information: 8 Vector__XXX
 SG_ Trip_Fan_Information_RawPayload : 0|64@1+ (1,0) [0|18446744073709551615] "" Vector__XXX

BO_ 2147548860 VDMA_FEBC_Compression_Service_Br: 8 Vector__XXX
 SG_ Compression_Service_Brake_Inform : 0|64@1+ (1,0) [0|18446744073709551615] "" Vector__XXX

BO_ 2147548861 VDMA_FEBD_Fan_Drive_1: 8 Vector__XXX
 SG_ Fan_Drive_1_RawPayload : 0|64@1+ (1,0) [0|18446744073709551615] "" Vector__XXX

BO_ 2147548862 VDMA_FEBE_Electronic_Engine_Cont: 8 Vector__XXX
 SG_ Electronic_Engine_Controller_4_R : 0|64@1+ (1,0) [0|18446744073709551615] "" Vector__XXX

BO_ 2147548863 VDMA_FEBF_Wheel_Speed_Informatio: 8 Vector__XXX
 SG_ Wheel_Speed_Information_RawPaylo : 0|64@1+ (1,0) [0|18446744073709551615] "" Vector__XXX

BO_ 2147548864 VDMA_FEC0_Service_Information: 8 Vector__XXX
 SG_ Service_Information_RawPayload : 0|64@1+ (1,0) [0|18446744073709551615] "" Vector__XXX

BO_ 2147548865 VDMA_FEC1_High_Resolution_Vehicl: 8 Vector__XXX
 SG_ High_Resolution_Vehicle_Distance : 0|64@1+ (1,0) [0|18446744073709551615] "" Vector__XXX

BO_ 2147548866 VDMA_FEC2_Electronic_Retarder_Co: 8 Vector__XXX
 SG_ Electronic_Retarder_Controller_2 : 0|64@1+ (1,0) [0|18446744073709551615] "" Vector__XXX

BO_ 2147548867 VDMA_FEC3_Electronic_Transmissio: 8 Vector__XXX
 SG_ Electronic_Transmission_Controll : 0|64@1+ (1,0) [0|18446744073709551615] "" Vector__XXX

BO_ 2147548868 VDMA_FEC4_Electronic_Brake_Syste: 8 Vector__XXX
 SG_ Electronic_Brake_System_2_2_RawP : 0|64@1+ (1,0) [0|18446744073709551615] "" Vector__XXX

BO_ 2147548869 VDMA_FEC5_Electronic_Transmissio: 8 Vector__XXX
 SG_ Electronic_Transmission_Controll : 0|64@1+ (1,0) [0|18446744073709551615] "" Vector__XXX

BO_ 2147548870 VDMA_FEC6_Electronic_Brake_Syste: 8 Vector__XXX
 SG_ Electronic_Brake_System_2_3_RawP : 0|64@1+ (1,0) [0|18446744073709551615] "" Vector__XXX

BO_ 2147548871 VDMA_FEC7_Electronic_Transmissio: 8 Vector__XXX
 SG_ Electronic_Transmission_Controll : 0|64@1+ (1,0) [0|18446744073709551615] "" Vector__XXX

BO_ 2147548872 VDMA_FEC8_General_Purpose_Messag: 8 Vector__XXX
 SG_ General_Purpose_Message_2_2_RawP : 0|64@1+ (1,0) [0|18446744073709551615] "" Vector__XXX

BO_ 2147548873 VDMA_FEC9_Electronic_Brake_Syste: 8 Vector__XXX
 SG_ Electronic_Brake_System_1_2_RawP : 0|64@1+ (1,0) [0|18446744073709551615] "" Vector__XXX

BO_ 2147548877 VDMA_FECD_Freeze_Frame_Parameter: 8 Vector__XXX
 SG_ Freeze_Frame_Parameters_RawPaylo : 0|64@1+ (1,0) [0|18446744073709551615] "" Vector__XXX

BO_ 2147548878 VDMA_FECE_Diagnostic_Readiness_1: 8 Vector__XXX
 SG_ Diagnostic_Readiness_1_RawPayloa : 0|64@1+ (1,0) [0|18446744073709551615] "" Vector__XXX

BO_ 2147548879 VDMA_FECF_Emission_Related_Pendi: 8 Vector__XXX
 SG_ Emission_Related_Pending_Diagnos : 0|64@1+ (1,0) [0|18446744073709551615] "" Vector__XXX

BO_ 2147548880 VDMA_FED0_Test_Results_for_Non_c: 8 Vector__XXX
 SG_ Test_Results_for_Non_continuousl : 0|64@1+ (1,0) [0|18446744073709551615] "" Vector__XXX

BO_ 2147548881 VDMA_FED1_Oxygen_Sensor_Test_Res: 8 Vector__XXX
 SG_ Oxygen_Sensor_Test_Results_RawPa : 0|64@1+ (1,0) [0|18446744073709551615] "" Vector__XXX

BO_ 2147548882 VDMA_FED2_Non_Continuously_Monit: 8 Vector__XXX
 SG_ Non_Continuously_Monitored_Syste : 0|64@1+ (1,0) [0|18446744073709551615] "" Vector__XXX

BO_ 2147548884 VDMA_FED4_Emission_Related_MIL_O: 8 Vector__XXX
 SG_ Emission_Related_MIL_On_Diagnost : 0|64@1+ (1,0) [0|18446744073709551615] "" Vector__XXX

BO_ 2147548885 VDMA_FED5_Alternator_Information: 8 Vector__XXX
 SG_ Alternator_Information_1_RawPayl : 0|64@1+ (1,0) [0|18446744073709551615] "" Vector__XXX

BO_ 2147548886 VDMA_FED6_Hybrid_or_EV_System_In: 8 Vector__XXX
 SG_ Hybrid_or_EV_System_Inputs_1_Raw : 0|64@1+ (1,0) [0|18446744073709551615] "" Vector__XXX

BO_ 2147548889 VDMA_FED9_Auxiliary_Input_Output: 8 Vector__XXX
 SG_ Auxiliary_Input_Output_Status_1_ : 0|64@1+ (1,0) [0|18446744073709551615] "" Vector__XXX

BO_ 2147548891 VDMA_FEDB_Engine_Fluid_Level_Pre: 8 Vector__XXX
 SG_ Engine_Fluid_Level_Pressure_2_Ra : 0|64@1+ (1,0) [0|18446744073709551615] "" Vector__XXX

BO_ 2147548892 VDMA_FEDC_Idle_Operation: 8 Vector__XXX
 SG_ Idle_Operation_RawPayload : 0|64@1+ (1,0) [0|18446744073709551615] "" Vector__XXX

BO_ 2147548893 VDMA_FEDD_Turbocharger: 8 Vector__XXX
 SG_ Turbocharger_RawPayload : 0|64@1+ (1,0) [0|18446744073709551615] "" Vector__XXX

BO_ 2147548894 VDMA_FEDE_Engine_Air_Start_Press: 8 Vector__XXX
 SG_ Engine_Air_Start_Pressure_RawPay : 0|64@1+ (1,0) [0|18446744073709551615] "" Vector__XXX

BO_ 2147548896 VDMA_FEE0_Vehicle_Distance: 8 Vector__XXX
 SG_ Vehicle_Distance_RawPayload : 0|64@1+ (1,0) [0|18446744073709551615] "" Vector__XXX

BO_ 2147548897 VDMA_FEE1_Retarder_Configuration: 8 Vector__XXX
 SG_ Retarder_Configuration_RawPayloa : 0|64@1+ (1,0) [0|18446744073709551615] "" Vector__XXX

BO_ 2147548898 VDMA_FEE2_Transmission_Configura: 8 Vector__XXX
 SG_ Transmission_Configuration_RawPa : 0|64@1+ (1,0) [0|18446744073709551615] "" Vector__XXX

BO_ 2147548900 VDMA_FEE4_Shutdown: 8 Vector__XXX
 SG_ Shutdown_RawPayload : 0|64@1+ (1,0) [0|18446744073709551615] "" Vector__XXX

BO_ 2147548903 VDMA_FEE7_Vehicle_Hours: 8 Vector__XXX
 SG_ Vehicle_Hours_RawPayload : 0|64@1+ (1,0) [0|18446744073709551615] "" Vector__XXX

BO_ 2147548904 VDMA_FEE8_Vehicle_Direction_Spee: 8 Vector__XXX
 SG_ Vehicle_Direction_Speed_RawPaylo : 0|64@1+ (1,0) [0|18446744073709551615] "" Vector__XXX

BO_ 2147548905 VDMA_FEE9_Fuel_Consumption_Liqui: 8 Vector__XXX
 SG_ Fuel_Consumption_Liquid_1_RawPay : 0|64@1+ (1,0) [0|18446744073709551615] "" Vector__XXX

BO_ 2147548906 VDMA_FEEA_Vehicle_Weight: 8 Vector__XXX
 SG_ Vehicle_Weight_RawPayload : 0|64@1+ (1,0) [0|18446744073709551615] "" Vector__XXX

BO_ 2147548909 VDMA_FEED_Cruise_Control_Vehicle: 8 Vector__XXX
 SG_ Cruise_Control_Vehicle_Speed_Set : 0|64@1+ (1,0) [0|18446744073709551615] "" Vector__XXX

BO_ 2147548912 VDMA_FEF0_Power_Takeoff_Informat: 8 Vector__XXX
 SG_ Power_Takeoff_Information_1_RawP : 0|64@1+ (1,0) [0|18446744073709551615] "" Vector__XXX

BO_ 2147548915 VDMA_FEF3_Vehicle_Position_1: 8 Vector__XXX
 SG_ Vehicle_Position_1_RawPayload : 0|64@1+ (1,0) [0|18446744073709551615] "" Vector__XXX

BO_ 2147548916 VDMA_FEF4_Tire_Condition_Message: 8 Vector__XXX
 SG_ Tire_Condition_Message_1_RawPayl : 0|64@1+ (1,0) [0|18446744073709551615] "" Vector__XXX

BO_ 2147548917 VDMA_FEF5_Ambient_Conditions: 8 Vector__XXX
 SG_ Ambient_Conditions_RawPayload : 0|64@1+ (1,0) [0|18446744073709551615] "" Vector__XXX

BO_ 2147548921 VDMA_FEF9_Axle_Information: 8 Vector__XXX
 SG_ Axle_Information_RawPayload : 0|64@1+ (1,0) [0|18446744073709551615] "" Vector__XXX

BO_ 2147548922 VDMA_FEFA_Brakes_1: 8 Vector__XXX
 SG_ Brakes_1_RawPayload : 0|64@1+ (1,0) [0|18446744073709551615] "" Vector__XXX

BO_ 2147548923 VDMA_FEFB_Retarder_fluids: 8 Vector__XXX
 SG_ Retarder_fluids_RawPayload : 0|64@1+ (1,0) [0|18446744073709551615] "" Vector__XXX

BO_ 2147548924 VDMA_FEFC_Dash_Display_1: 8 Vector__XXX
 SG_ Dash_Display_1_RawPayload : 0|64@1+ (1,0) [0|18446744073709551615] "" Vector__XXX

BO_ 2147548925 VDMA_FEFD_Alternate_Fuel_1: 8 Vector__XXX
 SG_ Alternate_Fuel_1_RawPayload : 0|64@1+ (1,0) [0|18446744073709551615] "" Vector__XXX

BO_ 2147548926 VDMA_FEFE_Auxiliary_Water_Pump_P: 8 Vector__XXX
 SG_ Auxiliary_Water_Pump_Pressure_Ra : 0|64@1+ (1,0) [0|18446744073709551615] "" Vector__XXX

BO_ 2147548927 VDMA_FEFF_Operator_indicators: 8 Vector__XXX
 SG_ Operator_indicators_RawPayload : 0|64@1+ (1,0) [0|18446744073709551615] "" Vector__XXX

BO_ 2147609856 VDMA_1ED00_NMEA_Request_Command_: 8 Vector__XXX
 SG_ NMEA_Request_Command_Acknowledge : 0|64@1+ (1,0) [0|18446744073709551615] "" Vector__XXX

BO_ 2147610112 VDMA_1EE00_PGN_List_Transmit_Rec: 8 Vector__XXX
 SG_ PGN_List_Transmit_Receive_PGN_s_ : 0|64@1+ (1,0) [0|18446744073709551615] "" Vector__XXX

BO_ 2147610631 VDMA_1F007_Alert: 8 Vector__XXX
 SG_ Alert_RawPayload : 0|64@1+ (1,0) [0|18446744073709551615] "" Vector__XXX

BO_ 2147610632 VDMA_1F008_Alert_Response: 8 Vector__XXX
 SG_ Alert_Response_RawPayload : 0|64@1+ (1,0) [0|18446744073709551615] "" Vector__XXX

BO_ 2147610633 VDMA_1F009_Alert_Text: 8 Vector__XXX
 SG_ Alert_Text_RawPayload : 0|64@1+ (1,0) [0|18446744073709551615] "" Vector__XXX

BO_ 2147610634 VDMA_1F00A_Alert_Configuration: 8 Vector__XXX
 SG_ Alert_Configuration_RawPayload : 0|64@1+ (1,0) [0|18446744073709551615] "" Vector__XXX

BO_ 2147610635 VDMA_1F00B_Alert_Threshold: 8 Vector__XXX
 SG_ Alert_Threshold_RawPayload : 0|64@1+ (1,0) [0|18446744073709551615] "" Vector__XXX

BO_ 2147610636 VDMA_1F00C_Alert_Value: 8 Vector__XXX
 SG_ Alert_Value_RawPayload : 0|64@1+ (1,0) [0|18446744073709551615] "" Vector__XXX

BO_ 2147610640 VDMA_1F010_System_Time: 8 Vector__XXX
 SG_ System_Time_RawPayload : 0|64@1+ (1,0) [0|18446744073709551615] "" Vector__XXX

BO_ 2147610641 VDMA_1F011_Heartbeat: 8 Vector__XXX
 SG_ Heartbeat_RawPayload : 0|64@1+ (1,0) [0|18446744073709551615] "" Vector__XXX

BO_ 2147610644 VDMA_1F014_Product_Information: 8 Vector__XXX
 SG_ Product_Information_RawPayload : 0|64@1+ (1,0) [0|18446744073709551615] "" Vector__XXX

BO_ 2147610646 VDMA_1F016_Configuration_Informa: 8 Vector__XXX
 SG_ Configuration_Information_RawPay : 0|64@1+ (1,0) [0|18446744073709551615] "" Vector__XXX

BO_ 2147610649 VDMA_1F019_Cyclic_Alert_List_IEC: 8 Vector__XXX
 SG_ Cyclic_Alert_List_IEC_61924_2_Ra : 0|64@1+ (1,0) [0|18446744073709551615] "" Vector__XXX

BO_ 2147610650 VDMA_1F01A_Responsibility_Transf: 8 Vector__XXX
 SG_ Responsibility_Transfer_Function : 0|64@1+ (1,0) [0|18446744073709551615] "" Vector__XXX

BO_ 2147610881 VDMA_1F101_Man_Overboard_Notific: 8 Vector__XXX
 SG_ Man_Overboard_Notification_MOB_R : 0|64@1+ (1,0) [0|18446744073709551615] "" Vector__XXX

BO_ 2147610885 VDMA_1F105_Heading_Track_Control: 8 Vector__XXX
 SG_ Heading_Track_Control_RawPayload : 0|64@1+ (1,0) [0|18446744073709551615] "" Vector__XXX

BO_ 2147610893 VDMA_1F10D_Rudder: 8 Vector__XXX
 SG_ Rudder_RawPayload : 0|64@1+ (1,0) [0|18446744073709551615] "" Vector__XXX

BO_ 2147610900 VDMA_1F114_Heave: 8 Vector__XXX
 SG_ Heave_RawPayload : 0|64@1+ (1,0) [0|18446744073709551615] "" Vector__XXX

BO_ 2147610905 VDMA_1F119_Attitude: 8 Vector__XXX
 SG_ Attitude_RawPayload : 0|64@1+ (1,0) [0|18446744073709551615] "" Vector__XXX

BO_ 2147610906 VDMA_1F11A_Magnetic_Variation: 8 Vector__XXX
 SG_ Magnetic_Variation_RawPayload : 0|64@1+ (1,0) [0|18446744073709551615] "" Vector__XXX

BO_ 2147611136 VDMA_1F200_Engine_Parameters_Rap: 8 Vector__XXX
 SG_ Engine_Parameters_Rapid_Update_R : 0|64@1+ (1,0) [0|18446744073709551615] "" Vector__XXX

BO_ 2147611137 VDMA_1F201_Engine_Parameters_Dyn: 8 Vector__XXX
 SG_ Engine_Parameters_Dynamic_RawPay : 0|64@1+ (1,0) [0|18446744073709551615] "" Vector__XXX

BO_ 2147611138 VDMA_1F202_Electric_Drive_Status: 8 Vector__XXX
 SG_ Electric_Drive_Status_Dynamic_Ra : 0|64@1+ (1,0) [0|18446744073709551615] "" Vector__XXX

BO_ 2147611139 VDMA_1F203_Electric_Energy_Stora: 8 Vector__XXX
 SG_ Electric_Energy_Storage_Status_D : 0|64@1+ (1,0) [0|18446744073709551615] "" Vector__XXX

BO_ 2147611141 VDMA_1F205_Transmission_Paramete: 8 Vector__XXX
 SG_ Transmission_Parameters_Dynamic_ : 0|64@1+ (1,0) [0|18446744073709551615] "" Vector__XXX

BO_ 2147611142 VDMA_1F206_Electric_Drive_Inform: 8 Vector__XXX
 SG_ Electric_Drive_Information_RawPa : 0|64@1+ (1,0) [0|18446744073709551615] "" Vector__XXX

BO_ 2147611143 VDMA_1F207_Electric_Energy_Stora: 8 Vector__XXX
 SG_ Electric_Energy_Storage_Informat : 0|64@1+ (1,0) [0|18446744073709551615] "" Vector__XXX

BO_ 2147611144 VDMA_1F208_Trip_Parameters_Vesse: 8 Vector__XXX
 SG_ Trip_Parameters_Vessel_RawPayloa : 0|64@1+ (1,0) [0|18446744073709551615] "" Vector__XXX

BO_ 2147611145 VDMA_1F209_Trip_Parameters_Small: 8 Vector__XXX
 SG_ Trip_Parameters_Small_Craft_RawP : 0|64@1+ (1,0) [0|18446744073709551615] "" Vector__XXX

BO_ 2147611146 VDMA_1F20A_Engine_Parameters_Sta: 8 Vector__XXX
 SG_ Engine_Parameters_Static_RawPayl : 0|64@1+ (1,0) [0|18446744073709551615] "" Vector__XXX

BO_ 2147611148 VDMA_1F20C_Load_Controller_Conne: 8 Vector__XXX
 SG_ Load_Controller_Connection_State : 0|64@1+ (1,0) [0|18446744073709551615] "" Vector__XXX

BO_ 2147611149 VDMA_1F20D_Binary_Switch_Bank_St: 8 Vector__XXX
 SG_ Binary_Switch_Bank_Status_RawPay : 0|64@1+ (1,0) [0|18446744073709551615] "" Vector__XXX

BO_ 2147611150 VDMA_1F20E_Switch_Bank_Control: 8 Vector__XXX
 SG_ Switch_Bank_Control_RawPayload : 0|64@1+ (1,0) [0|18446744073709551615] "" Vector__XXX

BO_ 2147611151 VDMA_1F20F_AC_Input_Status: 8 Vector__XXX
 SG_ AC_Input_Status_RawPayload : 0|64@1+ (1,0) [0|18446744073709551615] "" Vector__XXX

BO_ 2147611152 VDMA_1F210_AC_Output_Status: 8 Vector__XXX
 SG_ AC_Output_Status_RawPayload : 0|64@1+ (1,0) [0|18446744073709551615] "" Vector__XXX

BO_ 2147611153 VDMA_1F211_Fluid_Level: 8 Vector__XXX
 SG_ Fluid_Level_RawPayload : 0|64@1+ (1,0) [0|18446744073709551615] "" Vector__XXX

BO_ 2147611154 VDMA_1F212_DC_Detailed_Status: 8 Vector__XXX
 SG_ DC_Detailed_Status_RawPayload : 0|64@1+ (1,0) [0|18446744073709551615] "" Vector__XXX

BO_ 2147611155 VDMA_1F213_Charger_Status: 8 Vector__XXX
 SG_ Charger_Status_RawPayload : 0|64@1+ (1,0) [0|18446744073709551615] "" Vector__XXX

BO_ 2147611156 VDMA_1F214_Battery_Status: 8 Vector__XXX
 SG_ Battery_Status_RawPayload : 0|64@1+ (1,0) [0|18446744073709551615] "" Vector__XXX

BO_ 2147611157 VDMA_1F215_Inverter_Status: 8 Vector__XXX
 SG_ Inverter_Status_RawPayload : 0|64@1+ (1,0) [0|18446744073709551615] "" Vector__XXX

BO_ 2147611158 VDMA_1F216_Charger_Configuration: 8 Vector__XXX
 SG_ Charger_Configuration_Status_Raw : 0|64@1+ (1,0) [0|18446744073709551615] "" Vector__XXX

BO_ 2147611159 VDMA_1F217_Inverter_Configuratio: 8 Vector__XXX
 SG_ Inverter_Configuration_Status_Ra : 0|64@1+ (1,0) [0|18446744073709551615] "" Vector__XXX

BO_ 2147611160 VDMA_1F218_AGS_Configuration_Sta: 8 Vector__XXX
 SG_ AGS_Configuration_Status_RawPayl : 0|64@1+ (1,0) [0|18446744073709551615] "" Vector__XXX

BO_ 2147611161 VDMA_1F219_Battery_Configuration: 8 Vector__XXX
 SG_ Battery_Configuration_Status_Raw : 0|64@1+ (1,0) [0|18446744073709551615] "" Vector__XXX

BO_ 2147611162 VDMA_1F21A_AGS_Status: 8 Vector__XXX
 SG_ AGS_Status_RawPayload : 0|64@1+ (1,0) [0|18446744073709551615] "" Vector__XXX

BO_ 2147611392 VDMA_1F300_AC_Power_Current_Phas: 8 Vector__XXX
 SG_ AC_Power_Current_Phase_A_RawPayl : 0|64@1+ (1,0) [0|18446744073709551615] "" Vector__XXX

BO_ 2147611393 VDMA_1F301_AC_Power_Current_Phas: 8 Vector__XXX
 SG_ AC_Power_Current_Phase_B_RawPayl : 0|64@1+ (1,0) [0|18446744073709551615] "" Vector__XXX

BO_ 2147611394 VDMA_1F302_AC_Power_Current_Phas: 8 Vector__XXX
 SG_ AC_Power_Current_Phase_C_RawPayl : 0|64@1+ (1,0) [0|18446744073709551615] "" Vector__XXX

BO_ 2147611395 VDMA_1F303_AC_Voltage_Frequency_: 8 Vector__XXX
 SG_ AC_Voltage_Frequency_Phase_A_Raw : 0|64@1+ (1,0) [0|18446744073709551615] "" Vector__XXX

BO_ 2147611396 VDMA_1F304_AC_Voltage_Frequency_: 8 Vector__XXX
 SG_ AC_Voltage_Frequency_Phase_B_Raw : 0|64@1+ (1,0) [0|18446744073709551615] "" Vector__XXX

BO_ 2147611397 VDMA_1F305_AC_Voltage_Frequency_: 8 Vector__XXX
 SG_ AC_Voltage_Frequency_Phase_C_Raw : 0|64@1+ (1,0) [0|18446744073709551615] "" Vector__XXX

BO_ 2147611398 VDMA_1F306_Converter_Inverter_Ch: 8 Vector__XXX
 SG_ Converter_Inverter_Charger_Statu : 0|64@1+ (1,0) [0|18446744073709551615] "" Vector__XXX

BO_ 2147611399 VDMA_1F307_DC_Voltage_Current: 8 Vector__XXX
 SG_ DC_Voltage_Current_RawPayload : 0|64@1+ (1,0) [0|18446744073709551615] "" Vector__XXX

BO_ 2147611648 VDMA_1F400_Nautical_Leeway_Angle: 8 Vector__XXX
 SG_ Nautical_Leeway_Angle_RawPayload : 0|64@1+ (1,0) [0|18446744073709551615] "" Vector__XXX

BO_ 2147611649 VDMA_1F401_Vessel_Acceleration: 8 Vector__XXX
 SG_ Vessel_Acceleration_RawPayload : 0|64@1+ (1,0) [0|18446744073709551615] "" Vector__XXX

BO_ 2147611650 VDMA_1F402_Electric_Drive_Status: 8 Vector__XXX
 SG_ Electric_Drive_Status_Rapid_Upda : 0|64@1+ (1,0) [0|18446744073709551615] "" Vector__XXX

BO_ 2147611651 VDMA_1F403_Electric_Energy_Stora: 8 Vector__XXX
 SG_ Electric_Energy_Storage_Status_R : 0|64@1+ (1,0) [0|18446744073709551615] "" Vector__XXX

BO_ 2147611654 VDMA_1F406_Thruster_Control_Stat: 8 Vector__XXX
 SG_ Thruster_Control_Status_RawPaylo : 0|64@1+ (1,0) [0|18446744073709551615] "" Vector__XXX

BO_ 2147611655 VDMA_1F407_Thruster_Information: 8 Vector__XXX
 SG_ Thruster_Information_RawPayload : 0|64@1+ (1,0) [0|18446744073709551615] "" Vector__XXX

BO_ 2147611656 VDMA_1F408_Thruster_Motor_Status: 8 Vector__XXX
 SG_ Thruster_Motor_Status_RawPayload : 0|64@1+ (1,0) [0|18446744073709551615] "" Vector__XXX

BO_ 2147611907 VDMA_1F503_Speed: 8 Vector__XXX
 SG_ Speed_RawPayload : 0|64@1+ (1,0) [0|18446744073709551615] "" Vector__XXX

BO_ 2147611915 VDMA_1F50B_Water_Depth: 8 Vector__XXX
 SG_ Water_Depth_RawPayload : 0|64@1+ (1,0) [0|18446744073709551615] "" Vector__XXX

BO_ 2147611923 VDMA_1F513_Distance_Log: 8 Vector__XXX
 SG_ Distance_Log_RawPayload : 0|64@1+ (1,0) [0|18446744073709551615] "" Vector__XXX

BO_ 2147612168 VDMA_1F608_Tracked_Target_Data: 8 Vector__XXX
 SG_ Tracked_Target_Data_RawPayload : 0|64@1+ (1,0) [0|18446744073709551615] "" Vector__XXX

BO_ 2147612186 VDMA_1F61A_Elevator_Car_Status: 8 Vector__XXX
 SG_ Elevator_Car_Status_RawPayload : 0|64@1+ (1,0) [0|18446744073709551615] "" Vector__XXX

BO_ 2147612416 VDMA_1F700_Elevator_Motor_Contro: 8 Vector__XXX
 SG_ Elevator_Motor_Control_RawPayloa : 0|64@1+ (1,0) [0|18446744073709551615] "" Vector__XXX

BO_ 2147612417 VDMA_1F701_Elevator_Deck_Push_Bu: 8 Vector__XXX
 SG_ Elevator_Deck_Push_Button_RawPay : 0|64@1+ (1,0) [0|18446744073709551615] "" Vector__XXX

BO_ 2147612424 VDMA_1F708_Windlass_Control_Stat: 8 Vector__XXX
 SG_ Windlass_Control_Status_RawPaylo : 0|64@1+ (1,0) [0|18446744073709551615] "" Vector__XXX

BO_ 2147612425 VDMA_1F709_Anchor_Windlass_Opera: 8 Vector__XXX
 SG_ Anchor_Windlass_Operating_Status : 0|64@1+ (1,0) [0|18446744073709551615] "" Vector__XXX

BO_ 2147612426 VDMA_1F70A_Anchor_Windlass_Monit: 8 Vector__XXX
 SG_ Anchor_Windlass_Monitoring_Statu : 0|64@1+ (1,0) [0|18446744073709551615] "" Vector__XXX

BO_ 2147612428 VDMA_1F70C_Linear_Actuator_Contr: 8 Vector__XXX
 SG_ Linear_Actuator_Control_Status_R : 0|64@1+ (1,0) [0|18446744073709551615] "" Vector__XXX

BO_ 2147612676 VDMA_1F804_Altitude_Delta_High_P: 8 Vector__XXX
 SG_ Altitude_Delta_High_Precision_Ra : 0|64@1+ (1,0) [0|18446744073709551615] "" Vector__XXX

BO_ 2147612681 VDMA_1F809_Time_Date: 8 Vector__XXX
 SG_ Time_Date_RawPayload : 0|64@1+ (1,0) [0|18446744073709551615] "" Vector__XXX

BO_ 2147612686 VDMA_1F80E_AIS_Class_A_Position_: 8 Vector__XXX
 SG_ AIS_Class_A_Position_Report_RawP : 0|64@1+ (1,0) [0|18446744073709551615] "" Vector__XXX

BO_ 2147612687 VDMA_1F80F_AIS_Class_B_Position_: 8 Vector__XXX
 SG_ AIS_Class_B_Position_Report_RawP : 0|64@1+ (1,0) [0|18446744073709551615] "" Vector__XXX

BO_ 2147612688 VDMA_1F810_AIS_Class_B_Extended_: 8 Vector__XXX
 SG_ AIS_Class_B_Extended_Position_Re : 0|64@1+ (1,0) [0|18446744073709551615] "" Vector__XXX

BO_ 2147612689 VDMA_1F811_AIS_Aids_to_Navigatio: 8 Vector__XXX
 SG_ AIS_Aids_to_Navigation_AtoN_Repo : 0|64@1+ (1,0) [0|18446744073709551615] "" Vector__XXX

BO_ 2147612693 VDMA_1F815_User_Datum_Settings: 8 Vector__XXX
 SG_ User_Datum_Settings_RawPayload : 0|64@1+ (1,0) [0|18446744073709551615] "" Vector__XXX

BO_ 2147612931 VDMA_1F903_Cross_Track_Error: 8 Vector__XXX
 SG_ Cross_Track_Error_RawPayload : 0|64@1+ (1,0) [0|18446744073709551615] "" Vector__XXX

BO_ 2147612932 VDMA_1F904_Navigation_Data: 8 Vector__XXX
 SG_ Navigation_Data_RawPayload : 0|64@1+ (1,0) [0|18446744073709551615] "" Vector__XXX

BO_ 2147612933 VDMA_1F905_Navigation_Route_WP_i: 8 Vector__XXX
 SG_ Navigation_Route_WP_information_ : 0|64@1+ (1,0) [0|18446744073709551615] "" Vector__XXX

BO_ 2147612939 VDMA_1F90B_Set_Drift_Rapid_Updat: 8 Vector__XXX
 SG_ Set_Drift_Rapid_Update_RawPayloa : 0|64@1+ (1,0) [0|18446744073709551615] "" Vector__XXX

BO_ 2147612949 VDMA_1F915_Time_to_from_Mark: 8 Vector__XXX
 SG_ Time_to_from_Mark_RawPayload : 0|64@1+ (1,0) [0|18446744073709551615] "" Vector__XXX

BO_ 2147612950 VDMA_1F916_Bearing_and_Distance_: 8 Vector__XXX
 SG_ Bearing_and_Distance_between_two : 0|64@1+ (1,0) [0|18446744073709551615] "" Vector__XXX

BO_ 2147613186 VDMA_1FA02_GNSS_Control_Status: 8 Vector__XXX
 SG_ GNSS_Control_Status_RawPayload : 0|64@1+ (1,0) [0|18446744073709551615] "" Vector__XXX

BO_ 2147613187 VDMA_1FA03_GNSS_DOPs: 8 Vector__XXX
 SG_ GNSS_DOPs_RawPayload : 0|64@1+ (1,0) [0|18446744073709551615] "" Vector__XXX

BO_ 2147613188 VDMA_1FA04_GNSS_Sats_in_View: 8 Vector__XXX
 SG_ GNSS_Sats_in_View_RawPayload : 0|64@1+ (1,0) [0|18446744073709551615] "" Vector__XXX

BO_ 2147613189 VDMA_1FA05_GPS_Almanac_Data: 8 Vector__XXX
 SG_ GPS_Almanac_Data_RawPayload : 0|64@1+ (1,0) [0|18446744073709551615] "" Vector__XXX

BO_ 2147613190 VDMA_1FA06_GNSS_Pseudorange_Nois: 8 Vector__XXX
 SG_ GNSS_Pseudorange_Noise_Statistic : 0|64@1+ (1,0) [0|18446744073709551615] "" Vector__XXX

BO_ 2147613193 VDMA_1FA09_GNSS_RAIM_Output: 8 Vector__XXX
 SG_ GNSS_RAIM_Output_RawPayload : 0|64@1+ (1,0) [0|18446744073709551615] "" Vector__XXX

BO_ 2147613194 VDMA_1FA0A_GNSS_RAIM_Settings: 8 Vector__XXX
 SG_ GNSS_RAIM_Settings_RawPayload : 0|64@1+ (1,0) [0|18446744073709551615] "" Vector__XXX

BO_ 2147613195 VDMA_1FA0B_GNSS_Pseudorange_Erro: 8 Vector__XXX
 SG_ GNSS_Pseudorange_Error_Statistic : 0|64@1+ (1,0) [0|18446744073709551615] "" Vector__XXX

BO_ 2147613197 VDMA_1FA0D_DGNSS_Corrections: 8 Vector__XXX
 SG_ DGNSS_Corrections_RawPayload : 0|64@1+ (1,0) [0|18446744073709551615] "" Vector__XXX

BO_ 2147613198 VDMA_1FA0E_GNSS_Differential_Cor: 8 Vector__XXX
 SG_ GNSS_Differential_Correction_Rec : 0|64@1+ (1,0) [0|18446744073709551615] "" Vector__XXX

BO_ 2147613199 VDMA_1FA0F_GNSS_Differential_Cor: 8 Vector__XXX
 SG_ GNSS_Differential_Correction_Rec : 0|64@1+ (1,0) [0|18446744073709551615] "" Vector__XXX

BO_ 2147613204 VDMA_1FA14_GLONASS_Almanac_Data: 8 Vector__XXX
 SG_ GLONASS_Almanac_Data_RawPayload : 0|64@1+ (1,0) [0|18446744073709551615] "" Vector__XXX

BO_ 2147613440 VDMA_1FB00_AIS_DGNSS_Broadcast_B: 8 Vector__XXX
 SG_ AIS_DGNSS_Broadcast_Binary_Messa : 0|64@1+ (1,0) [0|18446744073709551615] "" Vector__XXX

BO_ 2147613441 VDMA_1FB01_AIS_UTC_and_Date_Repo: 8 Vector__XXX
 SG_ AIS_UTC_and_Date_Report_RawPaylo : 0|64@1+ (1,0) [0|18446744073709551615] "" Vector__XXX

BO_ 2147613442 VDMA_1FB02_AIS_Class_A_Static_an: 8 Vector__XXX
 SG_ AIS_Class_A_Static_and_Voyage_Re : 0|64@1+ (1,0) [0|18446744073709551615] "" Vector__XXX

BO_ 2147613443 VDMA_1FB03_AIS_Addressed_Binary_: 8 Vector__XXX
 SG_ AIS_Addressed_Binary_Message_Raw : 0|64@1+ (1,0) [0|18446744073709551615] "" Vector__XXX

BO_ 2147613444 VDMA_1FB04_AIS_Acknowledge: 8 Vector__XXX
 SG_ AIS_Acknowledge_RawPayload : 0|64@1+ (1,0) [0|18446744073709551615] "" Vector__XXX

BO_ 2147613445 VDMA_1FB05_AIS_Binary_Broadcast_: 8 Vector__XXX
 SG_ AIS_Binary_Broadcast_Message_Raw : 0|64@1+ (1,0) [0|18446744073709551615] "" Vector__XXX

BO_ 2147613446 VDMA_1FB06_AIS_SAR_Aircraft_Posi: 8 Vector__XXX
 SG_ AIS_SAR_Aircraft_Position_Report : 0|64@1+ (1,0) [0|18446744073709551615] "" Vector__XXX

BO_ 2147613447 VDMA_1FB07_Radio_Frequency_Mode_: 8 Vector__XXX
 SG_ Radio_Frequency_Mode_Power_RawPa : 0|64@1+ (1,0) [0|18446744073709551615] "" Vector__XXX

BO_ 2147613448 VDMA_1FB08_AIS_UTC_Date_Inquiry: 8 Vector__XXX
 SG_ AIS_UTC_Date_Inquiry_RawPayload : 0|64@1+ (1,0) [0|18446744073709551615] "" Vector__XXX

BO_ 2147613449 VDMA_1FB09_AIS_Addressed_Safety_: 8 Vector__XXX
 SG_ AIS_Addressed_Safety_Related_Mes : 0|64@1+ (1,0) [0|18446744073709551615] "" Vector__XXX

BO_ 2147613450 VDMA_1FB0A_AIS_Safety_Related_Br: 8 Vector__XXX
 SG_ AIS_Safety_Related_Broadcast_Mes : 0|64@1+ (1,0) [0|18446744073709551615] "" Vector__XXX

BO_ 2147613451 VDMA_1FB0B_AIS_Interrogation: 8 Vector__XXX
 SG_ AIS_Interrogation_RawPayload : 0|64@1+ (1,0) [0|18446744073709551615] "" Vector__XXX

BO_ 2147613452 VDMA_1FB0C_AIS_Assignment_Mode_C: 8 Vector__XXX
 SG_ AIS_Assignment_Mode_Command_RawP : 0|64@1+ (1,0) [0|18446744073709551615] "" Vector__XXX

BO_ 2147613453 VDMA_1FB0D_AIS_Data_Link_Managem: 8 Vector__XXX
 SG_ AIS_Data_Link_Management_Message : 0|64@1+ (1,0) [0|18446744073709551615] "" Vector__XXX

BO_ 2147613454 VDMA_1FB0E_AIS_Channel_Managemen: 8 Vector__XXX
 SG_ AIS_Channel_Management_RawPayloa : 0|64@1+ (1,0) [0|18446744073709551615] "" Vector__XXX

BO_ 2147613455 VDMA_1FB0F_AIS_Class_B_Group_Ass: 8 Vector__XXX
 SG_ AIS_Class_B_Group_Assignment_Raw : 0|64@1+ (1,0) [0|18446744073709551615] "" Vector__XXX

BO_ 2147613456 VDMA_1FB10_DSC_Call_Information: 8 Vector__XXX
 SG_ DSC_Call_Information_RawPayload : 0|64@1+ (1,0) [0|18446744073709551615] "" Vector__XXX

BO_ 2147613457 VDMA_1FB11_AIS_Class_B_CS_Static: 8 Vector__XXX
 SG_ AIS_Class_B_CS_Static_Data_Repor : 0|64@1+ (1,0) [0|18446744073709551615] "" Vector__XXX

BO_ 2147613458 VDMA_1FB12_AIS_Class_B_CS_Static: 8 Vector__XXX
 SG_ AIS_Class_B_CS_Static_Data_Repor : 0|64@1+ (1,0) [0|18446744073709551615] "" Vector__XXX

BO_ 2147613459 VDMA_1FB13_AIS_Single_Slot_Binar: 8 Vector__XXX
 SG_ AIS_Single_Slot_Binary_Message_D : 0|64@1+ (1,0) [0|18446744073709551615] "" Vector__XXX

BO_ 2147613460 VDMA_1FB14_AIS_Multi_Slot_Binary: 8 Vector__XXX
 SG_ AIS_Multi_Slot_Binary_Message_DE : 0|64@1+ (1,0) [0|18446744073709551615] "" Vector__XXX

BO_ 2147613461 VDMA_1FB15_AIS_Long_Range_Broadc: 8 Vector__XXX
 SG_ AIS_Long_Range_Broadcast_Message : 0|64@1+ (1,0) [0|18446744073709551615] "" Vector__XXX

BO_ 2147613462 VDMA_1FB16_AIS_Single_Slot_Binar: 8 Vector__XXX
 SG_ AIS_Single_Slot_Binary_Message_R : 0|64@1+ (1,0) [0|18446744073709551615] "" Vector__XXX

BO_ 2147613463 VDMA_1FB17_AIS_Multi_Slot_Binary: 8 Vector__XXX
 SG_ AIS_Multi_Slot_Binary_Message_Ra : 0|64@1+ (1,0) [0|18446744073709551615] "" Vector__XXX

BO_ 2147613464 VDMA_1FB18_AIS_Acknowledge: 8 Vector__XXX
 SG_ AIS_Acknowledge_RawPayload : 0|64@1+ (1,0) [0|18446744073709551615] "" Vector__XXX

BO_ 2147613700 VDMA_1FC04_Loran_C_TD_Data: 8 Vector__XXX
 SG_ Loran_C_TD_Data_RawPayload : 0|64@1+ (1,0) [0|18446744073709551615] "" Vector__XXX

BO_ 2147613701 VDMA_1FC05_Loran_C_Range_Data: 8 Vector__XXX
 SG_ Loran_C_Range_Data_RawPayload : 0|64@1+ (1,0) [0|18446744073709551615] "" Vector__XXX

BO_ 2147613702 VDMA_1FC06_Loran_C_Signal_Data: 8 Vector__XXX
 SG_ Loran_C_Signal_Data_RawPayload : 0|64@1+ (1,0) [0|18446744073709551615] "" Vector__XXX

BO_ 2147613708 VDMA_1FC0C_Label: 8 Vector__XXX
 SG_ Label_RawPayload : 0|64@1+ (1,0) [0|18446744073709551615] "" Vector__XXX

BO_ 2147613709 VDMA_1FC0D_Channel_Source_Config: 8 Vector__XXX
 SG_ Channel_Source_Configuration_Raw : 0|64@1+ (1,0) [0|18446744073709551615] "" Vector__XXX

BO_ 2147613712 VDMA_1FC10_Route_and_WP_Service_: 8 Vector__XXX
 SG_ Route_and_WP_Service_Database_Li : 0|64@1+ (1,0) [0|18446744073709551615] "" Vector__XXX

BO_ 2147613713 VDMA_1FC11_Route_and_WP_Service_: 8 Vector__XXX
 SG_ Route_and_WP_Service_Route_List_ : 0|64@1+ (1,0) [0|18446744073709551615] "" Vector__XXX

BO_ 2147613714 VDMA_1FC12_Route_and_WP_Service_: 8 Vector__XXX
 SG_ Route_and_WP_Service_Route_WP_Li : 0|64@1+ (1,0) [0|18446744073709551615] "" Vector__XXX

BO_ 2147613715 VDMA_1FC13_Route_and_WP_Service_: 8 Vector__XXX
 SG_ Route_and_WP_Service_Route_WP_Na : 0|64@1+ (1,0) [0|18446744073709551615] "" Vector__XXX

BO_ 2147613716 VDMA_1FC14_Route_and_WP_Service_: 8 Vector__XXX
 SG_ Route_and_WP_Service_Route_WP_Na : 0|64@1+ (1,0) [0|18446744073709551615] "" Vector__XXX

BO_ 2147613717 VDMA_1FC15_Route_and_WP_Service_: 8 Vector__XXX
 SG_ Route_and_WP_Service_XTE_Limit_N : 0|64@1+ (1,0) [0|18446744073709551615] "" Vector__XXX

BO_ 2147613718 VDMA_1FC16_Route_and_WP_Service_: 8 Vector__XXX
 SG_ Route_and_WP_Service_WP_Comment_ : 0|64@1+ (1,0) [0|18446744073709551615] "" Vector__XXX

BO_ 2147613719 VDMA_1FC17_Route_and_WP_Service_: 8 Vector__XXX
 SG_ Route_and_WP_Service_Route_Comme : 0|64@1+ (1,0) [0|18446744073709551615] "" Vector__XXX

BO_ 2147613720 VDMA_1FC18_Route_and_WP_Service_: 8 Vector__XXX
 SG_ Route_and_WP_Service_Database_Co : 0|64@1+ (1,0) [0|18446744073709551615] "" Vector__XXX

BO_ 2147613721 VDMA_1FC19_Route_and_WP_Service_: 8 Vector__XXX
 SG_ Route_and_WP_Service_Radius_of_T : 0|64@1+ (1,0) [0|18446744073709551615] "" Vector__XXX

BO_ 2147613722 VDMA_1FC1A_Route_and_WP_Service_: 8 Vector__XXX
 SG_ Route_and_WP_Service_WP_List_WP_ : 0|64@1+ (1,0) [0|18446744073709551615] "" Vector__XXX

BO_ 2147613954 VDMA_1FD02_Wind_Data: 8 Vector__XXX
 SG_ Wind_Data_RawPayload : 0|64@1+ (1,0) [0|18446744073709551615] "" Vector__XXX

BO_ 2147613958 VDMA_1FD06_Environmental_Paramet: 8 Vector__XXX
 SG_ Environmental_Parameters_RawPayl : 0|64@1+ (1,0) [0|18446744073709551615] "" Vector__XXX

BO_ 2147613959 VDMA_1FD07_Environmental_Paramet: 8 Vector__XXX
 SG_ Environmental_Parameters_RawPayl : 0|64@1+ (1,0) [0|18446744073709551615] "" Vector__XXX

BO_ 2147613960 VDMA_1FD08_Temperature: 8 Vector__XXX
 SG_ Temperature_RawPayload : 0|64@1+ (1,0) [0|18446744073709551615] "" Vector__XXX

BO_ 2147613961 VDMA_1FD09_Humidity: 8 Vector__XXX
 SG_ Humidity_RawPayload : 0|64@1+ (1,0) [0|18446744073709551615] "" Vector__XXX

BO_ 2147613962 VDMA_1FD0A_Actual_Pressure: 8 Vector__XXX
 SG_ Actual_Pressure_RawPayload : 0|64@1+ (1,0) [0|18446744073709551615] "" Vector__XXX

BO_ 2147613963 VDMA_1FD0B_Set_Pressure: 8 Vector__XXX
 SG_ Set_Pressure_RawPayload : 0|64@1+ (1,0) [0|18446744073709551615] "" Vector__XXX

BO_ 2147613964 VDMA_1FD0C_Temperature_Extended_: 8 Vector__XXX
 SG_ Temperature_Extended_Range_RawPa : 0|64@1+ (1,0) [0|18446744073709551615] "" Vector__XXX

BO_ 2147613968 VDMA_1FD10_Tide_Station_Data: 8 Vector__XXX
 SG_ Tide_Station_Data_RawPayload : 0|64@1+ (1,0) [0|18446744073709551615] "" Vector__XXX

BO_ 2147613969 VDMA_1FD11_Salinity_Station_Data: 8 Vector__XXX
 SG_ Salinity_Station_Data_RawPayload : 0|64@1+ (1,0) [0|18446744073709551615] "" Vector__XXX

BO_ 2147613970 VDMA_1FD12_Current_Station_Data: 8 Vector__XXX
 SG_ Current_Station_Data_RawPayload : 0|64@1+ (1,0) [0|18446744073709551615] "" Vector__XXX

BO_ 2147613971 VDMA_1FD13_Meteorological_Statio: 8 Vector__XXX
 SG_ Meteorological_Station_Data_RawP : 0|64@1+ (1,0) [0|18446744073709551615] "" Vector__XXX

BO_ 2147613972 VDMA_1FD14_Moored_Buoy_Station_D: 8 Vector__XXX
 SG_ Moored_Buoy_Station_Data_RawPayl : 0|64@1+ (1,0) [0|18446744073709551615] "" Vector__XXX

BO_ 2147613978 VDMA_1FD1A_Lighting_System_Setti: 8 Vector__XXX
 SG_ Lighting_System_Settings_RawPayl : 0|64@1+ (1,0) [0|18446744073709551615] "" Vector__XXX

BO_ 2147614208 VDMA_1FE00_Payload_Mass: 8 Vector__XXX
 SG_ Payload_Mass_RawPayload : 0|64@1+ (1,0) [0|18446744073709551615] "" Vector__XXX

BO_ 2147614209 VDMA_1FE01_Lighting_Zone: 8 Vector__XXX
 SG_ Lighting_Zone_RawPayload : 0|64@1+ (1,0) [0|18446744073709551615] "" Vector__XXX

BO_ 2147614210 VDMA_1FE02_Lighting_Scene: 8 Vector__XXX
 SG_ Lighting_Scene_RawPayload : 0|64@1+ (1,0) [0|18446744073709551615] "" Vector__XXX

BO_ 2147614211 VDMA_1FE03_Lighting_Device: 8 Vector__XXX
 SG_ Lighting_Device_RawPayload : 0|64@1+ (1,0) [0|18446744073709551615] "" Vector__XXX

BO_ 2147614212 VDMA_1FE04_Lighting_Device_Enume: 8 Vector__XXX
 SG_ Lighting_Device_Enumeration_RawP : 0|64@1+ (1,0) [0|18446744073709551615] "" Vector__XXX

BO_ 2147614213 VDMA_1FE05_Lighting_Color_Sequen: 8 Vector__XXX
 SG_ Lighting_Color_Sequence_RawPaylo : 0|64@1+ (1,0) [0|18446744073709551615] "" Vector__XXX

BO_ 2147614214 VDMA_1FE06_Lighting_Program: 8 Vector__XXX
 SG_ Lighting_Program_RawPayload : 0|64@1+ (1,0) [0|18446744073709551615] "" Vector__XXX

BO_ 2147614215 VDMA_1FE07_Watermaker_Input_Sett: 8 Vector__XXX
 SG_ Watermaker_Input_Setting_and_Sta : 0|64@1+ (1,0) [0|18446744073709551615] "" Vector__XXX

BO_ 2147614216 VDMA_1FE08_Entertainment_Diagnos: 8 Vector__XXX
 SG_ Entertainment_Diagnostic_Status_ : 0|64@1+ (1,0) [0|18446744073709551615] "" Vector__XXX

BO_ 2147614217 VDMA_1FE09_Entertainment_Current: 8 Vector__XXX
 SG_ Entertainment_Current_File_and_S : 0|64@1+ (1,0) [0|18446744073709551615] "" Vector__XXX

BO_ 2147614218 VDMA_1FE0A_Entertainment_Library: 8 Vector__XXX
 SG_ Entertainment_Library_Data_File_ : 0|64@1+ (1,0) [0|18446744073709551615] "" Vector__XXX

BO_ 2147614219 VDMA_1FE0B_Entertainment_Library: 8 Vector__XXX
 SG_ Entertainment_Library_Data_Group : 0|64@1+ (1,0) [0|18446744073709551615] "" Vector__XXX

BO_ 2147614220 VDMA_1FE0C_Entertainment_Library: 8 Vector__XXX
 SG_ Entertainment_Library_Data_Searc : 0|64@1+ (1,0) [0|18446744073709551615] "" Vector__XXX

BO_ 2147614221 VDMA_1FE0D_Entertainment_Support: 8 Vector__XXX
 SG_ Entertainment_Supported_Source_D : 0|64@1+ (1,0) [0|18446744073709551615] "" Vector__XXX

BO_ 2147614222 VDMA_1FE0E_Entertainment_Support: 8 Vector__XXX
 SG_ Entertainment_Supported_Zone_Dat : 0|64@1+ (1,0) [0|18446744073709551615] "" Vector__XXX

BO_ 2147614223 VDMA_1FE0F_Entertainment_Parenta: 8 Vector__XXX
 SG_ Entertainment_Parental_Control_S : 0|64@1+ (1,0) [0|18446744073709551615] "" Vector__XXX

BO_ 2147614224 VDMA_1FE10_Small_Craft_Status: 8 Vector__XXX
 SG_ Small_Craft_Status_RawPayload : 0|64@1+ (1,0) [0|18446744073709551615] "" Vector__XXX

BO_ 2147614225 VDMA_1FE11_Direction_Data: 8 Vector__XXX
 SG_ Direction_Data_RawPayload : 0|64@1+ (1,0) [0|18446744073709551615] "" Vector__XXX

BO_ 2147614226 VDMA_1FE12_Vessel_Speed_Componen: 8 Vector__XXX
 SG_ Vessel_Speed_Components_RawPaylo : 0|64@1+ (1,0) [0|18446744073709551615] "" Vector__XXX

BO_ 2147614227 VDMA_1FE13_Entertainment_System_: 8 Vector__XXX
 SG_ Entertainment_System_Configurati : 0|64@1+ (1,0) [0|18446744073709551615] "" Vector__XXX

BO_ 2147614228 VDMA_1FE14_Entertainment_System_: 8 Vector__XXX
 SG_ Entertainment_System_Configurati : 0|64@1+ (1,0) [0|18446744073709551615] "" Vector__XXX

BO_ 2147614229 VDMA_1FE15_Entertainment_Zone_Co: 8 Vector__XXX
 SG_ Entertainment_Zone_Configuration : 0|64@1+ (1,0) [0|18446744073709551615] "" Vector__XXX

BO_ 2147614230 VDMA_1FE16_Entertainment_Zone_Vo: 8 Vector__XXX
 SG_ Entertainment_Zone_Volume_RawPay : 0|64@1+ (1,0) [0|18446744073709551615] "" Vector__XXX

BO_ 2147614231 VDMA_1FE17_Entertainment_Availab: 8 Vector__XXX
 SG_ Entertainment_Available_Audio_EQ : 0|64@1+ (1,0) [0|18446744073709551615] "" Vector__XXX

BO_ 2147614232 VDMA_1FE18_Entertainment_Bluetoo: 8 Vector__XXX
 SG_ Entertainment_Bluetooth_Devices_ : 0|64@1+ (1,0) [0|18446744073709551615] "" Vector__XXX

BO_ 2147614233 VDMA_1FE19_Entertainment_Bluetoo: 8 Vector__XXX
 SG_ Entertainment_Bluetooth_Source_S : 0|64@1+ (1,0) [0|18446744073709551615] "" Vector__XXX

BO_ 2147614234 VDMA_1FE1A_Entertainment_Zone_Co: 8 Vector__XXX
 SG_ Entertainment_Zone_Configuration : 0|64@1+ (1,0) [0|18446744073709551615] "" Vector__XXX

CM_ BO_ 2147548773  "Source: isobus.net VDMA Data Dictionary (https://www.isobus.net/isobus/pGNAndSPN/16407?type=PGN)";
CM_ BO_ 2147548774  "Source: isobus.net VDMA Data Dictionary (https://www.isobus.net/isobus/pGNAndSPN/16408?type=PGN)";
CM_ BO_ 2147548775  "Source: isobus.net VDMA Data Dictionary (https://www.isobus.net/isobus/pGNAndSPN/16409?type=PGN)";
CM_ BO_ 2147548776  "Source: isobus.net VDMA Data Dictionary (https://www.isobus.net/isobus/pGNAndSPN/16413?type=PGN)";
CM_ BO_ 2147548777  "Source: isobus.net VDMA Data Dictionary (https://www.isobus.net/isobus/pGNAndSPN/16417?type=PGN)";
CM_ BO_ 2147548778  "Source: isobus.net VDMA Data Dictionary (https://www.isobus.net/isobus/pGNAndSPN/16430?type=PGN)";
CM_ BO_ 2147548779  "Source: isobus.net VDMA Data Dictionary (https://www.isobus.net/isobus/pGNAndSPN/16432?type=PGN)";
CM_ BO_ 2147548781  "Source: isobus.net VDMA Data Dictionary (https://www.isobus.net/isobus/pGNAndSPN/16455?type=PGN)";
CM_ BO_ 2147548782  "Source: isobus.net VDMA Data Dictionary (https://www.isobus.net/isobus/pGNAndSPN/16459?type=PGN)";
CM_ BO_ 2147548783  "Source: isobus.net VDMA Data Dictionary (https://www.isobus.net/isobus/pGNAndSPN/16469?type=PGN)";
CM_ BO_ 2147548784  "Source: isobus.net VDMA Data Dictionary (https://www.isobus.net/isobus/pGNAndSPN/16472?type=PGN)";
CM_ BO_ 2147548785  "Source: isobus.net VDMA Data Dictionary (https://www.isobus.net/isobus/pGNAndSPN/16477?type=PGN)";
CM_ BO_ 2147548786  "Source: isobus.net VDMA Data Dictionary (https://www.isobus.net/isobus/pGNAndSPN/16482?type=PGN)";
CM_ BO_ 2147548787  "Source: isobus.net VDMA Data Dictionary (https://www.isobus.net/isobus/pGNAndSPN/16483?type=PGN)";
CM_ BO_ 2147548788  "Source: isobus.net VDMA Data Dictionary (https://www.isobus.net/isobus/pGNAndSPN/16485?type=PGN)";
CM_ BO_ 2147548789  "Source: isobus.net VDMA Data Dictionary (https://www.isobus.net/isobus/pGNAndSPN/16489?type=PGN)";
CM_ BO_ 2147548790  "Source: isobus.net VDMA Data Dictionary (https://www.isobus.net/isobus/pGNAndSPN/16494?type=PGN)";
CM_ BO_ 2147548791  "Source: isobus.net VDMA Data Dictionary (https://www.isobus.net/isobus/pGNAndSPN/16497?type=PGN)";
CM_ BO_ 2147548792  "Source: isobus.net VDMA Data Dictionary (https://www.isobus.net/isobus/pGNAndSPN/16508?type=PGN)";
CM_ BO_ 2147548793  "Source: isobus.net VDMA Data Dictionary (https://www.isobus.net/isobus/pGNAndSPN/16511?type=PGN)";
CM_ BO_ 2147548794  "Source: isobus.net VDMA Data Dictionary (https://www.isobus.net/isobus/pGNAndSPN/16514?type=PGN)";
CM_ BO_ 2147548795  "Source: isobus.net VDMA Data Dictionary (https://www.isobus.net/isobus/pGNAndSPN/16518?type=PGN)";
CM_ BO_ 2147548796  "Source: isobus.net VDMA Data Dictionary (https://www.isobus.net/isobus/pGNAndSPN/16522?type=PGN)";
CM_ BO_ 2147548797  "Source: isobus.net VDMA Data Dictionary (https://www.isobus.net/isobus/pGNAndSPN/16526?type=PGN)";
CM_ BO_ 2147548798  "Source: isobus.net VDMA Data Dictionary (https://www.isobus.net/isobus/pGNAndSPN/16530?type=PGN)";
CM_ BO_ 2147548799  "Source: isobus.net VDMA Data Dictionary (https://www.isobus.net/isobus/pGNAndSPN/16534?type=PGN)";
CM_ BO_ 2147548800  "Source: isobus.net VDMA Data Dictionary (https://www.isobus.net/isobus/pGNAndSPN/16536?type=PGN)";
CM_ BO_ 2147548801  "Source: isobus.net VDMA Data Dictionary (https://www.isobus.net/isobus/pGNAndSPN/16542?type=PGN)";
CM_ BO_ 2147548802  "Source: isobus.net VDMA Data Dictionary (https://www.isobus.net/isobus/pGNAndSPN/16546?type=PGN)";
CM_ BO_ 2147548803  "Source: isobus.net VDMA Data Dictionary (https://www.isobus.net/isobus/pGNAndSPN/16550?type=PGN)";
CM_ BO_ 2147548804  "Source: isobus.net VDMA Data Dictionary (https://www.isobus.net/isobus/pGNAndSPN/16554?type=PGN)";
CM_ BO_ 2147548805  "Source: isobus.net VDMA Data Dictionary (https://www.isobus.net/isobus/pGNAndSPN/16558?type=PGN)";
CM_ BO_ 2147548806  "Source: isobus.net VDMA Data Dictionary (https://www.isobus.net/isobus/pGNAndSPN/16562?type=PGN)";
CM_ BO_ 2147548807  "Source: isobus.net VDMA Data Dictionary (https://www.isobus.net/isobus/pGNAndSPN/16566?type=PGN)";
CM_ BO_ 2147548808  "Source: isobus.net VDMA Data Dictionary (https://www.isobus.net/isobus/pGNAndSPN/16574?type=PGN)";
CM_ BO_ 2147548809  "Source: isobus.net VDMA Data Dictionary (https://www.isobus.net/isobus/pGNAndSPN/16582?type=PGN)";
CM_ BO_ 2147548810  "Source: isobus.net VDMA Data Dictionary (https://www.isobus.net/isobus/pGNAndSPN/16586?type=PGN)";
CM_ BO_ 2147548811  "Source: isobus.net VDMA Data Dictionary (https://www.isobus.net/isobus/pGNAndSPN/16590?type=PGN)";
CM_ BO_ 2147548812  "Source: isobus.net VDMA Data Dictionary (https://www.isobus.net/isobus/pGNAndSPN/16597?type=PGN)";
CM_ BO_ 2147548813  "Source: isobus.net VDMA Data Dictionary (https://www.isobus.net/isobus/pGNAndSPN/16601?type=PGN)";
CM_ BO_ 2147548814  "Source: isobus.net VDMA Data Dictionary (https://www.isobus.net/isobus/pGNAndSPN/16603?type=PGN)";
CM_ BO_ 2147548815  "Source: isobus.net VDMA Data Dictionary (https://www.isobus.net/isobus/pGNAndSPN/16604?type=PGN)";
CM_ BO_ 2147548816  "Source: isobus.net VDMA Data Dictionary (https://www.isobus.net/isobus/pGNAndSPN/16623?type=PGN)";
CM_ BO_ 2147548817  "Source: isobus.net VDMA Data Dictionary (https://www.isobus.net/isobus/pGNAndSPN/16626?type=PGN)";
CM_ BO_ 2147548818  "Source: isobus.net VDMA Data Dictionary (https://www.isobus.net/isobus/pGNAndSPN/16631?type=PGN)";
CM_ BO_ 2147548819  "Source: isobus.net VDMA Data Dictionary (https://www.isobus.net/isobus/pGNAndSPN/16634?type=PGN)";
CM_ BO_ 2147548820  "Source: isobus.net VDMA Data Dictionary (https://www.isobus.net/isobus/pGNAndSPN/16642?type=PGN)";
CM_ BO_ 2147548821  "Source: isobus.net VDMA Data Dictionary (https://www.isobus.net/isobus/pGNAndSPN/16643?type=PGN)";
CM_ BO_ 2147548822  "Source: isobus.net VDMA Data Dictionary (https://www.isobus.net/isobus/pGNAndSPN/16652?type=PGN)";
CM_ BO_ 2147548823  "Source: isobus.net VDMA Data Dictionary (https://www.isobus.net/isobus/pGNAndSPN/16656?type=PGN)";
CM_ BO_ 2147548824  "Source: isobus.net VDMA Data Dictionary (https://www.isobus.net/isobus/pGNAndSPN/16660?type=PGN)";
CM_ BO_ 2147548825  "Source: isobus.net VDMA Data Dictionary (https://www.isobus.net/isobus/pGNAndSPN/16664?type=PGN)";
CM_ BO_ 2147548826  "Source: isobus.net VDMA Data Dictionary (https://www.isobus.net/isobus/pGNAndSPN/16668?type=PGN)";
CM_ BO_ 2147548827  "Source: isobus.net VDMA Data Dictionary (https://www.isobus.net/isobus/pGNAndSPN/16672?type=PGN)";
CM_ BO_ 2147548828  "Source: isobus.net VDMA Data Dictionary (https://www.isobus.net/isobus/pGNAndSPN/16676?type=PGN)";
CM_ BO_ 2147548829  "Source: isobus.net VDMA Data Dictionary (https://www.isobus.net/isobus/pGNAndSPN/16680?type=PGN)";
CM_ BO_ 2147548830  "Source: isobus.net VDMA Data Dictionary (https://www.isobus.net/isobus/pGNAndSPN/16684?type=PGN)";
CM_ BO_ 2147548831  "Source: isobus.net VDMA Data Dictionary (https://www.isobus.net/isobus/pGNAndSPN/16688?type=PGN)";
CM_ BO_ 2147548832  "Source: isobus.net VDMA Data Dictionary (https://www.isobus.net/isobus/pGNAndSPN/16692?type=PGN)";
CM_ BO_ 2147548833  "Source: isobus.net VDMA Data Dictionary (https://www.isobus.net/isobus/pGNAndSPN/16696?type=PGN)";
CM_ BO_ 2147548834  "Source: isobus.net VDMA Data Dictionary (https://www.isobus.net/isobus/pGNAndSPN/16700?type=PGN)";
CM_ BO_ 2147548835  "Source: isobus.net VDMA Data Dictionary (https://www.isobus.net/isobus/pGNAndSPN/16704?type=PGN)";
CM_ BO_ 2147548836  "Source: isobus.net VDMA Data Dictionary (https://www.isobus.net/isobus/pGNAndSPN/16708?type=PGN)";
CM_ BO_ 2147548837  "Source: isobus.net VDMA Data Dictionary (https://www.isobus.net/isobus/pGNAndSPN/16715?type=PGN)";
CM_ BO_ 2147548838  "Source: isobus.net VDMA Data Dictionary (https://www.isobus.net/isobus/pGNAndSPN/16719?type=PGN)";
CM_ BO_ 2147548839  "Source: isobus.net VDMA Data Dictionary (https://www.isobus.net/isobus/pGNAndSPN/16727?type=PGN)";
CM_ BO_ 2147548840  "Source: isobus.net VDMA Data Dictionary (https://www.isobus.net/isobus/pGNAndSPN/16729?type=PGN)";
CM_ BO_ 2147548841  "Source: isobus.net VDMA Data Dictionary (https://www.isobus.net/isobus/pGNAndSPN/16734?type=PGN)";
CM_ BO_ 2147548842  "Source: isobus.net VDMA Data Dictionary (https://www.isobus.net/isobus/pGNAndSPN/16739?type=PGN)";
CM_ BO_ 2147548843  "Source: isobus.net VDMA Data Dictionary (https://www.isobus.net/isobus/pGNAndSPN/16743?type=PGN)";
CM_ BO_ 2147548844  "Source: isobus.net VDMA Data Dictionary (https://www.isobus.net/isobus/pGNAndSPN/16751?type=PGN)";
CM_ BO_ 2147548845  "Source: isobus.net VDMA Data Dictionary (https://www.isobus.net/isobus/pGNAndSPN/16759?type=PGN)";
CM_ BO_ 2147548846  "Source: isobus.net VDMA Data Dictionary (https://www.isobus.net/isobus/pGNAndSPN/16767?type=PGN)";
CM_ BO_ 2147548847  "Source: isobus.net VDMA Data Dictionary (https://www.isobus.net/isobus/pGNAndSPN/16769?type=PGN)";
CM_ BO_ 2147548848  "Source: isobus.net VDMA Data Dictionary (https://www.isobus.net/isobus/pGNAndSPN/16774?type=PGN)";
CM_ BO_ 2147548849  "Source: isobus.net VDMA Data Dictionary (https://www.isobus.net/isobus/pGNAndSPN/16776?type=PGN)";
CM_ BO_ 2147548850  "Source: isobus.net VDMA Data Dictionary (https://www.isobus.net/isobus/pGNAndSPN/16779?type=PGN)";
CM_ BO_ 2147548851  "Source: isobus.net VDMA Data Dictionary (https://www.isobus.net/isobus/pGNAndSPN/16782?type=PGN)";
CM_ BO_ 2147548852  "Source: isobus.net VDMA Data Dictionary (https://www.isobus.net/isobus/pGNAndSPN/16786?type=PGN)";
CM_ BO_ 2147548853  "Source: isobus.net VDMA Data Dictionary (https://www.isobus.net/isobus/pGNAndSPN/16790?type=PGN)";
CM_ BO_ 2147548854  "Source: isobus.net VDMA Data Dictionary (https://www.isobus.net/isobus/pGNAndSPN/16792?type=PGN)";
CM_ BO_ 2147548855  "Source: isobus.net VDMA Data Dictionary (https://www.isobus.net/isobus/pGNAndSPN/16797?type=PGN)";
CM_ BO_ 2147548856  "Source: isobus.net VDMA Data Dictionary (https://www.isobus.net/isobus/pGNAndSPN/16803?type=PGN)";
CM_ BO_ 2147548857  "Source: isobus.net VDMA Data Dictionary (https://www.isobus.net/isobus/pGNAndSPN/16809?type=PGN)";
CM_ BO_ 2147548858  "Source: isobus.net VDMA Data Dictionary (https://www.isobus.net/isobus/pGNAndSPN/16812?type=PGN)";
CM_ BO_ 2147548859  "Source: isobus.net VDMA Data Dictionary (https://www.isobus.net/isobus/pGNAndSPN/16816?type=PGN)";
CM_ BO_ 2147548860  "Source: isobus.net VDMA Data Dictionary (https://www.isobus.net/isobus/pGNAndSPN/16820?type=PGN)";
CM_ BO_ 2147548861  "Source: isobus.net VDMA Data Dictionary (https://www.isobus.net/isobus/pGNAndSPN/16827?type=PGN)";
CM_ BO_ 2147548862  "Source: isobus.net VDMA Data Dictionary (https://www.isobus.net/isobus/pGNAndSPN/16833?type=PGN)";
CM_ BO_ 2147548863  "Source: isobus.net VDMA Data Dictionary (https://www.isobus.net/isobus/pGNAndSPN/16840?type=PGN)";
CM_ BO_ 2147548864  "Source: isobus.net VDMA Data Dictionary (https://www.isobus.net/isobus/pGNAndSPN/16846?type=PGN)";
CM_ BO_ 2147548865  "Source: isobus.net VDMA Data Dictionary (https://www.isobus.net/isobus/pGNAndSPN/16848?type=PGN)";
CM_ BO_ 2147548866  "Source: isobus.net VDMA Data Dictionary (https://www.isobus.net/isobus/pGNAndSPN/16856?type=PGN)";
CM_ BO_ 2147548867  "Source: isobus.net VDMA Data Dictionary (https://www.isobus.net/isobus/pGNAndSPN/16862?type=PGN)";
CM_ BO_ 2147548868  "Source: isobus.net VDMA Data Dictionary (https://www.isobus.net/isobus/pGNAndSPN/16863?type=PGN)";
CM_ BO_ 2147548869  "Source: isobus.net VDMA Data Dictionary (https://www.isobus.net/isobus/pGNAndSPN/16865?type=PGN)";
CM_ BO_ 2147548870  "Source: isobus.net VDMA Data Dictionary (https://www.isobus.net/isobus/pGNAndSPN/16866?type=PGN)";
CM_ BO_ 2147548871  "Source: isobus.net VDMA Data Dictionary (https://www.isobus.net/isobus/pGNAndSPN/16883?type=PGN)";
CM_ BO_ 2147548872  "Source: isobus.net VDMA Data Dictionary (https://www.isobus.net/isobus/pGNAndSPN/16884?type=PGN)";
CM_ BO_ 2147548873  "Source: isobus.net VDMA Data Dictionary (https://www.isobus.net/isobus/pGNAndSPN/16885?type=PGN)";
CM_ BO_ 2147548877  "Source: isobus.net VDMA Data Dictionary (https://www.isobus.net/isobus/pGNAndSPN/16900?type=PGN)";
CM_ BO_ 2147548878  "Source: isobus.net VDMA Data Dictionary (https://www.isobus.net/isobus/pGNAndSPN/16906?type=PGN)";
CM_ BO_ 2147548879  "Source: isobus.net VDMA Data Dictionary (https://www.isobus.net/isobus/pGNAndSPN/16918?type=PGN)";
CM_ BO_ 2147548880  "Source: isobus.net VDMA Data Dictionary (https://www.isobus.net/isobus/pGNAndSPN/16923?type=PGN)";
CM_ BO_ 2147548881  "Source: isobus.net VDMA Data Dictionary (https://www.isobus.net/isobus/pGNAndSPN/16924?type=PGN)";
CM_ BO_ 2147548882  "Source: isobus.net VDMA Data Dictionary (https://www.isobus.net/isobus/pGNAndSPN/16925?type=PGN)";
CM_ BO_ 2147548884  "Source: isobus.net VDMA Data Dictionary (https://www.isobus.net/isobus/pGNAndSPN/16938?type=PGN)";
CM_ BO_ 2147548885  "Source: isobus.net VDMA Data Dictionary (https://www.isobus.net/isobus/pGNAndSPN/16950?type=PGN)";
CM_ BO_ 2147548886  "Source: isobus.net VDMA Data Dictionary (https://www.isobus.net/isobus/pGNAndSPN/16966?type=PGN)";
CM_ BO_ 2147548889  "Source: isobus.net VDMA Data Dictionary (https://www.isobus.net/isobus/pGNAndSPN/16986?type=PGN)";
CM_ BO_ 2147548891  "Source: isobus.net VDMA Data Dictionary (https://www.isobus.net/isobus/pGNAndSPN/16992?type=PGN)";
CM_ BO_ 2147548892  "Source: isobus.net VDMA Data Dictionary (https://www.isobus.net/isobus/pGNAndSPN/16994?type=PGN)";
CM_ BO_ 2147548893  "Source: isobus.net VDMA Data Dictionary (https://www.isobus.net/isobus/pGNAndSPN/16998?type=PGN)";
CM_ BO_ 2147548894  "Source: isobus.net VDMA Data Dictionary (https://www.isobus.net/isobus/pGNAndSPN/17001?type=PGN)";
CM_ BO_ 2147548896  "Source: isobus.net VDMA Data Dictionary (https://www.isobus.net/isobus/pGNAndSPN/17012?type=PGN)";
CM_ BO_ 2147548897  "Source: isobus.net VDMA Data Dictionary (https://www.isobus.net/isobus/pGNAndSPN/17026?type=PGN)";
CM_ BO_ 2147548898  "Source: isobus.net VDMA Data Dictionary (https://www.isobus.net/isobus/pGNAndSPN/17029?type=PGN)";
CM_ BO_ 2147548900  "Source: isobus.net VDMA Data Dictionary (https://www.isobus.net/isobus/pGNAndSPN/17081?type=PGN)";
CM_ BO_ 2147548903  "Source: isobus.net VDMA Data Dictionary (https://www.isobus.net/isobus/pGNAndSPN/17093?type=PGN)";
CM_ BO_ 2147548904  "Source: isobus.net VDMA Data Dictionary (https://www.isobus.net/isobus/pGNAndSPN/17097?type=PGN)";
CM_ BO_ 2147548905  "Source: isobus.net VDMA Data Dictionary (https://www.isobus.net/isobus/pGNAndSPN/17099?type=PGN)";
CM_ BO_ 2147548906  "Source: isobus.net VDMA Data Dictionary (https://www.isobus.net/isobus/pGNAndSPN/17103?type=PGN)";
CM_ BO_ 2147548909  "Source: isobus.net VDMA Data Dictionary (https://www.isobus.net/isobus/pGNAndSPN/17118?type=PGN)";
CM_ BO_ 2147548912  "Source: isobus.net VDMA Data Dictionary (https://www.isobus.net/isobus/pGNAndSPN/17145?type=PGN)";
CM_ BO_ 2147548915  "Source: isobus.net VDMA Data Dictionary (https://www.isobus.net/isobus/pGNAndSPN/17172?type=PGN)";
CM_ BO_ 2147548916  "Source: isobus.net VDMA Data Dictionary (https://www.isobus.net/isobus/pGNAndSPN/17181?type=PGN)";
CM_ BO_ 2147548917  "Source: isobus.net VDMA Data Dictionary (https://www.isobus.net/isobus/pGNAndSPN/17186?type=PGN)";
CM_ BO_ 2147548921  "Source: isobus.net VDMA Data Dictionary (https://www.isobus.net/isobus/pGNAndSPN/17212?type=PGN)";
CM_ BO_ 2147548922  "Source: isobus.net VDMA Data Dictionary (https://www.isobus.net/isobus/pGNAndSPN/17219?type=PGN)";
CM_ BO_ 2147548923  "Source: isobus.net VDMA Data Dictionary (https://www.isobus.net/isobus/pGNAndSPN/17223?type=PGN)";
CM_ BO_ 2147548924  "Source: isobus.net VDMA Data Dictionary (https://www.isobus.net/isobus/pGNAndSPN/17230?type=PGN)";
CM_ BO_ 2147548925  "Source: isobus.net VDMA Data Dictionary (https://www.isobus.net/isobus/pGNAndSPN/17235?type=PGN)";
CM_ BO_ 2147548926  "Source: isobus.net VDMA Data Dictionary (https://www.isobus.net/isobus/pGNAndSPN/17236?type=PGN)";
CM_ BO_ 2147548927  "Source: isobus.net VDMA Data Dictionary (https://www.isobus.net/isobus/pGNAndSPN/17252?type=PGN)";
CM_ BO_ 2147609856  "Source: isobus.net VDMA Data Dictionary (https://www.isobus.net/isobus/pGNAndSPN/17509?type=PGN)";
CM_ BO_ 2147610112  "Source: isobus.net VDMA Data Dictionary (https://www.isobus.net/isobus/pGNAndSPN/17510?type=PGN)";
CM_ BO_ 2147610631  "Source: isobus.net VDMA Data Dictionary (https://www.isobus.net/isobus/pGNAndSPN/17512?type=PGN)";
CM_ BO_ 2147610632  "Source: isobus.net VDMA Data Dictionary (https://www.isobus.net/isobus/pGNAndSPN/17513?type=PGN)";
CM_ BO_ 2147610633  "Source: isobus.net VDMA Data Dictionary (https://www.isobus.net/isobus/pGNAndSPN/17514?type=PGN)";
CM_ BO_ 2147610634  "Source: isobus.net VDMA Data Dictionary (https://www.isobus.net/isobus/pGNAndSPN/17515?type=PGN)";
CM_ BO_ 2147610635  "Source: isobus.net VDMA Data Dictionary (https://www.isobus.net/isobus/pGNAndSPN/17516?type=PGN)";
CM_ BO_ 2147610636  "Source: isobus.net VDMA Data Dictionary (https://www.isobus.net/isobus/pGNAndSPN/17517?type=PGN)";
CM_ BO_ 2147610640  "Source: isobus.net VDMA Data Dictionary (https://www.isobus.net/isobus/pGNAndSPN/17518?type=PGN)";
CM_ BO_ 2147610641  "Source: isobus.net VDMA Data Dictionary (https://www.isobus.net/isobus/pGNAndSPN/17519?type=PGN)";
CM_ BO_ 2147610644  "Source: isobus.net VDMA Data Dictionary (https://www.isobus.net/isobus/pGNAndSPN/17520?type=PGN)";
CM_ BO_ 2147610646  "Source: isobus.net VDMA Data Dictionary (https://www.isobus.net/isobus/pGNAndSPN/17521?type=PGN)";
CM_ BO_ 2147610649  "Source: isobus.net VDMA Data Dictionary (https://www.isobus.net/isobus/pGNAndSPN/17522?type=PGN)";
CM_ BO_ 2147610650  "Source: isobus.net VDMA Data Dictionary (https://www.isobus.net/isobus/pGNAndSPN/17523?type=PGN)";
CM_ BO_ 2147610881  "Source: isobus.net VDMA Data Dictionary (https://www.isobus.net/isobus/pGNAndSPN/17524?type=PGN)";
CM_ BO_ 2147610885  "Source: isobus.net VDMA Data Dictionary (https://www.isobus.net/isobus/pGNAndSPN/17525?type=PGN)";
CM_ BO_ 2147610893  "Source: isobus.net VDMA Data Dictionary (https://www.isobus.net/isobus/pGNAndSPN/17526?type=PGN)";
CM_ BO_ 2147610900  "Source: isobus.net VDMA Data Dictionary (https://www.isobus.net/isobus/pGNAndSPN/17529?type=PGN)";
CM_ BO_ 2147610905  "Source: isobus.net VDMA Data Dictionary (https://www.isobus.net/isobus/pGNAndSPN/17530?type=PGN)";
CM_ BO_ 2147610906  "Source: isobus.net VDMA Data Dictionary (https://www.isobus.net/isobus/pGNAndSPN/17531?type=PGN)";
CM_ BO_ 2147611136  "Source: isobus.net VDMA Data Dictionary (https://www.isobus.net/isobus/pGNAndSPN/17532?type=PGN)";
CM_ BO_ 2147611137  "Source: isobus.net VDMA Data Dictionary (https://www.isobus.net/isobus/pGNAndSPN/17533?type=PGN)";
CM_ BO_ 2147611138  "Source: isobus.net VDMA Data Dictionary (https://www.isobus.net/isobus/pGNAndSPN/17534?type=PGN)";
CM_ BO_ 2147611139  "Source: isobus.net VDMA Data Dictionary (https://www.isobus.net/isobus/pGNAndSPN/17535?type=PGN)";
CM_ BO_ 2147611141  "Source: isobus.net VDMA Data Dictionary (https://www.isobus.net/isobus/pGNAndSPN/17536?type=PGN)";
CM_ BO_ 2147611142  "Source: isobus.net VDMA Data Dictionary (https://www.isobus.net/isobus/pGNAndSPN/17537?type=PGN)";
CM_ BO_ 2147611143  "Source: isobus.net VDMA Data Dictionary (https://www.isobus.net/isobus/pGNAndSPN/17538?type=PGN)";
CM_ BO_ 2147611144  "Source: isobus.net VDMA Data Dictionary (https://www.isobus.net/isobus/pGNAndSPN/17539?type=PGN)";
CM_ BO_ 2147611145  "Source: isobus.net VDMA Data Dictionary (https://www.isobus.net/isobus/pGNAndSPN/17540?type=PGN)";
CM_ BO_ 2147611146  "Source: isobus.net VDMA Data Dictionary (https://www.isobus.net/isobus/pGNAndSPN/17541?type=PGN)";
CM_ BO_ 2147611148  "Source: isobus.net VDMA Data Dictionary (https://www.isobus.net/isobus/pGNAndSPN/17542?type=PGN)";
CM_ BO_ 2147611149  "Source: isobus.net VDMA Data Dictionary (https://www.isobus.net/isobus/pGNAndSPN/17543?type=PGN)";
CM_ BO_ 2147611150  "Source: isobus.net VDMA Data Dictionary (https://www.isobus.net/isobus/pGNAndSPN/17544?type=PGN)";
CM_ BO_ 2147611151  "Source: isobus.net VDMA Data Dictionary (https://www.isobus.net/isobus/pGNAndSPN/17545?type=PGN)";
CM_ BO_ 2147611152  "Source: isobus.net VDMA Data Dictionary (https://www.isobus.net/isobus/pGNAndSPN/17546?type=PGN)";
CM_ BO_ 2147611153  "Source: isobus.net VDMA Data Dictionary (https://www.isobus.net/isobus/pGNAndSPN/17547?type=PGN)";
CM_ BO_ 2147611154  "Source: isobus.net VDMA Data Dictionary (https://www.isobus.net/isobus/pGNAndSPN/17548?type=PGN)";
CM_ BO_ 2147611155  "Source: isobus.net VDMA Data Dictionary (https://www.isobus.net/isobus/pGNAndSPN/17549?type=PGN)";
CM_ BO_ 2147611156  "Source: isobus.net VDMA Data Dictionary (https://www.isobus.net/isobus/pGNAndSPN/17550?type=PGN)";
CM_ BO_ 2147611157  "Source: isobus.net VDMA Data Dictionary (https://www.isobus.net/isobus/pGNAndSPN/17551?type=PGN)";
CM_ BO_ 2147611158  "Source: isobus.net VDMA Data Dictionary (https://www.isobus.net/isobus/pGNAndSPN/17552?type=PGN)";
CM_ BO_ 2147611159  "Source: isobus.net VDMA Data Dictionary (https://www.isobus.net/isobus/pGNAndSPN/17553?type=PGN)";
CM_ BO_ 2147611160  "Source: isobus.net VDMA Data Dictionary (https://www.isobus.net/isobus/pGNAndSPN/17554?type=PGN)";
CM_ BO_ 2147611161  "Source: isobus.net VDMA Data Dictionary (https://www.isobus.net/isobus/pGNAndSPN/17555?type=PGN)";
CM_ BO_ 2147611162  "Source: isobus.net VDMA Data Dictionary (https://www.isobus.net/isobus/pGNAndSPN/17556?type=PGN)";
CM_ BO_ 2147611392  "Source: isobus.net VDMA Data Dictionary (https://www.isobus.net/isobus/pGNAndSPN/17557?type=PGN)";
CM_ BO_ 2147611393  "Source: isobus.net VDMA Data Dictionary (https://www.isobus.net/isobus/pGNAndSPN/17558?type=PGN)";
CM_ BO_ 2147611394  "Source: isobus.net VDMA Data Dictionary (https://www.isobus.net/isobus/pGNAndSPN/17559?type=PGN)";
CM_ BO_ 2147611395  "Source: isobus.net VDMA Data Dictionary (https://www.isobus.net/isobus/pGNAndSPN/17560?type=PGN)";
CM_ BO_ 2147611396  "Source: isobus.net VDMA Data Dictionary (https://www.isobus.net/isobus/pGNAndSPN/17561?type=PGN)";
CM_ BO_ 2147611397  "Source: isobus.net VDMA Data Dictionary (https://www.isobus.net/isobus/pGNAndSPN/17562?type=PGN)";
CM_ BO_ 2147611398  "Source: isobus.net VDMA Data Dictionary (https://www.isobus.net/isobus/pGNAndSPN/17563?type=PGN)";
CM_ BO_ 2147611399  "Source: isobus.net VDMA Data Dictionary (https://www.isobus.net/isobus/pGNAndSPN/17564?type=PGN)";
CM_ BO_ 2147611648  "Source: isobus.net VDMA Data Dictionary (https://www.isobus.net/isobus/pGNAndSPN/17565?type=PGN)";
CM_ BO_ 2147611649  "Source: isobus.net VDMA Data Dictionary (https://www.isobus.net/isobus/pGNAndSPN/17566?type=PGN)";
CM_ BO_ 2147611650  "Source: isobus.net VDMA Data Dictionary (https://www.isobus.net/isobus/pGNAndSPN/17567?type=PGN)";
CM_ BO_ 2147611651  "Source: isobus.net VDMA Data Dictionary (https://www.isobus.net/isobus/pGNAndSPN/17568?type=PGN)";
CM_ BO_ 2147611654  "Source: isobus.net VDMA Data Dictionary (https://www.isobus.net/isobus/pGNAndSPN/17569?type=PGN)";
CM_ BO_ 2147611655  "Source: isobus.net VDMA Data Dictionary (https://www.isobus.net/isobus/pGNAndSPN/17570?type=PGN)";
CM_ BO_ 2147611656  "Source: isobus.net VDMA Data Dictionary (https://www.isobus.net/isobus/pGNAndSPN/17571?type=PGN)";
CM_ BO_ 2147611907  "Source: isobus.net VDMA Data Dictionary (https://www.isobus.net/isobus/pGNAndSPN/17572?type=PGN)";
CM_ BO_ 2147611915  "Source: isobus.net VDMA Data Dictionary (https://www.isobus.net/isobus/pGNAndSPN/17573?type=PGN)";
CM_ BO_ 2147611923  "Source: isobus.net VDMA Data Dictionary (https://www.isobus.net/isobus/pGNAndSPN/17574?type=PGN)";
CM_ BO_ 2147612168  "Source: isobus.net VDMA Data Dictionary (https://www.isobus.net/isobus/pGNAndSPN/17575?type=PGN)";
CM_ BO_ 2147612186  "Source: isobus.net VDMA Data Dictionary (https://www.isobus.net/isobus/pGNAndSPN/17576?type=PGN)";
CM_ BO_ 2147612416  "Source: isobus.net VDMA Data Dictionary (https://www.isobus.net/isobus/pGNAndSPN/17577?type=PGN)";
CM_ BO_ 2147612417  "Source: isobus.net VDMA Data Dictionary (https://www.isobus.net/isobus/pGNAndSPN/17578?type=PGN)";
CM_ BO_ 2147612424  "Source: isobus.net VDMA Data Dictionary (https://www.isobus.net/isobus/pGNAndSPN/17579?type=PGN)";
CM_ BO_ 2147612425  "Source: isobus.net VDMA Data Dictionary (https://www.isobus.net/isobus/pGNAndSPN/17580?type=PGN)";
CM_ BO_ 2147612426  "Source: isobus.net VDMA Data Dictionary (https://www.isobus.net/isobus/pGNAndSPN/17581?type=PGN)";
CM_ BO_ 2147612428  "Source: isobus.net VDMA Data Dictionary (https://www.isobus.net/isobus/pGNAndSPN/17582?type=PGN)";
CM_ BO_ 2147612676  "Source: isobus.net VDMA Data Dictionary (https://www.isobus.net/isobus/pGNAndSPN/17586?type=PGN)";
CM_ BO_ 2147612681  "Source: isobus.net VDMA Data Dictionary (https://www.isobus.net/isobus/pGNAndSPN/17588?type=PGN)";
CM_ BO_ 2147612686  "Source: isobus.net VDMA Data Dictionary (https://www.isobus.net/isobus/pGNAndSPN/17589?type=PGN)";
CM_ BO_ 2147612687  "Source: isobus.net VDMA Data Dictionary (https://www.isobus.net/isobus/pGNAndSPN/17590?type=PGN)";
CM_ BO_ 2147612688  "Source: isobus.net VDMA Data Dictionary (https://www.isobus.net/isobus/pGNAndSPN/17591?type=PGN)";
CM_ BO_ 2147612689  "Source: isobus.net VDMA Data Dictionary (https://www.isobus.net/isobus/pGNAndSPN/17592?type=PGN)";
CM_ BO_ 2147612693  "Source: isobus.net VDMA Data Dictionary (https://www.isobus.net/isobus/pGNAndSPN/17594?type=PGN)";
CM_ BO_ 2147612931  "Source: isobus.net VDMA Data Dictionary (https://www.isobus.net/isobus/pGNAndSPN/17595?type=PGN)";
CM_ BO_ 2147612932  "Source: isobus.net VDMA Data Dictionary (https://www.isobus.net/isobus/pGNAndSPN/17596?type=PGN)";
CM_ BO_ 2147612933  "Source: isobus.net VDMA Data Dictionary (https://www.isobus.net/isobus/pGNAndSPN/17597?type=PGN)";
CM_ BO_ 2147612939  "Source: isobus.net VDMA Data Dictionary (https://www.isobus.net/isobus/pGNAndSPN/17598?type=PGN)";
CM_ BO_ 2147612949  "Source: isobus.net VDMA Data Dictionary (https://www.isobus.net/isobus/pGNAndSPN/17599?type=PGN)";
CM_ BO_ 2147612950  "Source: isobus.net VDMA Data Dictionary (https://www.isobus.net/isobus/pGNAndSPN/17600?type=PGN)";
CM_ BO_ 2147613186  "Source: isobus.net VDMA Data Dictionary (https://www.isobus.net/isobus/pGNAndSPN/17601?type=PGN)";
CM_ BO_ 2147613187  "Source: isobus.net VDMA Data Dictionary (https://www.isobus.net/isobus/pGNAndSPN/17602?type=PGN)";
CM_ BO_ 2147613188  "Source: isobus.net VDMA Data Dictionary (https://www.isobus.net/isobus/pGNAndSPN/17603?type=PGN)";
CM_ BO_ 2147613189  "Source: isobus.net VDMA Data Dictionary (https://www.isobus.net/isobus/pGNAndSPN/17604?type=PGN)";
CM_ BO_ 2147613190  "Source: isobus.net VDMA Data Dictionary (https://www.isobus.net/isobus/pGNAndSPN/17605?type=PGN)";
CM_ BO_ 2147613193  "Source: isobus.net VDMA Data Dictionary (https://www.isobus.net/isobus/pGNAndSPN/17606?type=PGN)";
CM_ BO_ 2147613194  "Source: isobus.net VDMA Data Dictionary (https://www.isobus.net/isobus/pGNAndSPN/17607?type=PGN)";
CM_ BO_ 2147613195  "Source: isobus.net VDMA Data Dictionary (https://www.isobus.net/isobus/pGNAndSPN/17608?type=PGN)";
CM_ BO_ 2147613197  "Source: isobus.net VDMA Data Dictionary (https://www.isobus.net/isobus/pGNAndSPN/17609?type=PGN)";
CM_ BO_ 2147613198  "Source: isobus.net VDMA Data Dictionary (https://www.isobus.net/isobus/pGNAndSPN/17610?type=PGN)";
CM_ BO_ 2147613199  "Source: isobus.net VDMA Data Dictionary (https://www.isobus.net/isobus/pGNAndSPN/17611?type=PGN)";
CM_ BO_ 2147613204  "Source: isobus.net VDMA Data Dictionary (https://www.isobus.net/isobus/pGNAndSPN/17612?type=PGN)";
CM_ BO_ 2147613440  "Source: isobus.net VDMA Data Dictionary (https://www.isobus.net/isobus/pGNAndSPN/17613?type=PGN)";
CM_ BO_ 2147613441  "Source: isobus.net VDMA Data Dictionary (https://www.isobus.net/isobus/pGNAndSPN/17614?type=PGN)";
CM_ BO_ 2147613442  "Source: isobus.net VDMA Data Dictionary (https://www.isobus.net/isobus/pGNAndSPN/17615?type=PGN)";
CM_ BO_ 2147613443  "Source: isobus.net VDMA Data Dictionary (https://www.isobus.net/isobus/pGNAndSPN/17616?type=PGN)";
CM_ BO_ 2147613444  "Source: isobus.net VDMA Data Dictionary (https://www.isobus.net/isobus/pGNAndSPN/17617?type=PGN)";
CM_ BO_ 2147613445  "Source: isobus.net VDMA Data Dictionary (https://www.isobus.net/isobus/pGNAndSPN/17618?type=PGN)";
CM_ BO_ 2147613446  "Source: isobus.net VDMA Data Dictionary (https://www.isobus.net/isobus/pGNAndSPN/17619?type=PGN)";
CM_ BO_ 2147613447  "Source: isobus.net VDMA Data Dictionary (https://www.isobus.net/isobus/pGNAndSPN/17620?type=PGN)";
CM_ BO_ 2147613448  "Source: isobus.net VDMA Data Dictionary (https://www.isobus.net/isobus/pGNAndSPN/17621?type=PGN)";
CM_ BO_ 2147613449  "Source: isobus.net VDMA Data Dictionary (https://www.isobus.net/isobus/pGNAndSPN/17622?type=PGN)";
CM_ BO_ 2147613450  "Source: isobus.net VDMA Data Dictionary (https://www.isobus.net/isobus/pGNAndSPN/17623?type=PGN)";
CM_ BO_ 2147613451  "Source: isobus.net VDMA Data Dictionary (https://www.isobus.net/isobus/pGNAndSPN/17624?type=PGN)";
CM_ BO_ 2147613452  "Source: isobus.net VDMA Data Dictionary (https://www.isobus.net/isobus/pGNAndSPN/17625?type=PGN)";
CM_ BO_ 2147613453  "Source: isobus.net VDMA Data Dictionary (https://www.isobus.net/isobus/pGNAndSPN/17626?type=PGN)";
CM_ BO_ 2147613454  "Source: isobus.net VDMA Data Dictionary (https://www.isobus.net/isobus/pGNAndSPN/17627?type=PGN)";
CM_ BO_ 2147613455  "Source: isobus.net VDMA Data Dictionary (https://www.isobus.net/isobus/pGNAndSPN/17628?type=PGN)";
CM_ BO_ 2147613456  "Source: isobus.net VDMA Data Dictionary (https://www.isobus.net/isobus/pGNAndSPN/17629?type=PGN)";
CM_ BO_ 2147613457  "Source: isobus.net VDMA Data Dictionary (https://www.isobus.net/isobus/pGNAndSPN/17630?type=PGN)";
CM_ BO_ 2147613458  "Source: isobus.net VDMA Data Dictionary (https://www.isobus.net/isobus/pGNAndSPN/17631?type=PGN)";
CM_ BO_ 2147613459  "Source: isobus.net VDMA Data Dictionary (https://www.isobus.net/isobus/pGNAndSPN/17632?type=PGN)";
CM_ BO_ 2147613460  "Source: isobus.net VDMA Data Dictionary (https://www.isobus.net/isobus/pGNAndSPN/17633?type=PGN)";
CM_ BO_ 2147613461  "Source: isobus.net VDMA Data Dictionary (https://www.isobus.net/isobus/pGNAndSPN/17634?type=PGN)";
CM_ BO_ 2147613462  "Source: isobus.net VDMA Data Dictionary (https://www.isobus.net/isobus/pGNAndSPN/17635?type=PGN)";
CM_ BO_ 2147613463  "Source: isobus.net VDMA Data Dictionary (https://www.isobus.net/isobus/pGNAndSPN/17636?type=PGN)";
CM_ BO_ 2147613464  "Source: isobus.net VDMA Data Dictionary (https://www.isobus.net/isobus/pGNAndSPN/17637?type=PGN)";
CM_ BO_ 2147613700  "Source: isobus.net VDMA Data Dictionary (https://www.isobus.net/isobus/pGNAndSPN/17638?type=PGN)";
CM_ BO_ 2147613701  "Source: isobus.net VDMA Data Dictionary (https://www.isobus.net/isobus/pGNAndSPN/17639?type=PGN)";
CM_ BO_ 2147613702  "Source: isobus.net VDMA Data Dictionary (https://www.isobus.net/isobus/pGNAndSPN/17640?type=PGN)";
CM_ BO_ 2147613708  "Source: isobus.net VDMA Data Dictionary (https://www.isobus.net/isobus/pGNAndSPN/17641?type=PGN)";
CM_ BO_ 2147613709  "Source: isobus.net VDMA Data Dictionary (https://www.isobus.net/isobus/pGNAndSPN/17642?type=PGN)";
CM_ BO_ 2147613712  "Source: isobus.net VDMA Data Dictionary (https://www.isobus.net/isobus/pGNAndSPN/17643?type=PGN)";
CM_ BO_ 2147613713  "Source: isobus.net VDMA Data Dictionary (https://www.isobus.net/isobus/pGNAndSPN/17644?type=PGN)";
CM_ BO_ 2147613714  "Source: isobus.net VDMA Data Dictionary (https://www.isobus.net/isobus/pGNAndSPN/17645?type=PGN)";
CM_ BO_ 2147613715  "Source: isobus.net VDMA Data Dictionary (https://www.isobus.net/isobus/pGNAndSPN/17646?type=PGN)";
CM_ BO_ 2147613716  "Source: isobus.net VDMA Data Dictionary (https://www.isobus.net/isobus/pGNAndSPN/17647?type=PGN)";
CM_ BO_ 2147613717  "Source: isobus.net VDMA Data Dictionary (https://www.isobus.net/isobus/pGNAndSPN/17648?type=PGN)";
CM_ BO_ 2147613718  "Source: isobus.net VDMA Data Dictionary (https://www.isobus.net/isobus/pGNAndSPN/17649?type=PGN)";
CM_ BO_ 2147613719  "Source: isobus.net VDMA Data Dictionary (https://www.isobus.net/isobus/pGNAndSPN/17650?type=PGN)";
CM_ BO_ 2147613720  "Source: isobus.net VDMA Data Dictionary (https://www.isobus.net/isobus/pGNAndSPN/17651?type=PGN)";
CM_ BO_ 2147613721  "Source: isobus.net VDMA Data Dictionary (https://www.isobus.net/isobus/pGNAndSPN/17652?type=PGN)";
CM_ BO_ 2147613722  "Source: isobus.net VDMA Data Dictionary (https://www.isobus.net/isobus/pGNAndSPN/17653?type=PGN)";
CM_ BO_ 2147613954  "Source: isobus.net VDMA Data Dictionary (https://www.isobus.net/isobus/pGNAndSPN/17654?type=PGN)";
CM_ BO_ 2147613958  "Source: isobus.net VDMA Data Dictionary (https://www.isobus.net/isobus/pGNAndSPN/17655?type=PGN)";
CM_ BO_ 2147613959  "Source: isobus.net VDMA Data Dictionary (https://www.isobus.net/isobus/pGNAndSPN/17656?type=PGN)";
CM_ BO_ 2147613960  "Source: isobus.net VDMA Data Dictionary (https://www.isobus.net/isobus/pGNAndSPN/17657?type=PGN)";
CM_ BO_ 2147613961  "Source: isobus.net VDMA Data Dictionary (https://www.isobus.net/isobus/pGNAndSPN/17658?type=PGN)";
CM_ BO_ 2147613962  "Source: isobus.net VDMA Data Dictionary (https://www.isobus.net/isobus/pGNAndSPN/17659?type=PGN)";
CM_ BO_ 2147613963  "Source: isobus.net VDMA Data Dictionary (https://www.isobus.net/isobus/pGNAndSPN/17660?type=PGN)";
CM_ BO_ 2147613964  "Source: isobus.net VDMA Data Dictionary (https://www.isobus.net/isobus/pGNAndSPN/17661?type=PGN)";
CM_ BO_ 2147613968  "Source: isobus.net VDMA Data Dictionary (https://www.isobus.net/isobus/pGNAndSPN/17662?type=PGN)";
CM_ BO_ 2147613969  "Source: isobus.net VDMA Data Dictionary (https://www.isobus.net/isobus/pGNAndSPN/17663?type=PGN)";
CM_ BO_ 2147613970  "Source: isobus.net VDMA Data Dictionary (https://www.isobus.net/isobus/pGNAndSPN/17664?type=PGN)";
CM_ BO_ 2147613971  "Source: isobus.net VDMA Data Dictionary (https://www.isobus.net/isobus/pGNAndSPN/17665?type=PGN)";
CM_ BO_ 2147613972  "Source: isobus.net VDMA Data Dictionary (https://www.isobus.net/isobus/pGNAndSPN/17666?type=PGN)";
CM_ BO_ 2147613978  "Source: isobus.net VDMA Data Dictionary (https://www.isobus.net/isobus/pGNAndSPN/17667?type=PGN)";
CM_ BO_ 2147614208  "Source: isobus.net VDMA Data Dictionary (https://www.isobus.net/isobus/pGNAndSPN/17668?type=PGN)";
CM_ BO_ 2147614209  "Source: isobus.net VDMA Data Dictionary (https://www.isobus.net/isobus/pGNAndSPN/17669?type=PGN)";
CM_ BO_ 2147614210  "Source: isobus.net VDMA Data Dictionary (https://www.isobus.net/isobus/pGNAndSPN/17670?type=PGN)";
CM_ BO_ 2147614211  "Source: isobus.net VDMA Data Dictionary (https://www.isobus.net/isobus/pGNAndSPN/17671?type=PGN)";
CM_ BO_ 2147614212  "Source: isobus.net VDMA Data Dictionary (https://www.isobus.net/isobus/pGNAndSPN/17672?type=PGN)";
CM_ BO_ 2147614213  "Source: isobus.net VDMA Data Dictionary (https://www.isobus.net/isobus/pGNAndSPN/17673?type=PGN)";
CM_ BO_ 2147614214  "Source: isobus.net VDMA Data Dictionary (https://www.isobus.net/isobus/pGNAndSPN/17674?type=PGN)";
CM_ BO_ 2147614215  "Source: isobus.net VDMA Data Dictionary (https://www.isobus.net/isobus/pGNAndSPN/17675?type=PGN)";
CM_ BO_ 2147614216  "Source: isobus.net VDMA Data Dictionary (https://www.isobus.net/isobus/pGNAndSPN/17676?type=PGN)";
CM_ BO_ 2147614217  "Source: isobus.net VDMA Data Dictionary (https://www.isobus.net/isobus/pGNAndSPN/17677?type=PGN)";
CM_ BO_ 2147614218  "Source: isobus.net VDMA Data Dictionary (https://www.isobus.net/isobus/pGNAndSPN/17678?type=PGN)";
CM_ BO_ 2147614219  "Source: isobus.net VDMA Data Dictionary (https://www.isobus.net/isobus/pGNAndSPN/17679?type=PGN)";
CM_ BO_ 2147614220  "Source: isobus.net VDMA Data Dictionary (https://www.isobus.net/isobus/pGNAndSPN/17680?type=PGN)";
CM_ BO_ 2147614221  "Source: isobus.net VDMA Data Dictionary (https://www.isobus.net/isobus/pGNAndSPN/17681?type=PGN)";
CM_ BO_ 2147614222  "Source: isobus.net VDMA Data Dictionary (https://www.isobus.net/isobus/pGNAndSPN/17682?type=PGN)";
CM_ BO_ 2147614223  "Source: isobus.net VDMA Data Dictionary (https://www.isobus.net/isobus/pGNAndSPN/17683?type=PGN)";
CM_ BO_ 2147614224  "Source: isobus.net VDMA Data Dictionary (https://www.isobus.net/isobus/pGNAndSPN/17684?type=PGN)";
CM_ BO_ 2147614225  "Source: isobus.net VDMA Data Dictionary (https://www.isobus.net/isobus/pGNAndSPN/17685?type=PGN)";
CM_ BO_ 2147614226  "Source: isobus.net VDMA Data Dictionary (https://www.isobus.net/isobus/pGNAndSPN/17686?type=PGN)";
CM_ BO_ 2147614227  "Source: isobus.net VDMA Data Dictionary (https://www.isobus.net/isobus/pGNAndSPN/17687?type=PGN)";
CM_ BO_ 2147614228  "Source: isobus.net VDMA Data Dictionary (https://www.isobus.net/isobus/pGNAndSPN/17688?type=PGN)";
CM_ BO_ 2147614229  "Source: isobus.net VDMA Data Dictionary (https://www.isobus.net/isobus/pGNAndSPN/17689?type=PGN)";
CM_ BO_ 2147614230  "Source: isobus.net VDMA Data Dictionary (https://www.isobus.net/isobus/pGNAndSPN/17690?type=PGN)";
CM_ BO_ 2147614231  "Source: isobus.net VDMA Data Dictionary (https://www.isobus.net/isobus/pGNAndSPN/17691?type=PGN)";
CM_ BO_ 2147614232  "Source: isobus.net VDMA Data Dictionary (https://www.isobus.net/isobus/pGNAndSPN/17692?type=PGN)";
CM_ BO_ 2147614233  "Source: isobus.net VDMA Data Dictionary (https://www.isobus.net/isobus/pGNAndSPN/17693?type=PGN)";
CM_ BO_ 2147614234  "Source: isobus.net VDMA Data Dictionary (https://www.isobus.net/isobus/pGNAndSPN/17694?type=PGN)";
CM_ SG_ 2147548773 General_Purpose_Message_1_6_RawP "Generic 8-byte raw payload. Detail page: https://www.isobus.net/isobus/pGNAndSPN/16407?type=PGN. Signal-level enrichment via PR welcome  see CONTRIBUTING.md.";
CM_ SG_ 2147548774 Battery_Main_Switch_Information_ "Generic 8-byte raw payload. Detail page: https://www.isobus.net/isobus/pGNAndSPN/16408?type=PGN. Signal-level enrichment via PR welcome  see CONTRIBUTING.md.";
CM_ SG_ 2147548775 Climate_Control_Configuration_Ra "Generic 8-byte raw payload. Detail page: https://www.isobus.net/isobus/pGNAndSPN/16409?type=PGN. Signal-level enrichment via PR welcome  see CONTRIBUTING.md.";
CM_ SG_ 2147548776 Vehicle_Fluids_RawPayload "Generic 8-byte raw payload. Detail page: https://www.isobus.net/isobus/pGNAndSPN/16413?type=PGN. Signal-level enrichment via PR welcome  see CONTRIBUTING.md.";
CM_ SG_ 2147548777 Engine_Temperature_3_RawPayload "Generic 8-byte raw payload. Detail page: https://www.isobus.net/isobus/pGNAndSPN/16417?type=PGN. Signal-level enrichment via PR welcome  see CONTRIBUTING.md.";
CM_ SG_ 2147548778 Engine_Fuel_Lube_Systems_RawPayl "Generic 8-byte raw payload. Detail page: https://www.isobus.net/isobus/pGNAndSPN/16430?type=PGN. Signal-level enrichment via PR welcome  see CONTRIBUTING.md.";
CM_ SG_ 2147548779 Driver_s_Identification_RawPaylo "Generic 8-byte raw payload. Detail page: https://www.isobus.net/isobus/pGNAndSPN/16432?type=PGN. Signal-level enrichment via PR welcome  see CONTRIBUTING.md.";
CM_ SG_ 2147548781 Heater_Information_RawPayload "Generic 8-byte raw payload. Detail page: https://www.isobus.net/isobus/pGNAndSPN/16455?type=PGN. Signal-level enrichment via PR welcome  see CONTRIBUTING.md.";
CM_ SG_ 2147548782 High_Resolution_Wheel_Speed_RawP "Generic 8-byte raw payload. Detail page: https://www.isobus.net/isobus/pGNAndSPN/16459?type=PGN. Signal-level enrichment via PR welcome  see CONTRIBUTING.md.";
CM_ SG_ 2147548783 Adaptive_Cruise_Control_1_RawPay "Generic 8-byte raw payload. Detail page: https://www.isobus.net/isobus/pGNAndSPN/16469?type=PGN. Signal-level enrichment via PR welcome  see CONTRIBUTING.md.";
CM_ SG_ 2147548784 Combination_Vehicle_Weight_RawPa "Generic 8-byte raw payload. Detail page: https://www.isobus.net/isobus/pGNAndSPN/16472?type=PGN. Signal-level enrichment via PR welcome  see CONTRIBUTING.md.";
CM_ SG_ 2147548785 Laser_Tracer_Position_RawPayload "Generic 8-byte raw payload. Detail page: https://www.isobus.net/isobus/pGNAndSPN/16477?type=PGN. Signal-level enrichment via PR welcome  see CONTRIBUTING.md.";
CM_ SG_ 2147548786 Laser_Leveling_System_Blade_Cont "Generic 8-byte raw payload. Detail page: https://www.isobus.net/isobus/pGNAndSPN/16482?type=PGN. Signal-level enrichment via PR welcome  see CONTRIBUTING.md.";
CM_ SG_ 2147548787 Laser_Receiver_Mast_Position_Raw "Generic 8-byte raw payload. Detail page: https://www.isobus.net/isobus/pGNAndSPN/16483?type=PGN. Signal-level enrichment via PR welcome  see CONTRIBUTING.md.";
CM_ SG_ 2147548788 Modify_Leveling_System_Control_S "Generic 8-byte raw payload. Detail page: https://www.isobus.net/isobus/pGNAndSPN/16485?type=PGN. Signal-level enrichment via PR welcome  see CONTRIBUTING.md.";
CM_ SG_ 2147548789 Laser_Leveling_System_Vertical_D "Generic 8-byte raw payload. Detail page: https://www.isobus.net/isobus/pGNAndSPN/16489?type=PGN. Signal-level enrichment via PR welcome  see CONTRIBUTING.md.";
CM_ SG_ 2147548790 Laser_Leveling_System_Vertical_P "Generic 8-byte raw payload. Detail page: https://www.isobus.net/isobus/pGNAndSPN/16494?type=PGN. Signal-level enrichment via PR welcome  see CONTRIBUTING.md.";
CM_ SG_ 2147548791 Auxiliary_Pressures_RawPayload "Generic 8-byte raw payload. Detail page: https://www.isobus.net/isobus/pGNAndSPN/16497?type=PGN. Signal-level enrichment via PR welcome  see CONTRIBUTING.md.";
CM_ SG_ 2147548792 Tire_Pressure_Control_Unit_Mode_ "Generic 8-byte raw payload. Detail page: https://www.isobus.net/isobus/pGNAndSPN/16508?type=PGN. Signal-level enrichment via PR welcome  see CONTRIBUTING.md.";
CM_ SG_ 2147548793 Tire_Pressure_Control_Unit_Targe "Generic 8-byte raw payload. Detail page: https://www.isobus.net/isobus/pGNAndSPN/16511?type=PGN. Signal-level enrichment via PR welcome  see CONTRIBUTING.md.";
CM_ SG_ 2147548794 Tire_Pressure_Control_Unit_Curre "Generic 8-byte raw payload. Detail page: https://www.isobus.net/isobus/pGNAndSPN/16514?type=PGN. Signal-level enrichment via PR welcome  see CONTRIBUTING.md.";
CM_ SG_ 2147548795 Combustion_Time_1_RawPayload "Generic 8-byte raw payload. Detail page: https://www.isobus.net/isobus/pGNAndSPN/16518?type=PGN. Signal-level enrichment via PR welcome  see CONTRIBUTING.md.";
CM_ SG_ 2147548796 Combustion_Time_2_RawPayload "Generic 8-byte raw payload. Detail page: https://www.isobus.net/isobus/pGNAndSPN/16522?type=PGN. Signal-level enrichment via PR welcome  see CONTRIBUTING.md.";
CM_ SG_ 2147548797 Combustion_Time_3_RawPayload "Generic 8-byte raw payload. Detail page: https://www.isobus.net/isobus/pGNAndSPN/16526?type=PGN. Signal-level enrichment via PR welcome  see CONTRIBUTING.md.";
CM_ SG_ 2147548798 Combustion_Time_4_RawPayload "Generic 8-byte raw payload. Detail page: https://www.isobus.net/isobus/pGNAndSPN/16530?type=PGN. Signal-level enrichment via PR welcome  see CONTRIBUTING.md.";
CM_ SG_ 2147548799 Combustion_Time_5_RawPayload "Generic 8-byte raw payload. Detail page: https://www.isobus.net/isobus/pGNAndSPN/16534?type=PGN. Signal-level enrichment via PR welcome  see CONTRIBUTING.md.";
CM_ SG_ 2147548800 Combustion_Time_6_RawPayload "Generic 8-byte raw payload. Detail page: https://www.isobus.net/isobus/pGNAndSPN/16536?type=PGN. Signal-level enrichment via PR welcome  see CONTRIBUTING.md.";
CM_ SG_ 2147548801 Fuel_Information_2_Gaseous_RawPa "Generic 8-byte raw payload. Detail page: https://www.isobus.net/isobus/pGNAndSPN/16542?type=PGN. Signal-level enrichment via PR welcome  see CONTRIBUTING.md.";
CM_ SG_ 2147548802 Ignition_Timing_1_RawPayload "Generic 8-byte raw payload. Detail page: https://www.isobus.net/isobus/pGNAndSPN/16546?type=PGN. Signal-level enrichment via PR welcome  see CONTRIBUTING.md.";
CM_ SG_ 2147548803 Ignition_Timing_2_RawPayload "Generic 8-byte raw payload. Detail page: https://www.isobus.net/isobus/pGNAndSPN/16550?type=PGN. Signal-level enrichment via PR welcome  see CONTRIBUTING.md.";
CM_ SG_ 2147548804 Ignition_Timing_3_RawPayload "Generic 8-byte raw payload. Detail page: https://www.isobus.net/isobus/pGNAndSPN/16554?type=PGN. Signal-level enrichment via PR welcome  see CONTRIBUTING.md.";
CM_ SG_ 2147548805 Ignition_Timing_4_RawPayload "Generic 8-byte raw payload. Detail page: https://www.isobus.net/isobus/pGNAndSPN/16558?type=PGN. Signal-level enrichment via PR welcome  see CONTRIBUTING.md.";
CM_ SG_ 2147548806 Ignition_Timing_5_RawPayload "Generic 8-byte raw payload. Detail page: https://www.isobus.net/isobus/pGNAndSPN/16562?type=PGN. Signal-level enrichment via PR welcome  see CONTRIBUTING.md.";
CM_ SG_ 2147548807 Ignition_Timing_6_RawPayload "Generic 8-byte raw payload. Detail page: https://www.isobus.net/isobus/pGNAndSPN/16566?type=PGN. Signal-level enrichment via PR welcome  see CONTRIBUTING.md.";
CM_ SG_ 2147548808 Ignition_Transformer_Secondary_O "Generic 8-byte raw payload. Detail page: https://www.isobus.net/isobus/pGNAndSPN/16574?type=PGN. Signal-level enrichment via PR welcome  see CONTRIBUTING.md.";
CM_ SG_ 2147548809 Ignition_Transformer_Secondary_O "Generic 8-byte raw payload. Detail page: https://www.isobus.net/isobus/pGNAndSPN/16582?type=PGN. Signal-level enrichment via PR welcome  see CONTRIBUTING.md.";
CM_ SG_ 2147548810 Ignition_Transformer_Secondary_O "Generic 8-byte raw payload. Detail page: https://www.isobus.net/isobus/pGNAndSPN/16586?type=PGN. Signal-level enrichment via PR welcome  see CONTRIBUTING.md.";
CM_ SG_ 2147548811 Gaseous_Fuel_Pressure_1_RawPaylo "Generic 8-byte raw payload. Detail page: https://www.isobus.net/isobus/pGNAndSPN/16590?type=PGN. Signal-level enrichment via PR welcome  see CONTRIBUTING.md.";
CM_ SG_ 2147548812 Auxiliary_Analog_Information_Raw "Generic 8-byte raw payload. Detail page: https://www.isobus.net/isobus/pGNAndSPN/16597?type=PGN. Signal-level enrichment via PR welcome  see CONTRIBUTING.md.";
CM_ SG_ 2147548813 Vehicle_Electrical_Power_2_RawPa "Generic 8-byte raw payload. Detail page: https://www.isobus.net/isobus/pGNAndSPN/16601?type=PGN. Signal-level enrichment via PR welcome  see CONTRIBUTING.md.";
CM_ SG_ 2147548814 Service_2_RawPayload "Generic 8-byte raw payload. Detail page: https://www.isobus.net/isobus/pGNAndSPN/16603?type=PGN. Signal-level enrichment via PR welcome  see CONTRIBUTING.md.";
CM_ SG_ 2147548815 Supply_Pressure_2_RawPayload "Generic 8-byte raw payload. Detail page: https://www.isobus.net/isobus/pGNAndSPN/16604?type=PGN. Signal-level enrichment via PR welcome  see CONTRIBUTING.md.";
CM_ SG_ 2147548816 Engine_Torque_History_RawPayload "Generic 8-byte raw payload. Detail page: https://www.isobus.net/isobus/pGNAndSPN/16623?type=PGN. Signal-level enrichment via PR welcome  see CONTRIBUTING.md.";
CM_ SG_ 2147548817 Fuel_Leakage_RawPayload "Generic 8-byte raw payload. Detail page: https://www.isobus.net/isobus/pGNAndSPN/16626?type=PGN. Signal-level enrichment via PR welcome  see CONTRIBUTING.md.";
CM_ SG_ 2147548818 Engine_Information_1_RawPayload "Generic 8-byte raw payload. Detail page: https://www.isobus.net/isobus/pGNAndSPN/16631?type=PGN. Signal-level enrichment via PR welcome  see CONTRIBUTING.md.";
CM_ SG_ 2147548819 Engine_Electrical_System_Module_ "Generic 8-byte raw payload. Detail page: https://www.isobus.net/isobus/pGNAndSPN/16634?type=PGN. Signal-level enrichment via PR welcome  see CONTRIBUTING.md.";
CM_ SG_ 2147548820 Engine_Auxiliary_Coolant_RawPayl "Generic 8-byte raw payload. Detail page: https://www.isobus.net/isobus/pGNAndSPN/16642?type=PGN. Signal-level enrichment via PR welcome  see CONTRIBUTING.md.";
CM_ SG_ 2147548821 Rebuild_Information_RawPayload "Generic 8-byte raw payload. Detail page: https://www.isobus.net/isobus/pGNAndSPN/16643?type=PGN. Signal-level enrichment via PR welcome  see CONTRIBUTING.md.";
CM_ SG_ 2147548822 Turbocharger_Wastegate_RawPayloa "Generic 8-byte raw payload. Detail page: https://www.isobus.net/isobus/pGNAndSPN/16652?type=PGN. Signal-level enrichment via PR welcome  see CONTRIBUTING.md.";
CM_ SG_ 2147548823 Turbocharger_Information_5_RawPa "Generic 8-byte raw payload. Detail page: https://www.isobus.net/isobus/pGNAndSPN/16656?type=PGN. Signal-level enrichment via PR welcome  see CONTRIBUTING.md.";
CM_ SG_ 2147548824 Turbocharger_Information_4_RawPa "Generic 8-byte raw payload. Detail page: https://www.isobus.net/isobus/pGNAndSPN/16660?type=PGN. Signal-level enrichment via PR welcome  see CONTRIBUTING.md.";
CM_ SG_ 2147548825 Turbocharger_Information_3_RawPa "Generic 8-byte raw payload. Detail page: https://www.isobus.net/isobus/pGNAndSPN/16664?type=PGN. Signal-level enrichment via PR welcome  see CONTRIBUTING.md.";
CM_ SG_ 2147548826 Turbocharger_Information_2_RawPa "Generic 8-byte raw payload. Detail page: https://www.isobus.net/isobus/pGNAndSPN/16668?type=PGN. Signal-level enrichment via PR welcome  see CONTRIBUTING.md.";
CM_ SG_ 2147548827 Turbocharger_Information_1_RawPa "Generic 8-byte raw payload. Detail page: https://www.isobus.net/isobus/pGNAndSPN/16672?type=PGN. Signal-level enrichment via PR welcome  see CONTRIBUTING.md.";
CM_ SG_ 2147548828 Main_Bearing_Temperature_3_RawPa "Generic 8-byte raw payload. Detail page: https://www.isobus.net/isobus/pGNAndSPN/16676?type=PGN. Signal-level enrichment via PR welcome  see CONTRIBUTING.md.";
CM_ SG_ 2147548829 Main_Bearing_Temperature_2_RawPa "Generic 8-byte raw payload. Detail page: https://www.isobus.net/isobus/pGNAndSPN/16680?type=PGN. Signal-level enrichment via PR welcome  see CONTRIBUTING.md.";
CM_ SG_ 2147548830 Main_Bearing_Temperature_1_RawPa "Generic 8-byte raw payload. Detail page: https://www.isobus.net/isobus/pGNAndSPN/16684?type=PGN. Signal-level enrichment via PR welcome  see CONTRIBUTING.md.";
CM_ SG_ 2147548831 Exhaust_Port_Temperature_5_RawPa "Generic 8-byte raw payload. Detail page: https://www.isobus.net/isobus/pGNAndSPN/16688?type=PGN. Signal-level enrichment via PR welcome  see CONTRIBUTING.md.";
CM_ SG_ 2147548832 Exhaust_Port_Temperature_4_RawPa "Generic 8-byte raw payload. Detail page: https://www.isobus.net/isobus/pGNAndSPN/16692?type=PGN. Signal-level enrichment via PR welcome  see CONTRIBUTING.md.";
CM_ SG_ 2147548833 Exhaust_Port_Temperature_3_RawPa "Generic 8-byte raw payload. Detail page: https://www.isobus.net/isobus/pGNAndSPN/16696?type=PGN. Signal-level enrichment via PR welcome  see CONTRIBUTING.md.";
CM_ SG_ 2147548834 Exhaust_Port_Temperature_2_RawPa "Generic 8-byte raw payload. Detail page: https://www.isobus.net/isobus/pGNAndSPN/16700?type=PGN. Signal-level enrichment via PR welcome  see CONTRIBUTING.md.";
CM_ SG_ 2147548835 Exhaust_Port_Temperature_1_RawPa "Generic 8-byte raw payload. Detail page: https://www.isobus.net/isobus/pGNAndSPN/16704?type=PGN. Signal-level enrichment via PR welcome  see CONTRIBUTING.md.";
CM_ SG_ 2147548836 Engine_Temperature_2_RawPayload "Generic 8-byte raw payload. Detail page: https://www.isobus.net/isobus/pGNAndSPN/16708?type=PGN. Signal-level enrichment via PR welcome  see CONTRIBUTING.md.";
CM_ SG_ 2147548837 Intake_Manifold_Information_2_Ra "Generic 8-byte raw payload. Detail page: https://www.isobus.net/isobus/pGNAndSPN/16715?type=PGN. Signal-level enrichment via PR welcome  see CONTRIBUTING.md.";
CM_ SG_ 2147548838 Intake_Manifold_Information_1_Ra "Generic 8-byte raw payload. Detail page: https://www.isobus.net/isobus/pGNAndSPN/16719?type=PGN. Signal-level enrichment via PR welcome  see CONTRIBUTING.md.";
CM_ SG_ 2147548839 Alternator_Temperature_1_RawPayl "Generic 8-byte raw payload. Detail page: https://www.isobus.net/isobus/pGNAndSPN/16727?type=PGN. Signal-level enrichment via PR welcome  see CONTRIBUTING.md.";
CM_ SG_ 2147548840 Articulation_Control_RawPayload "Generic 8-byte raw payload. Detail page: https://www.isobus.net/isobus/pGNAndSPN/16729?type=PGN. Signal-level enrichment via PR welcome  see CONTRIBUTING.md.";
CM_ SG_ 2147548841 Exhaust_Oxygen_1_RawPayload "Generic 8-byte raw payload. Detail page: https://www.isobus.net/isobus/pGNAndSPN/16734?type=PGN. Signal-level enrichment via PR welcome  see CONTRIBUTING.md.";
CM_ SG_ 2147548842 Alternate_Fuel_2_RawPayload "Generic 8-byte raw payload. Detail page: https://www.isobus.net/isobus/pGNAndSPN/16739?type=PGN. Signal-level enrichment via PR welcome  see CONTRIBUTING.md.";
CM_ SG_ 2147548843 Electronic_Transmission_Controll "Generic 8-byte raw payload. Detail page: https://www.isobus.net/isobus/pGNAndSPN/16743?type=PGN. Signal-level enrichment via PR welcome  see CONTRIBUTING.md.";
CM_ SG_ 2147548844 Wheel_Brake_Lining_Remaining_Inf "Generic 8-byte raw payload. Detail page: https://www.isobus.net/isobus/pGNAndSPN/16751?type=PGN. Signal-level enrichment via PR welcome  see CONTRIBUTING.md.";
CM_ SG_ 2147548845 Wheel_Application_Pressure_High_ "Generic 8-byte raw payload. Detail page: https://www.isobus.net/isobus/pGNAndSPN/16759?type=PGN. Signal-level enrichment via PR welcome  see CONTRIBUTING.md.";
CM_ SG_ 2147548846 Air_Supply_Pressure_RawPayload "Generic 8-byte raw payload. Detail page: https://www.isobus.net/isobus/pGNAndSPN/16767?type=PGN. Signal-level enrichment via PR welcome  see CONTRIBUTING.md.";
CM_ SG_ 2147548847 Fuel_Consumption_Gaseous_RawPayl "Generic 8-byte raw payload. Detail page: https://www.isobus.net/isobus/pGNAndSPN/16769?type=PGN. Signal-level enrichment via PR welcome  see CONTRIBUTING.md.";
CM_ SG_ 2147548848 Trip_Time_Information_2_RawPaylo "Generic 8-byte raw payload. Detail page: https://www.isobus.net/isobus/pGNAndSPN/16774?type=PGN. Signal-level enrichment via PR welcome  see CONTRIBUTING.md.";
CM_ SG_ 2147548849 ECU_History_RawPayload "Generic 8-byte raw payload. Detail page: https://www.isobus.net/isobus/pGNAndSPN/16776?type=PGN. Signal-level enrichment via PR welcome  see CONTRIBUTING.md.";
CM_ SG_ 2147548850 Fuel_Information_1_Gaseous_RawPa "Generic 8-byte raw payload. Detail page: https://www.isobus.net/isobus/pGNAndSPN/16779?type=PGN. Signal-level enrichment via PR welcome  see CONTRIBUTING.md.";
CM_ SG_ 2147548851 Fuel_Information_1_Liquid_RawPay "Generic 8-byte raw payload. Detail page: https://www.isobus.net/isobus/pGNAndSPN/16782?type=PGN. Signal-level enrichment via PR welcome  see CONTRIBUTING.md.";
CM_ SG_ 2147548852 Trip_Time_Information_1_RawPaylo "Generic 8-byte raw payload. Detail page: https://www.isobus.net/isobus/pGNAndSPN/16786?type=PGN. Signal-level enrichment via PR welcome  see CONTRIBUTING.md.";
CM_ SG_ 2147548853 Trip_Shutdown_Information_RawPay "Generic 8-byte raw payload. Detail page: https://www.isobus.net/isobus/pGNAndSPN/16790?type=PGN. Signal-level enrichment via PR welcome  see CONTRIBUTING.md.";
CM_ SG_ 2147548854 Trip_Vehicle_Speed_Cruise_Distan "Generic 8-byte raw payload. Detail page: https://www.isobus.net/isobus/pGNAndSPN/16792?type=PGN. Signal-level enrichment via PR welcome  see CONTRIBUTING.md.";
CM_ SG_ 2147548855 Engine_Speed_Load_Factor_Informa "Generic 8-byte raw payload. Detail page: https://www.isobus.net/isobus/pGNAndSPN/16797?type=PGN. Signal-level enrichment via PR welcome  see CONTRIBUTING.md.";
CM_ SG_ 2147548856 Trip_Fuel_Information_Gaseous_Ra "Generic 8-byte raw payload. Detail page: https://www.isobus.net/isobus/pGNAndSPN/16803?type=PGN. Signal-level enrichment via PR welcome  see CONTRIBUTING.md.";
CM_ SG_ 2147548857 Trip_Fuel_Information_Liquid_Raw "Generic 8-byte raw payload. Detail page: https://www.isobus.net/isobus/pGNAndSPN/16809?type=PGN. Signal-level enrichment via PR welcome  see CONTRIBUTING.md.";
CM_ SG_ 2147548858 Trip_Distance_Information_RawPay "Generic 8-byte raw payload. Detail page: https://www.isobus.net/isobus/pGNAndSPN/16812?type=PGN. Signal-level enrichment via PR welcome  see CONTRIBUTING.md.";
CM_ SG_ 2147548859 Trip_Fan_Information_RawPayload "Generic 8-byte raw payload. Detail page: https://www.isobus.net/isobus/pGNAndSPN/16816?type=PGN. Signal-level enrichment via PR welcome  see CONTRIBUTING.md.";
CM_ SG_ 2147548860 Compression_Service_Brake_Inform "Generic 8-byte raw payload. Detail page: https://www.isobus.net/isobus/pGNAndSPN/16820?type=PGN. Signal-level enrichment via PR welcome  see CONTRIBUTING.md.";
CM_ SG_ 2147548861 Fan_Drive_1_RawPayload "Generic 8-byte raw payload. Detail page: https://www.isobus.net/isobus/pGNAndSPN/16827?type=PGN. Signal-level enrichment via PR welcome  see CONTRIBUTING.md.";
CM_ SG_ 2147548862 Electronic_Engine_Controller_4_R "Generic 8-byte raw payload. Detail page: https://www.isobus.net/isobus/pGNAndSPN/16833?type=PGN. Signal-level enrichment via PR welcome  see CONTRIBUTING.md.";
CM_ SG_ 2147548863 Wheel_Speed_Information_RawPaylo "Generic 8-byte raw payload. Detail page: https://www.isobus.net/isobus/pGNAndSPN/16840?type=PGN. Signal-level enrichment via PR welcome  see CONTRIBUTING.md.";
CM_ SG_ 2147548864 Service_Information_RawPayload "Generic 8-byte raw payload. Detail page: https://www.isobus.net/isobus/pGNAndSPN/16846?type=PGN. Signal-level enrichment via PR welcome  see CONTRIBUTING.md.";
CM_ SG_ 2147548865 High_Resolution_Vehicle_Distance "Generic 8-byte raw payload. Detail page: https://www.isobus.net/isobus/pGNAndSPN/16848?type=PGN. Signal-level enrichment via PR welcome  see CONTRIBUTING.md.";
CM_ SG_ 2147548866 Electronic_Retarder_Controller_2 "Generic 8-byte raw payload. Detail page: https://www.isobus.net/isobus/pGNAndSPN/16856?type=PGN. Signal-level enrichment via PR welcome  see CONTRIBUTING.md.";
CM_ SG_ 2147548867 Electronic_Transmission_Controll "Generic 8-byte raw payload. Detail page: https://www.isobus.net/isobus/pGNAndSPN/16862?type=PGN. Signal-level enrichment via PR welcome  see CONTRIBUTING.md.";
CM_ SG_ 2147548868 Electronic_Brake_System_2_2_RawP "Generic 8-byte raw payload. Detail page: https://www.isobus.net/isobus/pGNAndSPN/16863?type=PGN. Signal-level enrichment via PR welcome  see CONTRIBUTING.md.";
CM_ SG_ 2147548869 Electronic_Transmission_Controll "Generic 8-byte raw payload. Detail page: https://www.isobus.net/isobus/pGNAndSPN/16865?type=PGN. Signal-level enrichment via PR welcome  see CONTRIBUTING.md.";
CM_ SG_ 2147548870 Electronic_Brake_System_2_3_RawP "Generic 8-byte raw payload. Detail page: https://www.isobus.net/isobus/pGNAndSPN/16866?type=PGN. Signal-level enrichment via PR welcome  see CONTRIBUTING.md.";
CM_ SG_ 2147548871 Electronic_Transmission_Controll "Generic 8-byte raw payload. Detail page: https://www.isobus.net/isobus/pGNAndSPN/16883?type=PGN. Signal-level enrichment via PR welcome  see CONTRIBUTING.md.";
CM_ SG_ 2147548872 General_Purpose_Message_2_2_RawP "Generic 8-byte raw payload. Detail page: https://www.isobus.net/isobus/pGNAndSPN/16884?type=PGN. Signal-level enrichment via PR welcome  see CONTRIBUTING.md.";
CM_ SG_ 2147548873 Electronic_Brake_System_1_2_RawP "Generic 8-byte raw payload. Detail page: https://www.isobus.net/isobus/pGNAndSPN/16885?type=PGN. Signal-level enrichment via PR welcome  see CONTRIBUTING.md.";
CM_ SG_ 2147548877 Freeze_Frame_Parameters_RawPaylo "Generic 8-byte raw payload. Detail page: https://www.isobus.net/isobus/pGNAndSPN/16900?type=PGN. Signal-level enrichment via PR welcome  see CONTRIBUTING.md.";
CM_ SG_ 2147548878 Diagnostic_Readiness_1_RawPayloa "Generic 8-byte raw payload. Detail page: https://www.isobus.net/isobus/pGNAndSPN/16906?type=PGN. Signal-level enrichment via PR welcome  see CONTRIBUTING.md.";
CM_ SG_ 2147548879 Emission_Related_Pending_Diagnos "Generic 8-byte raw payload. Detail page: https://www.isobus.net/isobus/pGNAndSPN/16918?type=PGN. Signal-level enrichment via PR welcome  see CONTRIBUTING.md.";
CM_ SG_ 2147548880 Test_Results_for_Non_continuousl "Generic 8-byte raw payload. Detail page: https://www.isobus.net/isobus/pGNAndSPN/16923?type=PGN. Signal-level enrichment via PR welcome  see CONTRIBUTING.md.";
CM_ SG_ 2147548881 Oxygen_Sensor_Test_Results_RawPa "Generic 8-byte raw payload. Detail page: https://www.isobus.net/isobus/pGNAndSPN/16924?type=PGN. Signal-level enrichment via PR welcome  see CONTRIBUTING.md.";
CM_ SG_ 2147548882 Non_Continuously_Monitored_Syste "Generic 8-byte raw payload. Detail page: https://www.isobus.net/isobus/pGNAndSPN/16925?type=PGN. Signal-level enrichment via PR welcome  see CONTRIBUTING.md.";
CM_ SG_ 2147548884 Emission_Related_MIL_On_Diagnost "Generic 8-byte raw payload. Detail page: https://www.isobus.net/isobus/pGNAndSPN/16938?type=PGN. Signal-level enrichment via PR welcome  see CONTRIBUTING.md.";
CM_ SG_ 2147548885 Alternator_Information_1_RawPayl "Generic 8-byte raw payload. Detail page: https://www.isobus.net/isobus/pGNAndSPN/16950?type=PGN. Signal-level enrichment via PR welcome  see CONTRIBUTING.md.";
CM_ SG_ 2147548886 Hybrid_or_EV_System_Inputs_1_Raw "Generic 8-byte raw payload. Detail page: https://www.isobus.net/isobus/pGNAndSPN/16966?type=PGN. Signal-level enrichment via PR welcome  see CONTRIBUTING.md.";
CM_ SG_ 2147548889 Auxiliary_Input_Output_Status_1_ "Generic 8-byte raw payload. Detail page: https://www.isobus.net/isobus/pGNAndSPN/16986?type=PGN. Signal-level enrichment via PR welcome  see CONTRIBUTING.md.";
CM_ SG_ 2147548891 Engine_Fluid_Level_Pressure_2_Ra "Generic 8-byte raw payload. Detail page: https://www.isobus.net/isobus/pGNAndSPN/16992?type=PGN. Signal-level enrichment via PR welcome  see CONTRIBUTING.md.";
CM_ SG_ 2147548892 Idle_Operation_RawPayload "Generic 8-byte raw payload. Detail page: https://www.isobus.net/isobus/pGNAndSPN/16994?type=PGN. Signal-level enrichment via PR welcome  see CONTRIBUTING.md.";
CM_ SG_ 2147548893 Turbocharger_RawPayload "Generic 8-byte raw payload. Detail page: https://www.isobus.net/isobus/pGNAndSPN/16998?type=PGN. Signal-level enrichment via PR welcome  see CONTRIBUTING.md.";
CM_ SG_ 2147548894 Engine_Air_Start_Pressure_RawPay "Generic 8-byte raw payload. Detail page: https://www.isobus.net/isobus/pGNAndSPN/17001?type=PGN. Signal-level enrichment via PR welcome  see CONTRIBUTING.md.";
CM_ SG_ 2147548896 Vehicle_Distance_RawPayload "Generic 8-byte raw payload. Detail page: https://www.isobus.net/isobus/pGNAndSPN/17012?type=PGN. Signal-level enrichment via PR welcome  see CONTRIBUTING.md.";
CM_ SG_ 2147548897 Retarder_Configuration_RawPayloa "Generic 8-byte raw payload. Detail page: https://www.isobus.net/isobus/pGNAndSPN/17026?type=PGN. Signal-level enrichment via PR welcome  see CONTRIBUTING.md.";
CM_ SG_ 2147548898 Transmission_Configuration_RawPa "Generic 8-byte raw payload. Detail page: https://www.isobus.net/isobus/pGNAndSPN/17029?type=PGN. Signal-level enrichment via PR welcome  see CONTRIBUTING.md.";
CM_ SG_ 2147548900 Shutdown_RawPayload "Generic 8-byte raw payload. Detail page: https://www.isobus.net/isobus/pGNAndSPN/17081?type=PGN. Signal-level enrichment via PR welcome  see CONTRIBUTING.md.";
CM_ SG_ 2147548903 Vehicle_Hours_RawPayload "Generic 8-byte raw payload. Detail page: https://www.isobus.net/isobus/pGNAndSPN/17093?type=PGN. Signal-level enrichment via PR welcome  see CONTRIBUTING.md.";
CM_ SG_ 2147548904 Vehicle_Direction_Speed_RawPaylo "Generic 8-byte raw payload. Detail page: https://www.isobus.net/isobus/pGNAndSPN/17097?type=PGN. Signal-level enrichment via PR welcome  see CONTRIBUTING.md.";
CM_ SG_ 2147548905 Fuel_Consumption_Liquid_1_RawPay "Generic 8-byte raw payload. Detail page: https://www.isobus.net/isobus/pGNAndSPN/17099?type=PGN. Signal-level enrichment via PR welcome  see CONTRIBUTING.md.";
CM_ SG_ 2147548906 Vehicle_Weight_RawPayload "Generic 8-byte raw payload. Detail page: https://www.isobus.net/isobus/pGNAndSPN/17103?type=PGN. Signal-level enrichment via PR welcome  see CONTRIBUTING.md.";
CM_ SG_ 2147548909 Cruise_Control_Vehicle_Speed_Set "Generic 8-byte raw payload. Detail page: https://www.isobus.net/isobus/pGNAndSPN/17118?type=PGN. Signal-level enrichment via PR welcome  see CONTRIBUTING.md.";
CM_ SG_ 2147548912 Power_Takeoff_Information_1_RawP "Generic 8-byte raw payload. Detail page: https://www.isobus.net/isobus/pGNAndSPN/17145?type=PGN. Signal-level enrichment via PR welcome  see CONTRIBUTING.md.";
CM_ SG_ 2147548915 Vehicle_Position_1_RawPayload "Generic 8-byte raw payload. Detail page: https://www.isobus.net/isobus/pGNAndSPN/17172?type=PGN. Signal-level enrichment via PR welcome  see CONTRIBUTING.md.";
CM_ SG_ 2147548916 Tire_Condition_Message_1_RawPayl "Generic 8-byte raw payload. Detail page: https://www.isobus.net/isobus/pGNAndSPN/17181?type=PGN. Signal-level enrichment via PR welcome  see CONTRIBUTING.md.";
CM_ SG_ 2147548917 Ambient_Conditions_RawPayload "Generic 8-byte raw payload. Detail page: https://www.isobus.net/isobus/pGNAndSPN/17186?type=PGN. Signal-level enrichment via PR welcome  see CONTRIBUTING.md.";
CM_ SG_ 2147548921 Axle_Information_RawPayload "Generic 8-byte raw payload. Detail page: https://www.isobus.net/isobus/pGNAndSPN/17212?type=PGN. Signal-level enrichment via PR welcome  see CONTRIBUTING.md.";
CM_ SG_ 2147548922 Brakes_1_RawPayload "Generic 8-byte raw payload. Detail page: https://www.isobus.net/isobus/pGNAndSPN/17219?type=PGN. Signal-level enrichment via PR welcome  see CONTRIBUTING.md.";
CM_ SG_ 2147548923 Retarder_fluids_RawPayload "Generic 8-byte raw payload. Detail page: https://www.isobus.net/isobus/pGNAndSPN/17223?type=PGN. Signal-level enrichment via PR welcome  see CONTRIBUTING.md.";
CM_ SG_ 2147548924 Dash_Display_1_RawPayload "Generic 8-byte raw payload. Detail page: https://www.isobus.net/isobus/pGNAndSPN/17230?type=PGN. Signal-level enrichment via PR welcome  see CONTRIBUTING.md.";
CM_ SG_ 2147548925 Alternate_Fuel_1_RawPayload "Generic 8-byte raw payload. Detail page: https://www.isobus.net/isobus/pGNAndSPN/17235?type=PGN. Signal-level enrichment via PR welcome  see CONTRIBUTING.md.";
CM_ SG_ 2147548926 Auxiliary_Water_Pump_Pressure_Ra "Generic 8-byte raw payload. Detail page: https://www.isobus.net/isobus/pGNAndSPN/17236?type=PGN. Signal-level enrichment via PR welcome  see CONTRIBUTING.md.";
CM_ SG_ 2147548927 Operator_indicators_RawPayload "Generic 8-byte raw payload. Detail page: https://www.isobus.net/isobus/pGNAndSPN/17252?type=PGN. Signal-level enrichment via PR welcome  see CONTRIBUTING.md.";
CM_ SG_ 2147609856 NMEA_Request_Command_Acknowledge "Generic 8-byte raw payload. Detail page: https://www.isobus.net/isobus/pGNAndSPN/17509?type=PGN. Signal-level enrichment via PR welcome  see CONTRIBUTING.md.";
CM_ SG_ 2147610112 PGN_List_Transmit_Receive_PGN_s_ "Generic 8-byte raw payload. Detail page: https://www.isobus.net/isobus/pGNAndSPN/17510?type=PGN. Signal-level enrichment via PR welcome  see CONTRIBUTING.md.";
CM_ SG_ 2147610631 Alert_RawPayload "Generic 8-byte raw payload. Detail page: https://www.isobus.net/isobus/pGNAndSPN/17512?type=PGN. Signal-level enrichment via PR welcome  see CONTRIBUTING.md.";
CM_ SG_ 2147610632 Alert_Response_RawPayload "Generic 8-byte raw payload. Detail page: https://www.isobus.net/isobus/pGNAndSPN/17513?type=PGN. Signal-level enrichment via PR welcome  see CONTRIBUTING.md.";
CM_ SG_ 2147610633 Alert_Text_RawPayload "Generic 8-byte raw payload. Detail page: https://www.isobus.net/isobus/pGNAndSPN/17514?type=PGN. Signal-level enrichment via PR welcome  see CONTRIBUTING.md.";
CM_ SG_ 2147610634 Alert_Configuration_RawPayload "Generic 8-byte raw payload. Detail page: https://www.isobus.net/isobus/pGNAndSPN/17515?type=PGN. Signal-level enrichment via PR welcome  see CONTRIBUTING.md.";
CM_ SG_ 2147610635 Alert_Threshold_RawPayload "Generic 8-byte raw payload. Detail page: https://www.isobus.net/isobus/pGNAndSPN/17516?type=PGN. Signal-level enrichment via PR welcome  see CONTRIBUTING.md.";
CM_ SG_ 2147610636 Alert_Value_RawPayload "Generic 8-byte raw payload. Detail page: https://www.isobus.net/isobus/pGNAndSPN/17517?type=PGN. Signal-level enrichment via PR welcome  see CONTRIBUTING.md.";
CM_ SG_ 2147610640 System_Time_RawPayload "Generic 8-byte raw payload. Detail page: https://www.isobus.net/isobus/pGNAndSPN/17518?type=PGN. Signal-level enrichment via PR welcome  see CONTRIBUTING.md.";
CM_ SG_ 2147610641 Heartbeat_RawPayload "Generic 8-byte raw payload. Detail page: https://www.isobus.net/isobus/pGNAndSPN/17519?type=PGN. Signal-level enrichment via PR welcome  see CONTRIBUTING.md.";
CM_ SG_ 2147610644 Product_Information_RawPayload "Generic 8-byte raw payload. Detail page: https://www.isobus.net/isobus/pGNAndSPN/17520?type=PGN. Signal-level enrichment via PR welcome  see CONTRIBUTING.md.";
CM_ SG_ 2147610646 Configuration_Information_RawPay "Generic 8-byte raw payload. Detail page: https://www.isobus.net/isobus/pGNAndSPN/17521?type=PGN. Signal-level enrichment via PR welcome  see CONTRIBUTING.md.";
CM_ SG_ 2147610649 Cyclic_Alert_List_IEC_61924_2_Ra "Generic 8-byte raw payload. Detail page: https://www.isobus.net/isobus/pGNAndSPN/17522?type=PGN. Signal-level enrichment via PR welcome  see CONTRIBUTING.md.";
CM_ SG_ 2147610650 Responsibility_Transfer_Function "Generic 8-byte raw payload. Detail page: https://www.isobus.net/isobus/pGNAndSPN/17523?type=PGN. Signal-level enrichment via PR welcome  see CONTRIBUTING.md.";
CM_ SG_ 2147610881 Man_Overboard_Notification_MOB_R "Generic 8-byte raw payload. Detail page: https://www.isobus.net/isobus/pGNAndSPN/17524?type=PGN. Signal-level enrichment via PR welcome  see CONTRIBUTING.md.";
CM_ SG_ 2147610885 Heading_Track_Control_RawPayload "Generic 8-byte raw payload. Detail page: https://www.isobus.net/isobus/pGNAndSPN/17525?type=PGN. Signal-level enrichment via PR welcome  see CONTRIBUTING.md.";
CM_ SG_ 2147610893 Rudder_RawPayload "Generic 8-byte raw payload. Detail page: https://www.isobus.net/isobus/pGNAndSPN/17526?type=PGN. Signal-level enrichment via PR welcome  see CONTRIBUTING.md.";
CM_ SG_ 2147610900 Heave_RawPayload "Generic 8-byte raw payload. Detail page: https://www.isobus.net/isobus/pGNAndSPN/17529?type=PGN. Signal-level enrichment via PR welcome  see CONTRIBUTING.md.";
CM_ SG_ 2147610905 Attitude_RawPayload "Generic 8-byte raw payload. Detail page: https://www.isobus.net/isobus/pGNAndSPN/17530?type=PGN. Signal-level enrichment via PR welcome  see CONTRIBUTING.md.";
CM_ SG_ 2147610906 Magnetic_Variation_RawPayload "Generic 8-byte raw payload. Detail page: https://www.isobus.net/isobus/pGNAndSPN/17531?type=PGN. Signal-level enrichment via PR welcome  see CONTRIBUTING.md.";
CM_ SG_ 2147611136 Engine_Parameters_Rapid_Update_R "Generic 8-byte raw payload. Detail page: https://www.isobus.net/isobus/pGNAndSPN/17532?type=PGN. Signal-level enrichment via PR welcome  see CONTRIBUTING.md.";
CM_ SG_ 2147611137 Engine_Parameters_Dynamic_RawPay "Generic 8-byte raw payload. Detail page: https://www.isobus.net/isobus/pGNAndSPN/17533?type=PGN. Signal-level enrichment via PR welcome  see CONTRIBUTING.md.";
CM_ SG_ 2147611138 Electric_Drive_Status_Dynamic_Ra "Generic 8-byte raw payload. Detail page: https://www.isobus.net/isobus/pGNAndSPN/17534?type=PGN. Signal-level enrichment via PR welcome  see CONTRIBUTING.md.";
CM_ SG_ 2147611139 Electric_Energy_Storage_Status_D "Generic 8-byte raw payload. Detail page: https://www.isobus.net/isobus/pGNAndSPN/17535?type=PGN. Signal-level enrichment via PR welcome  see CONTRIBUTING.md.";
CM_ SG_ 2147611141 Transmission_Parameters_Dynamic_ "Generic 8-byte raw payload. Detail page: https://www.isobus.net/isobus/pGNAndSPN/17536?type=PGN. Signal-level enrichment via PR welcome  see CONTRIBUTING.md.";
CM_ SG_ 2147611142 Electric_Drive_Information_RawPa "Generic 8-byte raw payload. Detail page: https://www.isobus.net/isobus/pGNAndSPN/17537?type=PGN. Signal-level enrichment via PR welcome  see CONTRIBUTING.md.";
CM_ SG_ 2147611143 Electric_Energy_Storage_Informat "Generic 8-byte raw payload. Detail page: https://www.isobus.net/isobus/pGNAndSPN/17538?type=PGN. Signal-level enrichment via PR welcome  see CONTRIBUTING.md.";
CM_ SG_ 2147611144 Trip_Parameters_Vessel_RawPayloa "Generic 8-byte raw payload. Detail page: https://www.isobus.net/isobus/pGNAndSPN/17539?type=PGN. Signal-level enrichment via PR welcome  see CONTRIBUTING.md.";
CM_ SG_ 2147611145 Trip_Parameters_Small_Craft_RawP "Generic 8-byte raw payload. Detail page: https://www.isobus.net/isobus/pGNAndSPN/17540?type=PGN. Signal-level enrichment via PR welcome  see CONTRIBUTING.md.";
CM_ SG_ 2147611146 Engine_Parameters_Static_RawPayl "Generic 8-byte raw payload. Detail page: https://www.isobus.net/isobus/pGNAndSPN/17541?type=PGN. Signal-level enrichment via PR welcome  see CONTRIBUTING.md.";
CM_ SG_ 2147611148 Load_Controller_Connection_State "Generic 8-byte raw payload. Detail page: https://www.isobus.net/isobus/pGNAndSPN/17542?type=PGN. Signal-level enrichment via PR welcome  see CONTRIBUTING.md.";
CM_ SG_ 2147611149 Binary_Switch_Bank_Status_RawPay "Generic 8-byte raw payload. Detail page: https://www.isobus.net/isobus/pGNAndSPN/17543?type=PGN. Signal-level enrichment via PR welcome  see CONTRIBUTING.md.";
CM_ SG_ 2147611150 Switch_Bank_Control_RawPayload "Generic 8-byte raw payload. Detail page: https://www.isobus.net/isobus/pGNAndSPN/17544?type=PGN. Signal-level enrichment via PR welcome  see CONTRIBUTING.md.";
CM_ SG_ 2147611151 AC_Input_Status_RawPayload "Generic 8-byte raw payload. Detail page: https://www.isobus.net/isobus/pGNAndSPN/17545?type=PGN. Signal-level enrichment via PR welcome  see CONTRIBUTING.md.";
CM_ SG_ 2147611152 AC_Output_Status_RawPayload "Generic 8-byte raw payload. Detail page: https://www.isobus.net/isobus/pGNAndSPN/17546?type=PGN. Signal-level enrichment via PR welcome  see CONTRIBUTING.md.";
CM_ SG_ 2147611153 Fluid_Level_RawPayload "Generic 8-byte raw payload. Detail page: https://www.isobus.net/isobus/pGNAndSPN/17547?type=PGN. Signal-level enrichment via PR welcome  see CONTRIBUTING.md.";
CM_ SG_ 2147611154 DC_Detailed_Status_RawPayload "Generic 8-byte raw payload. Detail page: https://www.isobus.net/isobus/pGNAndSPN/17548?type=PGN. Signal-level enrichment via PR welcome  see CONTRIBUTING.md.";
CM_ SG_ 2147611155 Charger_Status_RawPayload "Generic 8-byte raw payload. Detail page: https://www.isobus.net/isobus/pGNAndSPN/17549?type=PGN. Signal-level enrichment via PR welcome  see CONTRIBUTING.md.";
CM_ SG_ 2147611156 Battery_Status_RawPayload "Generic 8-byte raw payload. Detail page: https://www.isobus.net/isobus/pGNAndSPN/17550?type=PGN. Signal-level enrichment via PR welcome  see CONTRIBUTING.md.";
CM_ SG_ 2147611157 Inverter_Status_RawPayload "Generic 8-byte raw payload. Detail page: https://www.isobus.net/isobus/pGNAndSPN/17551?type=PGN. Signal-level enrichment via PR welcome  see CONTRIBUTING.md.";
CM_ SG_ 2147611158 Charger_Configuration_Status_Raw "Generic 8-byte raw payload. Detail page: https://www.isobus.net/isobus/pGNAndSPN/17552?type=PGN. Signal-level enrichment via PR welcome  see CONTRIBUTING.md.";
CM_ SG_ 2147611159 Inverter_Configuration_Status_Ra "Generic 8-byte raw payload. Detail page: https://www.isobus.net/isobus/pGNAndSPN/17553?type=PGN. Signal-level enrichment via PR welcome  see CONTRIBUTING.md.";
CM_ SG_ 2147611160 AGS_Configuration_Status_RawPayl "Generic 8-byte raw payload. Detail page: https://www.isobus.net/isobus/pGNAndSPN/17554?type=PGN. Signal-level enrichment via PR welcome  see CONTRIBUTING.md.";
CM_ SG_ 2147611161 Battery_Configuration_Status_Raw "Generic 8-byte raw payload. Detail page: https://www.isobus.net/isobus/pGNAndSPN/17555?type=PGN. Signal-level enrichment via PR welcome  see CONTRIBUTING.md.";
CM_ SG_ 2147611162 AGS_Status_RawPayload "Generic 8-byte raw payload. Detail page: https://www.isobus.net/isobus/pGNAndSPN/17556?type=PGN. Signal-level enrichment via PR welcome  see CONTRIBUTING.md.";
CM_ SG_ 2147611392 AC_Power_Current_Phase_A_RawPayl "Generic 8-byte raw payload. Detail page: https://www.isobus.net/isobus/pGNAndSPN/17557?type=PGN. Signal-level enrichment via PR welcome  see CONTRIBUTING.md.";
CM_ SG_ 2147611393 AC_Power_Current_Phase_B_RawPayl "Generic 8-byte raw payload. Detail page: https://www.isobus.net/isobus/pGNAndSPN/17558?type=PGN. Signal-level enrichment via PR welcome  see CONTRIBUTING.md.";
CM_ SG_ 2147611394 AC_Power_Current_Phase_C_RawPayl "Generic 8-byte raw payload. Detail page: https://www.isobus.net/isobus/pGNAndSPN/17559?type=PGN. Signal-level enrichment via PR welcome  see CONTRIBUTING.md.";
CM_ SG_ 2147611395 AC_Voltage_Frequency_Phase_A_Raw "Generic 8-byte raw payload. Detail page: https://www.isobus.net/isobus/pGNAndSPN/17560?type=PGN. Signal-level enrichment via PR welcome  see CONTRIBUTING.md.";
CM_ SG_ 2147611396 AC_Voltage_Frequency_Phase_B_Raw "Generic 8-byte raw payload. Detail page: https://www.isobus.net/isobus/pGNAndSPN/17561?type=PGN. Signal-level enrichment via PR welcome  see CONTRIBUTING.md.";
CM_ SG_ 2147611397 AC_Voltage_Frequency_Phase_C_Raw "Generic 8-byte raw payload. Detail page: https://www.isobus.net/isobus/pGNAndSPN/17562?type=PGN. Signal-level enrichment via PR welcome  see CONTRIBUTING.md.";
CM_ SG_ 2147611398 Converter_Inverter_Charger_Statu "Generic 8-byte raw payload. Detail page: https://www.isobus.net/isobus/pGNAndSPN/17563?type=PGN. Signal-level enrichment via PR welcome  see CONTRIBUTING.md.";
CM_ SG_ 2147611399 DC_Voltage_Current_RawPayload "Generic 8-byte raw payload. Detail page: https://www.isobus.net/isobus/pGNAndSPN/17564?type=PGN. Signal-level enrichment via PR welcome  see CONTRIBUTING.md.";
CM_ SG_ 2147611648 Nautical_Leeway_Angle_RawPayload "Generic 8-byte raw payload. Detail page: https://www.isobus.net/isobus/pGNAndSPN/17565?type=PGN. Signal-level enrichment via PR welcome  see CONTRIBUTING.md.";
CM_ SG_ 2147611649 Vessel_Acceleration_RawPayload "Generic 8-byte raw payload. Detail page: https://www.isobus.net/isobus/pGNAndSPN/17566?type=PGN. Signal-level enrichment via PR welcome  see CONTRIBUTING.md.";
CM_ SG_ 2147611650 Electric_Drive_Status_Rapid_Upda "Generic 8-byte raw payload. Detail page: https://www.isobus.net/isobus/pGNAndSPN/17567?type=PGN. Signal-level enrichment via PR welcome  see CONTRIBUTING.md.";
CM_ SG_ 2147611651 Electric_Energy_Storage_Status_R "Generic 8-byte raw payload. Detail page: https://www.isobus.net/isobus/pGNAndSPN/17568?type=PGN. Signal-level enrichment via PR welcome  see CONTRIBUTING.md.";
CM_ SG_ 2147611654 Thruster_Control_Status_RawPaylo "Generic 8-byte raw payload. Detail page: https://www.isobus.net/isobus/pGNAndSPN/17569?type=PGN. Signal-level enrichment via PR welcome  see CONTRIBUTING.md.";
CM_ SG_ 2147611655 Thruster_Information_RawPayload "Generic 8-byte raw payload. Detail page: https://www.isobus.net/isobus/pGNAndSPN/17570?type=PGN. Signal-level enrichment via PR welcome  see CONTRIBUTING.md.";
CM_ SG_ 2147611656 Thruster_Motor_Status_RawPayload "Generic 8-byte raw payload. Detail page: https://www.isobus.net/isobus/pGNAndSPN/17571?type=PGN. Signal-level enrichment via PR welcome  see CONTRIBUTING.md.";
CM_ SG_ 2147611907 Speed_RawPayload "Generic 8-byte raw payload. Detail page: https://www.isobus.net/isobus/pGNAndSPN/17572?type=PGN. Signal-level enrichment via PR welcome  see CONTRIBUTING.md.";
CM_ SG_ 2147611915 Water_Depth_RawPayload "Generic 8-byte raw payload. Detail page: https://www.isobus.net/isobus/pGNAndSPN/17573?type=PGN. Signal-level enrichment via PR welcome  see CONTRIBUTING.md.";
CM_ SG_ 2147611923 Distance_Log_RawPayload "Generic 8-byte raw payload. Detail page: https://www.isobus.net/isobus/pGNAndSPN/17574?type=PGN. Signal-level enrichment via PR welcome  see CONTRIBUTING.md.";
CM_ SG_ 2147612168 Tracked_Target_Data_RawPayload "Generic 8-byte raw payload. Detail page: https://www.isobus.net/isobus/pGNAndSPN/17575?type=PGN. Signal-level enrichment via PR welcome  see CONTRIBUTING.md.";
CM_ SG_ 2147612186 Elevator_Car_Status_RawPayload "Generic 8-byte raw payload. Detail page: https://www.isobus.net/isobus/pGNAndSPN/17576?type=PGN. Signal-level enrichment via PR welcome  see CONTRIBUTING.md.";
CM_ SG_ 2147612416 Elevator_Motor_Control_RawPayloa "Generic 8-byte raw payload. Detail page: https://www.isobus.net/isobus/pGNAndSPN/17577?type=PGN. Signal-level enrichment via PR welcome  see CONTRIBUTING.md.";
CM_ SG_ 2147612417 Elevator_Deck_Push_Button_RawPay "Generic 8-byte raw payload. Detail page: https://www.isobus.net/isobus/pGNAndSPN/17578?type=PGN. Signal-level enrichment via PR welcome  see CONTRIBUTING.md.";
CM_ SG_ 2147612424 Windlass_Control_Status_RawPaylo "Generic 8-byte raw payload. Detail page: https://www.isobus.net/isobus/pGNAndSPN/17579?type=PGN. Signal-level enrichment via PR welcome  see CONTRIBUTING.md.";
CM_ SG_ 2147612425 Anchor_Windlass_Operating_Status "Generic 8-byte raw payload. Detail page: https://www.isobus.net/isobus/pGNAndSPN/17580?type=PGN. Signal-level enrichment via PR welcome  see CONTRIBUTING.md.";
CM_ SG_ 2147612426 Anchor_Windlass_Monitoring_Statu "Generic 8-byte raw payload. Detail page: https://www.isobus.net/isobus/pGNAndSPN/17581?type=PGN. Signal-level enrichment via PR welcome  see CONTRIBUTING.md.";
CM_ SG_ 2147612428 Linear_Actuator_Control_Status_R "Generic 8-byte raw payload. Detail page: https://www.isobus.net/isobus/pGNAndSPN/17582?type=PGN. Signal-level enrichment via PR welcome  see CONTRIBUTING.md.";
CM_ SG_ 2147612676 Altitude_Delta_High_Precision_Ra "Generic 8-byte raw payload. Detail page: https://www.isobus.net/isobus/pGNAndSPN/17586?type=PGN. Signal-level enrichment via PR welcome  see CONTRIBUTING.md.";
CM_ SG_ 2147612681 Time_Date_RawPayload "Generic 8-byte raw payload. Detail page: https://www.isobus.net/isobus/pGNAndSPN/17588?type=PGN. Signal-level enrichment via PR welcome  see CONTRIBUTING.md.";
CM_ SG_ 2147612686 AIS_Class_A_Position_Report_RawP "Generic 8-byte raw payload. Detail page: https://www.isobus.net/isobus/pGNAndSPN/17589?type=PGN. Signal-level enrichment via PR welcome  see CONTRIBUTING.md.";
CM_ SG_ 2147612687 AIS_Class_B_Position_Report_RawP "Generic 8-byte raw payload. Detail page: https://www.isobus.net/isobus/pGNAndSPN/17590?type=PGN. Signal-level enrichment via PR welcome  see CONTRIBUTING.md.";
CM_ SG_ 2147612688 AIS_Class_B_Extended_Position_Re "Generic 8-byte raw payload. Detail page: https://www.isobus.net/isobus/pGNAndSPN/17591?type=PGN. Signal-level enrichment via PR welcome  see CONTRIBUTING.md.";
CM_ SG_ 2147612689 AIS_Aids_to_Navigation_AtoN_Repo "Generic 8-byte raw payload. Detail page: https://www.isobus.net/isobus/pGNAndSPN/17592?type=PGN. Signal-level enrichment via PR welcome  see CONTRIBUTING.md.";
CM_ SG_ 2147612693 User_Datum_Settings_RawPayload "Generic 8-byte raw payload. Detail page: https://www.isobus.net/isobus/pGNAndSPN/17594?type=PGN. Signal-level enrichment via PR welcome  see CONTRIBUTING.md.";
CM_ SG_ 2147612931 Cross_Track_Error_RawPayload "Generic 8-byte raw payload. Detail page: https://www.isobus.net/isobus/pGNAndSPN/17595?type=PGN. Signal-level enrichment via PR welcome  see CONTRIBUTING.md.";
CM_ SG_ 2147612932 Navigation_Data_RawPayload "Generic 8-byte raw payload. Detail page: https://www.isobus.net/isobus/pGNAndSPN/17596?type=PGN. Signal-level enrichment via PR welcome  see CONTRIBUTING.md.";
CM_ SG_ 2147612933 Navigation_Route_WP_information_ "Generic 8-byte raw payload. Detail page: https://www.isobus.net/isobus/pGNAndSPN/17597?type=PGN. Signal-level enrichment via PR welcome  see CONTRIBUTING.md.";
CM_ SG_ 2147612939 Set_Drift_Rapid_Update_RawPayloa "Generic 8-byte raw payload. Detail page: https://www.isobus.net/isobus/pGNAndSPN/17598?type=PGN. Signal-level enrichment via PR welcome  see CONTRIBUTING.md.";
CM_ SG_ 2147612949 Time_to_from_Mark_RawPayload "Generic 8-byte raw payload. Detail page: https://www.isobus.net/isobus/pGNAndSPN/17599?type=PGN. Signal-level enrichment via PR welcome  see CONTRIBUTING.md.";
CM_ SG_ 2147612950 Bearing_and_Distance_between_two "Generic 8-byte raw payload. Detail page: https://www.isobus.net/isobus/pGNAndSPN/17600?type=PGN. Signal-level enrichment via PR welcome  see CONTRIBUTING.md.";
CM_ SG_ 2147613186 GNSS_Control_Status_RawPayload "Generic 8-byte raw payload. Detail page: https://www.isobus.net/isobus/pGNAndSPN/17601?type=PGN. Signal-level enrichment via PR welcome  see CONTRIBUTING.md.";
CM_ SG_ 2147613187 GNSS_DOPs_RawPayload "Generic 8-byte raw payload. Detail page: https://www.isobus.net/isobus/pGNAndSPN/17602?type=PGN. Signal-level enrichment via PR welcome  see CONTRIBUTING.md.";
CM_ SG_ 2147613188 GNSS_Sats_in_View_RawPayload "Generic 8-byte raw payload. Detail page: https://www.isobus.net/isobus/pGNAndSPN/17603?type=PGN. Signal-level enrichment via PR welcome  see CONTRIBUTING.md.";
CM_ SG_ 2147613189 GPS_Almanac_Data_RawPayload "Generic 8-byte raw payload. Detail page: https://www.isobus.net/isobus/pGNAndSPN/17604?type=PGN. Signal-level enrichment via PR welcome  see CONTRIBUTING.md.";
CM_ SG_ 2147613190 GNSS_Pseudorange_Noise_Statistic "Generic 8-byte raw payload. Detail page: https://www.isobus.net/isobus/pGNAndSPN/17605?type=PGN. Signal-level enrichment via PR welcome  see CONTRIBUTING.md.";
CM_ SG_ 2147613193 GNSS_RAIM_Output_RawPayload "Generic 8-byte raw payload. Detail page: https://www.isobus.net/isobus/pGNAndSPN/17606?type=PGN. Signal-level enrichment via PR welcome  see CONTRIBUTING.md.";
CM_ SG_ 2147613194 GNSS_RAIM_Settings_RawPayload "Generic 8-byte raw payload. Detail page: https://www.isobus.net/isobus/pGNAndSPN/17607?type=PGN. Signal-level enrichment via PR welcome  see CONTRIBUTING.md.";
CM_ SG_ 2147613195 GNSS_Pseudorange_Error_Statistic "Generic 8-byte raw payload. Detail page: https://www.isobus.net/isobus/pGNAndSPN/17608?type=PGN. Signal-level enrichment via PR welcome  see CONTRIBUTING.md.";
CM_ SG_ 2147613197 DGNSS_Corrections_RawPayload "Generic 8-byte raw payload. Detail page: https://www.isobus.net/isobus/pGNAndSPN/17609?type=PGN. Signal-level enrichment via PR welcome  see CONTRIBUTING.md.";
CM_ SG_ 2147613198 GNSS_Differential_Correction_Rec "Generic 8-byte raw payload. Detail page: https://www.isobus.net/isobus/pGNAndSPN/17610?type=PGN. Signal-level enrichment via PR welcome  see CONTRIBUTING.md.";
CM_ SG_ 2147613199 GNSS_Differential_Correction_Rec "Generic 8-byte raw payload. Detail page: https://www.isobus.net/isobus/pGNAndSPN/17611?type=PGN. Signal-level enrichment via PR welcome  see CONTRIBUTING.md.";
CM_ SG_ 2147613204 GLONASS_Almanac_Data_RawPayload "Generic 8-byte raw payload. Detail page: https://www.isobus.net/isobus/pGNAndSPN/17612?type=PGN. Signal-level enrichment via PR welcome  see CONTRIBUTING.md.";
CM_ SG_ 2147613440 AIS_DGNSS_Broadcast_Binary_Messa "Generic 8-byte raw payload. Detail page: https://www.isobus.net/isobus/pGNAndSPN/17613?type=PGN. Signal-level enrichment via PR welcome  see CONTRIBUTING.md.";
CM_ SG_ 2147613441 AIS_UTC_and_Date_Report_RawPaylo "Generic 8-byte raw payload. Detail page: https://www.isobus.net/isobus/pGNAndSPN/17614?type=PGN. Signal-level enrichment via PR welcome  see CONTRIBUTING.md.";
CM_ SG_ 2147613442 AIS_Class_A_Static_and_Voyage_Re "Generic 8-byte raw payload. Detail page: https://www.isobus.net/isobus/pGNAndSPN/17615?type=PGN. Signal-level enrichment via PR welcome  see CONTRIBUTING.md.";
CM_ SG_ 2147613443 AIS_Addressed_Binary_Message_Raw "Generic 8-byte raw payload. Detail page: https://www.isobus.net/isobus/pGNAndSPN/17616?type=PGN. Signal-level enrichment via PR welcome  see CONTRIBUTING.md.";
CM_ SG_ 2147613444 AIS_Acknowledge_RawPayload "Generic 8-byte raw payload. Detail page: https://www.isobus.net/isobus/pGNAndSPN/17617?type=PGN. Signal-level enrichment via PR welcome  see CONTRIBUTING.md.";
CM_ SG_ 2147613445 AIS_Binary_Broadcast_Message_Raw "Generic 8-byte raw payload. Detail page: https://www.isobus.net/isobus/pGNAndSPN/17618?type=PGN. Signal-level enrichment via PR welcome  see CONTRIBUTING.md.";
CM_ SG_ 2147613446 AIS_SAR_Aircraft_Position_Report "Generic 8-byte raw payload. Detail page: https://www.isobus.net/isobus/pGNAndSPN/17619?type=PGN. Signal-level enrichment via PR welcome  see CONTRIBUTING.md.";
CM_ SG_ 2147613447 Radio_Frequency_Mode_Power_RawPa "Generic 8-byte raw payload. Detail page: https://www.isobus.net/isobus/pGNAndSPN/17620?type=PGN. Signal-level enrichment via PR welcome  see CONTRIBUTING.md.";
CM_ SG_ 2147613448 AIS_UTC_Date_Inquiry_RawPayload "Generic 8-byte raw payload. Detail page: https://www.isobus.net/isobus/pGNAndSPN/17621?type=PGN. Signal-level enrichment via PR welcome  see CONTRIBUTING.md.";
CM_ SG_ 2147613449 AIS_Addressed_Safety_Related_Mes "Generic 8-byte raw payload. Detail page: https://www.isobus.net/isobus/pGNAndSPN/17622?type=PGN. Signal-level enrichment via PR welcome  see CONTRIBUTING.md.";
CM_ SG_ 2147613450 AIS_Safety_Related_Broadcast_Mes "Generic 8-byte raw payload. Detail page: https://www.isobus.net/isobus/pGNAndSPN/17623?type=PGN. Signal-level enrichment via PR welcome  see CONTRIBUTING.md.";
CM_ SG_ 2147613451 AIS_Interrogation_RawPayload "Generic 8-byte raw payload. Detail page: https://www.isobus.net/isobus/pGNAndSPN/17624?type=PGN. Signal-level enrichment via PR welcome  see CONTRIBUTING.md.";
CM_ SG_ 2147613452 AIS_Assignment_Mode_Command_RawP "Generic 8-byte raw payload. Detail page: https://www.isobus.net/isobus/pGNAndSPN/17625?type=PGN. Signal-level enrichment via PR welcome  see CONTRIBUTING.md.";
CM_ SG_ 2147613453 AIS_Data_Link_Management_Message "Generic 8-byte raw payload. Detail page: https://www.isobus.net/isobus/pGNAndSPN/17626?type=PGN. Signal-level enrichment via PR welcome  see CONTRIBUTING.md.";
CM_ SG_ 2147613454 AIS_Channel_Management_RawPayloa "Generic 8-byte raw payload. Detail page: https://www.isobus.net/isobus/pGNAndSPN/17627?type=PGN. Signal-level enrichment via PR welcome  see CONTRIBUTING.md.";
CM_ SG_ 2147613455 AIS_Class_B_Group_Assignment_Raw "Generic 8-byte raw payload. Detail page: https://www.isobus.net/isobus/pGNAndSPN/17628?type=PGN. Signal-level enrichment via PR welcome  see CONTRIBUTING.md.";
CM_ SG_ 2147613456 DSC_Call_Information_RawPayload "Generic 8-byte raw payload. Detail page: https://www.isobus.net/isobus/pGNAndSPN/17629?type=PGN. Signal-level enrichment via PR welcome  see CONTRIBUTING.md.";
CM_ SG_ 2147613457 AIS_Class_B_CS_Static_Data_Repor "Generic 8-byte raw payload. Detail page: https://www.isobus.net/isobus/pGNAndSPN/17630?type=PGN. Signal-level enrichment via PR welcome  see CONTRIBUTING.md.";
CM_ SG_ 2147613458 AIS_Class_B_CS_Static_Data_Repor "Generic 8-byte raw payload. Detail page: https://www.isobus.net/isobus/pGNAndSPN/17631?type=PGN. Signal-level enrichment via PR welcome  see CONTRIBUTING.md.";
CM_ SG_ 2147613459 AIS_Single_Slot_Binary_Message_D "Generic 8-byte raw payload. Detail page: https://www.isobus.net/isobus/pGNAndSPN/17632?type=PGN. Signal-level enrichment via PR welcome  see CONTRIBUTING.md.";
CM_ SG_ 2147613460 AIS_Multi_Slot_Binary_Message_DE "Generic 8-byte raw payload. Detail page: https://www.isobus.net/isobus/pGNAndSPN/17633?type=PGN. Signal-level enrichment via PR welcome  see CONTRIBUTING.md.";
CM_ SG_ 2147613461 AIS_Long_Range_Broadcast_Message "Generic 8-byte raw payload. Detail page: https://www.isobus.net/isobus/pGNAndSPN/17634?type=PGN. Signal-level enrichment via PR welcome  see CONTRIBUTING.md.";
CM_ SG_ 2147613462 AIS_Single_Slot_Binary_Message_R "Generic 8-byte raw payload. Detail page: https://www.isobus.net/isobus/pGNAndSPN/17635?type=PGN. Signal-level enrichment via PR welcome  see CONTRIBUTING.md.";
CM_ SG_ 2147613463 AIS_Multi_Slot_Binary_Message_Ra "Generic 8-byte raw payload. Detail page: https://www.isobus.net/isobus/pGNAndSPN/17636?type=PGN. Signal-level enrichment via PR welcome  see CONTRIBUTING.md.";
CM_ SG_ 2147613464 AIS_Acknowledge_RawPayload "Generic 8-byte raw payload. Detail page: https://www.isobus.net/isobus/pGNAndSPN/17637?type=PGN. Signal-level enrichment via PR welcome  see CONTRIBUTING.md.";
CM_ SG_ 2147613700 Loran_C_TD_Data_RawPayload "Generic 8-byte raw payload. Detail page: https://www.isobus.net/isobus/pGNAndSPN/17638?type=PGN. Signal-level enrichment via PR welcome  see CONTRIBUTING.md.";
CM_ SG_ 2147613701 Loran_C_Range_Data_RawPayload "Generic 8-byte raw payload. Detail page: https://www.isobus.net/isobus/pGNAndSPN/17639?type=PGN. Signal-level enrichment via PR welcome  see CONTRIBUTING.md.";
CM_ SG_ 2147613702 Loran_C_Signal_Data_RawPayload "Generic 8-byte raw payload. Detail page: https://www.isobus.net/isobus/pGNAndSPN/17640?type=PGN. Signal-level enrichment via PR welcome  see CONTRIBUTING.md.";
CM_ SG_ 2147613708 Label_RawPayload "Generic 8-byte raw payload. Detail page: https://www.isobus.net/isobus/pGNAndSPN/17641?type=PGN. Signal-level enrichment via PR welcome  see CONTRIBUTING.md.";
CM_ SG_ 2147613709 Channel_Source_Configuration_Raw "Generic 8-byte raw payload. Detail page: https://www.isobus.net/isobus/pGNAndSPN/17642?type=PGN. Signal-level enrichment via PR welcome  see CONTRIBUTING.md.";
CM_ SG_ 2147613712 Route_and_WP_Service_Database_Li "Generic 8-byte raw payload. Detail page: https://www.isobus.net/isobus/pGNAndSPN/17643?type=PGN. Signal-level enrichment via PR welcome  see CONTRIBUTING.md.";
CM_ SG_ 2147613713 Route_and_WP_Service_Route_List_ "Generic 8-byte raw payload. Detail page: https://www.isobus.net/isobus/pGNAndSPN/17644?type=PGN. Signal-level enrichment via PR welcome  see CONTRIBUTING.md.";
CM_ SG_ 2147613714 Route_and_WP_Service_Route_WP_Li "Generic 8-byte raw payload. Detail page: https://www.isobus.net/isobus/pGNAndSPN/17645?type=PGN. Signal-level enrichment via PR welcome  see CONTRIBUTING.md.";
CM_ SG_ 2147613715 Route_and_WP_Service_Route_WP_Na "Generic 8-byte raw payload. Detail page: https://www.isobus.net/isobus/pGNAndSPN/17646?type=PGN. Signal-level enrichment via PR welcome  see CONTRIBUTING.md.";
CM_ SG_ 2147613716 Route_and_WP_Service_Route_WP_Na "Generic 8-byte raw payload. Detail page: https://www.isobus.net/isobus/pGNAndSPN/17647?type=PGN. Signal-level enrichment via PR welcome  see CONTRIBUTING.md.";
CM_ SG_ 2147613717 Route_and_WP_Service_XTE_Limit_N "Generic 8-byte raw payload. Detail page: https://www.isobus.net/isobus/pGNAndSPN/17648?type=PGN. Signal-level enrichment via PR welcome  see CONTRIBUTING.md.";
CM_ SG_ 2147613718 Route_and_WP_Service_WP_Comment_ "Generic 8-byte raw payload. Detail page: https://www.isobus.net/isobus/pGNAndSPN/17649?type=PGN. Signal-level enrichment via PR welcome  see CONTRIBUTING.md.";
CM_ SG_ 2147613719 Route_and_WP_Service_Route_Comme "Generic 8-byte raw payload. Detail page: https://www.isobus.net/isobus/pGNAndSPN/17650?type=PGN. Signal-level enrichment via PR welcome  see CONTRIBUTING.md.";
CM_ SG_ 2147613720 Route_and_WP_Service_Database_Co "Generic 8-byte raw payload. Detail page: https://www.isobus.net/isobus/pGNAndSPN/17651?type=PGN. Signal-level enrichment via PR welcome  see CONTRIBUTING.md.";
CM_ SG_ 2147613721 Route_and_WP_Service_Radius_of_T "Generic 8-byte raw payload. Detail page: https://www.isobus.net/isobus/pGNAndSPN/17652?type=PGN. Signal-level enrichment via PR welcome  see CONTRIBUTING.md.";
CM_ SG_ 2147613722 Route_and_WP_Service_WP_List_WP_ "Generic 8-byte raw payload. Detail page: https://www.isobus.net/isobus/pGNAndSPN/17653?type=PGN. Signal-level enrichment via PR welcome  see CONTRIBUTING.md.";
CM_ SG_ 2147613954 Wind_Data_RawPayload "Generic 8-byte raw payload. Detail page: https://www.isobus.net/isobus/pGNAndSPN/17654?type=PGN. Signal-level enrichment via PR welcome  see CONTRIBUTING.md.";
CM_ SG_ 2147613958 Environmental_Parameters_RawPayl "Generic 8-byte raw payload. Detail page: https://www.isobus.net/isobus/pGNAndSPN/17655?type=PGN. Signal-level enrichment via PR welcome  see CONTRIBUTING.md.";
CM_ SG_ 2147613959 Environmental_Parameters_RawPayl "Generic 8-byte raw payload. Detail page: https://www.isobus.net/isobus/pGNAndSPN/17656?type=PGN. Signal-level enrichment via PR welcome  see CONTRIBUTING.md.";
CM_ SG_ 2147613960 Temperature_RawPayload "Generic 8-byte raw payload. Detail page: https://www.isobus.net/isobus/pGNAndSPN/17657?type=PGN. Signal-level enrichment via PR welcome  see CONTRIBUTING.md.";
CM_ SG_ 2147613961 Humidity_RawPayload "Generic 8-byte raw payload. Detail page: https://www.isobus.net/isobus/pGNAndSPN/17658?type=PGN. Signal-level enrichment via PR welcome  see CONTRIBUTING.md.";
CM_ SG_ 2147613962 Actual_Pressure_RawPayload "Generic 8-byte raw payload. Detail page: https://www.isobus.net/isobus/pGNAndSPN/17659?type=PGN. Signal-level enrichment via PR welcome  see CONTRIBUTING.md.";
CM_ SG_ 2147613963 Set_Pressure_RawPayload "Generic 8-byte raw payload. Detail page: https://www.isobus.net/isobus/pGNAndSPN/17660?type=PGN. Signal-level enrichment via PR welcome  see CONTRIBUTING.md.";
CM_ SG_ 2147613964 Temperature_Extended_Range_RawPa "Generic 8-byte raw payload. Detail page: https://www.isobus.net/isobus/pGNAndSPN/17661?type=PGN. Signal-level enrichment via PR welcome  see CONTRIBUTING.md.";
CM_ SG_ 2147613968 Tide_Station_Data_RawPayload "Generic 8-byte raw payload. Detail page: https://www.isobus.net/isobus/pGNAndSPN/17662?type=PGN. Signal-level enrichment via PR welcome  see CONTRIBUTING.md.";
CM_ SG_ 2147613969 Salinity_Station_Data_RawPayload "Generic 8-byte raw payload. Detail page: https://www.isobus.net/isobus/pGNAndSPN/17663?type=PGN. Signal-level enrichment via PR welcome  see CONTRIBUTING.md.";
CM_ SG_ 2147613970 Current_Station_Data_RawPayload "Generic 8-byte raw payload. Detail page: https://www.isobus.net/isobus/pGNAndSPN/17664?type=PGN. Signal-level enrichment via PR welcome  see CONTRIBUTING.md.";
CM_ SG_ 2147613971 Meteorological_Station_Data_RawP "Generic 8-byte raw payload. Detail page: https://www.isobus.net/isobus/pGNAndSPN/17665?type=PGN. Signal-level enrichment via PR welcome  see CONTRIBUTING.md.";
CM_ SG_ 2147613972 Moored_Buoy_Station_Data_RawPayl "Generic 8-byte raw payload. Detail page: https://www.isobus.net/isobus/pGNAndSPN/17666?type=PGN. Signal-level enrichment via PR welcome  see CONTRIBUTING.md.";
CM_ SG_ 2147613978 Lighting_System_Settings_RawPayl "Generic 8-byte raw payload. Detail page: https://www.isobus.net/isobus/pGNAndSPN/17667?type=PGN. Signal-level enrichment via PR welcome  see CONTRIBUTING.md.";
CM_ SG_ 2147614208 Payload_Mass_RawPayload "Generic 8-byte raw payload. Detail page: https://www.isobus.net/isobus/pGNAndSPN/17668?type=PGN. Signal-level enrichment via PR welcome  see CONTRIBUTING.md.";
CM_ SG_ 2147614209 Lighting_Zone_RawPayload "Generic 8-byte raw payload. Detail page: https://www.isobus.net/isobus/pGNAndSPN/17669?type=PGN. Signal-level enrichment via PR welcome  see CONTRIBUTING.md.";
CM_ SG_ 2147614210 Lighting_Scene_RawPayload "Generic 8-byte raw payload. Detail page: https://www.isobus.net/isobus/pGNAndSPN/17670?type=PGN. Signal-level enrichment via PR welcome  see CONTRIBUTING.md.";
CM_ SG_ 2147614211 Lighting_Device_RawPayload "Generic 8-byte raw payload. Detail page: https://www.isobus.net/isobus/pGNAndSPN/17671?type=PGN. Signal-level enrichment via PR welcome  see CONTRIBUTING.md.";
CM_ SG_ 2147614212 Lighting_Device_Enumeration_RawP "Generic 8-byte raw payload. Detail page: https://www.isobus.net/isobus/pGNAndSPN/17672?type=PGN. Signal-level enrichment via PR welcome  see CONTRIBUTING.md.";
CM_ SG_ 2147614213 Lighting_Color_Sequence_RawPaylo "Generic 8-byte raw payload. Detail page: https://www.isobus.net/isobus/pGNAndSPN/17673?type=PGN. Signal-level enrichment via PR welcome  see CONTRIBUTING.md.";
CM_ SG_ 2147614214 Lighting_Program_RawPayload "Generic 8-byte raw payload. Detail page: https://www.isobus.net/isobus/pGNAndSPN/17674?type=PGN. Signal-level enrichment via PR welcome  see CONTRIBUTING.md.";
CM_ SG_ 2147614215 Watermaker_Input_Setting_and_Sta "Generic 8-byte raw payload. Detail page: https://www.isobus.net/isobus/pGNAndSPN/17675?type=PGN. Signal-level enrichment via PR welcome  see CONTRIBUTING.md.";
CM_ SG_ 2147614216 Entertainment_Diagnostic_Status_ "Generic 8-byte raw payload. Detail page: https://www.isobus.net/isobus/pGNAndSPN/17676?type=PGN. Signal-level enrichment via PR welcome  see CONTRIBUTING.md.";
CM_ SG_ 2147614217 Entertainment_Current_File_and_S "Generic 8-byte raw payload. Detail page: https://www.isobus.net/isobus/pGNAndSPN/17677?type=PGN. Signal-level enrichment via PR welcome  see CONTRIBUTING.md.";
CM_ SG_ 2147614218 Entertainment_Library_Data_File_ "Generic 8-byte raw payload. Detail page: https://www.isobus.net/isobus/pGNAndSPN/17678?type=PGN. Signal-level enrichment via PR welcome  see CONTRIBUTING.md.";
CM_ SG_ 2147614219 Entertainment_Library_Data_Group "Generic 8-byte raw payload. Detail page: https://www.isobus.net/isobus/pGNAndSPN/17679?type=PGN. Signal-level enrichment via PR welcome  see CONTRIBUTING.md.";
CM_ SG_ 2147614220 Entertainment_Library_Data_Searc "Generic 8-byte raw payload. Detail page: https://www.isobus.net/isobus/pGNAndSPN/17680?type=PGN. Signal-level enrichment via PR welcome  see CONTRIBUTING.md.";
CM_ SG_ 2147614221 Entertainment_Supported_Source_D "Generic 8-byte raw payload. Detail page: https://www.isobus.net/isobus/pGNAndSPN/17681?type=PGN. Signal-level enrichment via PR welcome  see CONTRIBUTING.md.";
CM_ SG_ 2147614222 Entertainment_Supported_Zone_Dat "Generic 8-byte raw payload. Detail page: https://www.isobus.net/isobus/pGNAndSPN/17682?type=PGN. Signal-level enrichment via PR welcome  see CONTRIBUTING.md.";
CM_ SG_ 2147614223 Entertainment_Parental_Control_S "Generic 8-byte raw payload. Detail page: https://www.isobus.net/isobus/pGNAndSPN/17683?type=PGN. Signal-level enrichment via PR welcome  see CONTRIBUTING.md.";
CM_ SG_ 2147614224 Small_Craft_Status_RawPayload "Generic 8-byte raw payload. Detail page: https://www.isobus.net/isobus/pGNAndSPN/17684?type=PGN. Signal-level enrichment via PR welcome  see CONTRIBUTING.md.";
CM_ SG_ 2147614225 Direction_Data_RawPayload "Generic 8-byte raw payload. Detail page: https://www.isobus.net/isobus/pGNAndSPN/17685?type=PGN. Signal-level enrichment via PR welcome  see CONTRIBUTING.md.";
CM_ SG_ 2147614226 Vessel_Speed_Components_RawPaylo "Generic 8-byte raw payload. Detail page: https://www.isobus.net/isobus/pGNAndSPN/17686?type=PGN. Signal-level enrichment via PR welcome  see CONTRIBUTING.md.";
CM_ SG_ 2147614227 Entertainment_System_Configurati "Generic 8-byte raw payload. Detail page: https://www.isobus.net/isobus/pGNAndSPN/17687?type=PGN. Signal-level enrichment via PR welcome  see CONTRIBUTING.md.";
CM_ SG_ 2147614228 Entertainment_System_Configurati "Generic 8-byte raw payload. Detail page: https://www.isobus.net/isobus/pGNAndSPN/17688?type=PGN. Signal-level enrichment via PR welcome  see CONTRIBUTING.md.";
CM_ SG_ 2147614229 Entertainment_Zone_Configuration "Generic 8-byte raw payload. Detail page: https://www.isobus.net/isobus/pGNAndSPN/17689?type=PGN. Signal-level enrichment via PR welcome  see CONTRIBUTING.md.";
CM_ SG_ 2147614230 Entertainment_Zone_Volume_RawPay "Generic 8-byte raw payload. Detail page: https://www.isobus.net/isobus/pGNAndSPN/17690?type=PGN. Signal-level enrichment via PR welcome  see CONTRIBUTING.md.";
CM_ SG_ 2147614231 Entertainment_Available_Audio_EQ "Generic 8-byte raw payload. Detail page: https://www.isobus.net/isobus/pGNAndSPN/17691?type=PGN. Signal-level enrichment via PR welcome  see CONTRIBUTING.md.";
CM_ SG_ 2147614232 Entertainment_Bluetooth_Devices_ "Generic 8-byte raw payload. Detail page: https://www.isobus.net/isobus/pGNAndSPN/17692?type=PGN. Signal-level enrichment via PR welcome  see CONTRIBUTING.md.";
CM_ SG_ 2147614233 Entertainment_Bluetooth_Source_S "Generic 8-byte raw payload. Detail page: https://www.isobus.net/isobus/pGNAndSPN/17693?type=PGN. Signal-level enrichment via PR welcome  see CONTRIBUTING.md.";
CM_ SG_ 2147614234 Entertainment_Zone_Configuration "Generic 8-byte raw payload. Detail page: https://www.isobus.net/isobus/pGNAndSPN/17694?type=PGN. Signal-level enrichment via PR welcome  see CONTRIBUTING.md.";

BA_DEF_ BO_ "SystemMessageLongSymbol" STRING;
BA_DEF_ SG_ "SystemSignalLongSymbol" STRING;
BA_ "SystemMessageLongSymbol" BO_ 2147548773 "VDMA_FE65_General_Purpose_Message_1_6";
BA_ "SystemMessageLongSymbol" BO_ 2147548774 "VDMA_FE66_Battery_Main_Switch_Information";
BA_ "SystemMessageLongSymbol" BO_ 2147548775 "VDMA_FE67_Climate_Control_Configuration";
BA_ "SystemMessageLongSymbol" BO_ 2147548778 "VDMA_FE6A_Engine_Fuel_Lube_Systems";
BA_ "SystemMessageLongSymbol" BO_ 2147548779 "VDMA_FE6B_Driver_s_Identification";
BA_ "SystemMessageLongSymbol" BO_ 2147548782 "VDMA_FE6E_High_Resolution_Wheel_Speed";
BA_ "SystemMessageLongSymbol" BO_ 2147548783 "VDMA_FE6F_Adaptive_Cruise_Control_1";
BA_ "SystemMessageLongSymbol" BO_ 2147548784 "VDMA_FE70_Combination_Vehicle_Weight";
BA_ "SystemMessageLongSymbol" BO_ 2147548786 "VDMA_FE72_Laser_Leveling_System_Blade_Cont";
BA_ "SystemMessageLongSymbol" BO_ 2147548787 "VDMA_FE73_Laser_Receiver_Mast_Position";
BA_ "SystemMessageLongSymbol" BO_ 2147548788 "VDMA_FE74_Modify_Leveling_System_Control_S";
BA_ "SystemMessageLongSymbol" BO_ 2147548789 "VDMA_FE75_Laser_Leveling_System_Vertical_D";
BA_ "SystemMessageLongSymbol" BO_ 2147548790 "VDMA_FE76_Laser_Leveling_System_Vertical_P";
BA_ "SystemMessageLongSymbol" BO_ 2147548792 "VDMA_FE78_Tire_Pressure_Control_Unit_Mode_";
BA_ "SystemMessageLongSymbol" BO_ 2147548793 "VDMA_FE79_Tire_Pressure_Control_Unit_Targe";
BA_ "SystemMessageLongSymbol" BO_ 2147548794 "VDMA_FE7A_Tire_Pressure_Control_Unit_Curre";
BA_ "SystemMessageLongSymbol" BO_ 2147548801 "VDMA_FE81_Fuel_Information_2_Gaseous";
BA_ "SystemMessageLongSymbol" BO_ 2147548808 "VDMA_FE88_Ignition_Transformer_Secondary_O";
BA_ "SystemMessageLongSymbol" BO_ 2147548809 "VDMA_FE89_Ignition_Transformer_Secondary_O";
BA_ "SystemMessageLongSymbol" BO_ 2147548810 "VDMA_FE8A_Ignition_Transformer_Secondary_O";
BA_ "SystemMessageLongSymbol" BO_ 2147548811 "VDMA_FE8B_Gaseous_Fuel_Pressure_1";
BA_ "SystemMessageLongSymbol" BO_ 2147548812 "VDMA_FE8C_Auxiliary_Analog_Information";
BA_ "SystemMessageLongSymbol" BO_ 2147548813 "VDMA_FE8D_Vehicle_Electrical_Power_2";
BA_ "SystemMessageLongSymbol" BO_ 2147548819 "VDMA_FE93_Engine_Electrical_System_Module_";
BA_ "SystemMessageLongSymbol" BO_ 2147548820 "VDMA_FE94_Engine_Auxiliary_Coolant";
BA_ "SystemMessageLongSymbol" BO_ 2147548823 "VDMA_FE97_Turbocharger_Information_5";
BA_ "SystemMessageLongSymbol" BO_ 2147548824 "VDMA_FE98_Turbocharger_Information_4";
BA_ "SystemMessageLongSymbol" BO_ 2147548825 "VDMA_FE99_Turbocharger_Information_3";
BA_ "SystemMessageLongSymbol" BO_ 2147548826 "VDMA_FE9A_Turbocharger_Information_2";
BA_ "SystemMessageLongSymbol" BO_ 2147548827 "VDMA_FE9B_Turbocharger_Information_1";
BA_ "SystemMessageLongSymbol" BO_ 2147548828 "VDMA_FE9C_Main_Bearing_Temperature_3";
BA_ "SystemMessageLongSymbol" BO_ 2147548829 "VDMA_FE9D_Main_Bearing_Temperature_2";
BA_ "SystemMessageLongSymbol" BO_ 2147548830 "VDMA_FE9E_Main_Bearing_Temperature_1";
BA_ "SystemMessageLongSymbol" BO_ 2147548831 "VDMA_FE9F_Exhaust_Port_Temperature_5";
BA_ "SystemMessageLongSymbol" BO_ 2147548832 "VDMA_FEA0_Exhaust_Port_Temperature_4";
BA_ "SystemMessageLongSymbol" BO_ 2147548833 "VDMA_FEA1_Exhaust_Port_Temperature_3";
BA_ "SystemMessageLongSymbol" BO_ 2147548834 "VDMA_FEA2_Exhaust_Port_Temperature_2";
BA_ "SystemMessageLongSymbol" BO_ 2147548835 "VDMA_FEA3_Exhaust_Port_Temperature_1";
BA_ "SystemMessageLongSymbol" BO_ 2147548837 "VDMA_FEA5_Intake_Manifold_Information_2";
BA_ "SystemMessageLongSymbol" BO_ 2147548838 "VDMA_FEA6_Intake_Manifold_Information_1";
BA_ "SystemMessageLongSymbol" BO_ 2147548839 "VDMA_FEA7_Alternator_Temperature_1";
BA_ "SystemMessageLongSymbol" BO_ 2147548843 "VDMA_FEAB_Electronic_Transmission_Controll";
BA_ "SystemMessageLongSymbol" BO_ 2147548844 "VDMA_FEAC_Wheel_Brake_Lining_Remaining_Inf";
BA_ "SystemMessageLongSymbol" BO_ 2147548845 "VDMA_FEAD_Wheel_Application_Pressure_High_";
BA_ "SystemMessageLongSymbol" BO_ 2147548847 "VDMA_FEAF_Fuel_Consumption_Gaseous";
BA_ "SystemMessageLongSymbol" BO_ 2147548848 "VDMA_FEB0_Trip_Time_Information_2";
BA_ "SystemMessageLongSymbol" BO_ 2147548850 "VDMA_FEB2_Fuel_Information_1_Gaseous";
BA_ "SystemMessageLongSymbol" BO_ 2147548851 "VDMA_FEB3_Fuel_Information_1_Liquid";
BA_ "SystemMessageLongSymbol" BO_ 2147548852 "VDMA_FEB4_Trip_Time_Information_1";
BA_ "SystemMessageLongSymbol" BO_ 2147548853 "VDMA_FEB5_Trip_Shutdown_Information";
BA_ "SystemMessageLongSymbol" BO_ 2147548854 "VDMA_FEB6_Trip_Vehicle_Speed_Cruise_Distan";
BA_ "SystemMessageLongSymbol" BO_ 2147548855 "VDMA_FEB7_Engine_Speed_Load_Factor_Informa";
BA_ "SystemMessageLongSymbol" BO_ 2147548856 "VDMA_FEB8_Trip_Fuel_Information_Gaseous";
BA_ "SystemMessageLongSymbol" BO_ 2147548857 "VDMA_FEB9_Trip_Fuel_Information_Liquid";
BA_ "SystemMessageLongSymbol" BO_ 2147548858 "VDMA_FEBA_Trip_Distance_Information";
BA_ "SystemMessageLongSymbol" BO_ 2147548860 "VDMA_FEBC_Compression_Service_Brake_Inform";
BA_ "SystemMessageLongSymbol" BO_ 2147548862 "VDMA_FEBE_Electronic_Engine_Controller_4";
BA_ "SystemMessageLongSymbol" BO_ 2147548863 "VDMA_FEBF_Wheel_Speed_Information";
BA_ "SystemMessageLongSymbol" BO_ 2147548865 "VDMA_FEC1_High_Resolution_Vehicle_Distance";
BA_ "SystemMessageLongSymbol" BO_ 2147548866 "VDMA_FEC2_Electronic_Retarder_Controller_2";
BA_ "SystemMessageLongSymbol" BO_ 2147548867 "VDMA_FEC3_Electronic_Transmission_Controll";
BA_ "SystemMessageLongSymbol" BO_ 2147548868 "VDMA_FEC4_Electronic_Brake_System_2_2";
BA_ "SystemMessageLongSymbol" BO_ 2147548869 "VDMA_FEC5_Electronic_Transmission_Controll";
BA_ "SystemMessageLongSymbol" BO_ 2147548870 "VDMA_FEC6_Electronic_Brake_System_2_3";
BA_ "SystemMessageLongSymbol" BO_ 2147548871 "VDMA_FEC7_Electronic_Transmission_Controll";
BA_ "SystemMessageLongSymbol" BO_ 2147548872 "VDMA_FEC8_General_Purpose_Message_2_2";
BA_ "SystemMessageLongSymbol" BO_ 2147548873 "VDMA_FEC9_Electronic_Brake_System_1_2";
BA_ "SystemMessageLongSymbol" BO_ 2147548877 "VDMA_FECD_Freeze_Frame_Parameters";
BA_ "SystemMessageLongSymbol" BO_ 2147548879 "VDMA_FECF_Emission_Related_Pending_Diagnos";
BA_ "SystemMessageLongSymbol" BO_ 2147548880 "VDMA_FED0_Test_Results_for_Non_continuousl";
BA_ "SystemMessageLongSymbol" BO_ 2147548881 "VDMA_FED1_Oxygen_Sensor_Test_Results";
BA_ "SystemMessageLongSymbol" BO_ 2147548882 "VDMA_FED2_Non_Continuously_Monitored_Syste";
BA_ "SystemMessageLongSymbol" BO_ 2147548884 "VDMA_FED4_Emission_Related_MIL_On_Diagnost";
BA_ "SystemMessageLongSymbol" BO_ 2147548885 "VDMA_FED5_Alternator_Information_1";
BA_ "SystemMessageLongSymbol" BO_ 2147548886 "VDMA_FED6_Hybrid_or_EV_System_Inputs_1";
BA_ "SystemMessageLongSymbol" BO_ 2147548889 "VDMA_FED9_Auxiliary_Input_Output_Status_1";
BA_ "SystemMessageLongSymbol" BO_ 2147548891 "VDMA_FEDB_Engine_Fluid_Level_Pressure_2";
BA_ "SystemMessageLongSymbol" BO_ 2147548894 "VDMA_FEDE_Engine_Air_Start_Pressure";
BA_ "SystemMessageLongSymbol" BO_ 2147548898 "VDMA_FEE2_Transmission_Configuration";
BA_ "SystemMessageLongSymbol" BO_ 2147548904 "VDMA_FEE8_Vehicle_Direction_Speed";
BA_ "SystemMessageLongSymbol" BO_ 2147548905 "VDMA_FEE9_Fuel_Consumption_Liquid_1";
BA_ "SystemMessageLongSymbol" BO_ 2147548909 "VDMA_FEED_Cruise_Control_Vehicle_Speed_Set";
BA_ "SystemMessageLongSymbol" BO_ 2147548912 "VDMA_FEF0_Power_Takeoff_Information_1";
BA_ "SystemMessageLongSymbol" BO_ 2147548916 "VDMA_FEF4_Tire_Condition_Message_1";
BA_ "SystemMessageLongSymbol" BO_ 2147548926 "VDMA_FEFE_Auxiliary_Water_Pump_Pressure";
BA_ "SystemMessageLongSymbol" BO_ 2147609856 "VDMA_1ED00_NMEA_Request_Command_Acknowledge";
BA_ "SystemMessageLongSymbol" BO_ 2147610112 "VDMA_1EE00_PGN_List_Transmit_Receive_PGN_s_";
BA_ "SystemMessageLongSymbol" BO_ 2147610646 "VDMA_1F016_Configuration_Information";
BA_ "SystemMessageLongSymbol" BO_ 2147610649 "VDMA_1F019_Cyclic_Alert_List_IEC_61924_2";
BA_ "SystemMessageLongSymbol" BO_ 2147610650 "VDMA_1F01A_Responsibility_Transfer_Function";
BA_ "SystemMessageLongSymbol" BO_ 2147610881 "VDMA_1F101_Man_Overboard_Notification_MOB";
BA_ "SystemMessageLongSymbol" BO_ 2147611136 "VDMA_1F200_Engine_Parameters_Rapid_Update";
BA_ "SystemMessageLongSymbol" BO_ 2147611137 "VDMA_1F201_Engine_Parameters_Dynamic";
BA_ "SystemMessageLongSymbol" BO_ 2147611138 "VDMA_1F202_Electric_Drive_Status_Dynamic";
BA_ "SystemMessageLongSymbol" BO_ 2147611139 "VDMA_1F203_Electric_Energy_Storage_Status_D";
BA_ "SystemMessageLongSymbol" BO_ 2147611141 "VDMA_1F205_Transmission_Parameters_Dynamic";
BA_ "SystemMessageLongSymbol" BO_ 2147611142 "VDMA_1F206_Electric_Drive_Information";
BA_ "SystemMessageLongSymbol" BO_ 2147611143 "VDMA_1F207_Electric_Energy_Storage_Informat";
BA_ "SystemMessageLongSymbol" BO_ 2147611144 "VDMA_1F208_Trip_Parameters_Vessel";
BA_ "SystemMessageLongSymbol" BO_ 2147611145 "VDMA_1F209_Trip_Parameters_Small_Craft";
BA_ "SystemMessageLongSymbol" BO_ 2147611146 "VDMA_1F20A_Engine_Parameters_Static";
BA_ "SystemMessageLongSymbol" BO_ 2147611148 "VDMA_1F20C_Load_Controller_Connection_State";
BA_ "SystemMessageLongSymbol" BO_ 2147611149 "VDMA_1F20D_Binary_Switch_Bank_Status";
BA_ "SystemMessageLongSymbol" BO_ 2147611158 "VDMA_1F216_Charger_Configuration_Status";
BA_ "SystemMessageLongSymbol" BO_ 2147611159 "VDMA_1F217_Inverter_Configuration_Status";
BA_ "SystemMessageLongSymbol" BO_ 2147611160 "VDMA_1F218_AGS_Configuration_Status";
BA_ "SystemMessageLongSymbol" BO_ 2147611161 "VDMA_1F219_Battery_Configuration_Status";
BA_ "SystemMessageLongSymbol" BO_ 2147611392 "VDMA_1F300_AC_Power_Current_Phase_A";
BA_ "SystemMessageLongSymbol" BO_ 2147611393 "VDMA_1F301_AC_Power_Current_Phase_B";
BA_ "SystemMessageLongSymbol" BO_ 2147611394 "VDMA_1F302_AC_Power_Current_Phase_C";
BA_ "SystemMessageLongSymbol" BO_ 2147611395 "VDMA_1F303_AC_Voltage_Frequency_Phase_A";
BA_ "SystemMessageLongSymbol" BO_ 2147611396 "VDMA_1F304_AC_Voltage_Frequency_Phase_B";
BA_ "SystemMessageLongSymbol" BO_ 2147611397 "VDMA_1F305_AC_Voltage_Frequency_Phase_C";
BA_ "SystemMessageLongSymbol" BO_ 2147611398 "VDMA_1F306_Converter_Inverter_Charger_Statu";
BA_ "SystemMessageLongSymbol" BO_ 2147611650 "VDMA_1F402_Electric_Drive_Status_Rapid_Upda";
BA_ "SystemMessageLongSymbol" BO_ 2147611651 "VDMA_1F403_Electric_Energy_Storage_Status_R";
BA_ "SystemMessageLongSymbol" BO_ 2147611654 "VDMA_1F406_Thruster_Control_Status";
BA_ "SystemMessageLongSymbol" BO_ 2147612416 "VDMA_1F700_Elevator_Motor_Control";
BA_ "SystemMessageLongSymbol" BO_ 2147612417 "VDMA_1F701_Elevator_Deck_Push_Button";
BA_ "SystemMessageLongSymbol" BO_ 2147612424 "VDMA_1F708_Windlass_Control_Status";
BA_ "SystemMessageLongSymbol" BO_ 2147612425 "VDMA_1F709_Anchor_Windlass_Operating_Status";
BA_ "SystemMessageLongSymbol" BO_ 2147612426 "VDMA_1F70A_Anchor_Windlass_Monitoring_Statu";
BA_ "SystemMessageLongSymbol" BO_ 2147612428 "VDMA_1F70C_Linear_Actuator_Control_Status";
BA_ "SystemMessageLongSymbol" BO_ 2147612676 "VDMA_1F804_Altitude_Delta_High_Precision_Ra";
BA_ "SystemMessageLongSymbol" BO_ 2147612686 "VDMA_1F80E_AIS_Class_A_Position_Report";
BA_ "SystemMessageLongSymbol" BO_ 2147612687 "VDMA_1F80F_AIS_Class_B_Position_Report";
BA_ "SystemMessageLongSymbol" BO_ 2147612688 "VDMA_1F810_AIS_Class_B_Extended_Position_Re";
BA_ "SystemMessageLongSymbol" BO_ 2147612689 "VDMA_1F811_AIS_Aids_to_Navigation_AtoN_Repo";
BA_ "SystemMessageLongSymbol" BO_ 2147612933 "VDMA_1F905_Navigation_Route_WP_information";
BA_ "SystemMessageLongSymbol" BO_ 2147612939 "VDMA_1F90B_Set_Drift_Rapid_Update";
BA_ "SystemMessageLongSymbol" BO_ 2147612950 "VDMA_1F916_Bearing_and_Distance_between_two";
BA_ "SystemMessageLongSymbol" BO_ 2147613190 "VDMA_1FA06_GNSS_Pseudorange_Noise_Statistic";
BA_ "SystemMessageLongSymbol" BO_ 2147613195 "VDMA_1FA0B_GNSS_Pseudorange_Error_Statistic";
BA_ "SystemMessageLongSymbol" BO_ 2147613198 "VDMA_1FA0E_GNSS_Differential_Correction_Rec";
BA_ "SystemMessageLongSymbol" BO_ 2147613199 "VDMA_1FA0F_GNSS_Differential_Correction_Rec";
BA_ "SystemMessageLongSymbol" BO_ 2147613440 "VDMA_1FB00_AIS_DGNSS_Broadcast_Binary_Messa";
BA_ "SystemMessageLongSymbol" BO_ 2147613441 "VDMA_1FB01_AIS_UTC_and_Date_Report";
BA_ "SystemMessageLongSymbol" BO_ 2147613442 "VDMA_1FB02_AIS_Class_A_Static_and_Voyage_Re";
BA_ "SystemMessageLongSymbol" BO_ 2147613443 "VDMA_1FB03_AIS_Addressed_Binary_Message";
BA_ "SystemMessageLongSymbol" BO_ 2147613445 "VDMA_1FB05_AIS_Binary_Broadcast_Message";
BA_ "SystemMessageLongSymbol" BO_ 2147613446 "VDMA_1FB06_AIS_SAR_Aircraft_Position_Report";
BA_ "SystemMessageLongSymbol" BO_ 2147613447 "VDMA_1FB07_Radio_Frequency_Mode_Power";
BA_ "SystemMessageLongSymbol" BO_ 2147613449 "VDMA_1FB09_AIS_Addressed_Safety_Related_Mes";
BA_ "SystemMessageLongSymbol" BO_ 2147613450 "VDMA_1FB0A_AIS_Safety_Related_Broadcast_Mes";
BA_ "SystemMessageLongSymbol" BO_ 2147613452 "VDMA_1FB0C_AIS_Assignment_Mode_Command";
BA_ "SystemMessageLongSymbol" BO_ 2147613453 "VDMA_1FB0D_AIS_Data_Link_Management_Message";
BA_ "SystemMessageLongSymbol" BO_ 2147613454 "VDMA_1FB0E_AIS_Channel_Management";
BA_ "SystemMessageLongSymbol" BO_ 2147613455 "VDMA_1FB0F_AIS_Class_B_Group_Assignment";
BA_ "SystemMessageLongSymbol" BO_ 2147613457 "VDMA_1FB11_AIS_Class_B_CS_Static_Data_Repor";
BA_ "SystemMessageLongSymbol" BO_ 2147613458 "VDMA_1FB12_AIS_Class_B_CS_Static_Data_Repor";
BA_ "SystemMessageLongSymbol" BO_ 2147613459 "VDMA_1FB13_AIS_Single_Slot_Binary_Message_D";
BA_ "SystemMessageLongSymbol" BO_ 2147613460 "VDMA_1FB14_AIS_Multi_Slot_Binary_Message_DE";
BA_ "SystemMessageLongSymbol" BO_ 2147613461 "VDMA_1FB15_AIS_Long_Range_Broadcast_Message";
BA_ "SystemMessageLongSymbol" BO_ 2147613462 "VDMA_1FB16_AIS_Single_Slot_Binary_Message";
BA_ "SystemMessageLongSymbol" BO_ 2147613463 "VDMA_1FB17_AIS_Multi_Slot_Binary_Message";
BA_ "SystemMessageLongSymbol" BO_ 2147613709 "VDMA_1FC0D_Channel_Source_Configuration";
BA_ "SystemMessageLongSymbol" BO_ 2147613712 "VDMA_1FC10_Route_and_WP_Service_Database_Li";
BA_ "SystemMessageLongSymbol" BO_ 2147613713 "VDMA_1FC11_Route_and_WP_Service_Route_List";
BA_ "SystemMessageLongSymbol" BO_ 2147613714 "VDMA_1FC12_Route_and_WP_Service_Route_WP_Li";
BA_ "SystemMessageLongSymbol" BO_ 2147613715 "VDMA_1FC13_Route_and_WP_Service_Route_WP_Na";
BA_ "SystemMessageLongSymbol" BO_ 2147613716 "VDMA_1FC14_Route_and_WP_Service_Route_WP_Na";
BA_ "SystemMessageLongSymbol" BO_ 2147613717 "VDMA_1FC15_Route_and_WP_Service_XTE_Limit_N";
BA_ "SystemMessageLongSymbol" BO_ 2147613718 "VDMA_1FC16_Route_and_WP_Service_WP_Comment";
BA_ "SystemMessageLongSymbol" BO_ 2147613719 "VDMA_1FC17_Route_and_WP_Service_Route_Comme";
BA_ "SystemMessageLongSymbol" BO_ 2147613720 "VDMA_1FC18_Route_and_WP_Service_Database_Co";
BA_ "SystemMessageLongSymbol" BO_ 2147613721 "VDMA_1FC19_Route_and_WP_Service_Radius_of_T";
BA_ "SystemMessageLongSymbol" BO_ 2147613722 "VDMA_1FC1A_Route_and_WP_Service_WP_List_WP_";
BA_ "SystemMessageLongSymbol" BO_ 2147613958 "VDMA_1FD06_Environmental_Parameters";
BA_ "SystemMessageLongSymbol" BO_ 2147613959 "VDMA_1FD07_Environmental_Parameters";
BA_ "SystemMessageLongSymbol" BO_ 2147613964 "VDMA_1FD0C_Temperature_Extended_Range";
BA_ "SystemMessageLongSymbol" BO_ 2147613971 "VDMA_1FD13_Meteorological_Station_Data";
BA_ "SystemMessageLongSymbol" BO_ 2147613972 "VDMA_1FD14_Moored_Buoy_Station_Data";
BA_ "SystemMessageLongSymbol" BO_ 2147613978 "VDMA_1FD1A_Lighting_System_Settings";
BA_ "SystemMessageLongSymbol" BO_ 2147614212 "VDMA_1FE04_Lighting_Device_Enumeration";
BA_ "SystemMessageLongSymbol" BO_ 2147614213 "VDMA_1FE05_Lighting_Color_Sequence";
BA_ "SystemMessageLongSymbol" BO_ 2147614215 "VDMA_1FE07_Watermaker_Input_Setting_and_Sta";
BA_ "SystemMessageLongSymbol" BO_ 2147614216 "VDMA_1FE08_Entertainment_Diagnostic_Status";
BA_ "SystemMessageLongSymbol" BO_ 2147614217 "VDMA_1FE09_Entertainment_Current_File_and_S";
BA_ "SystemMessageLongSymbol" BO_ 2147614218 "VDMA_1FE0A_Entertainment_Library_Data_File";
BA_ "SystemMessageLongSymbol" BO_ 2147614219 "VDMA_1FE0B_Entertainment_Library_Data_Group";
BA_ "SystemMessageLongSymbol" BO_ 2147614220 "VDMA_1FE0C_Entertainment_Library_Data_Searc";
BA_ "SystemMessageLongSymbol" BO_ 2147614221 "VDMA_1FE0D_Entertainment_Supported_Source_D";
BA_ "SystemMessageLongSymbol" BO_ 2147614222 "VDMA_1FE0E_Entertainment_Supported_Zone_Dat";
BA_ "SystemMessageLongSymbol" BO_ 2147614223 "VDMA_1FE0F_Entertainment_Parental_Control_S";
BA_ "SystemMessageLongSymbol" BO_ 2147614226 "VDMA_1FE12_Vessel_Speed_Components";
BA_ "SystemMessageLongSymbol" BO_ 2147614227 "VDMA_1FE13_Entertainment_System_Configurati";
BA_ "SystemMessageLongSymbol" BO_ 2147614228 "VDMA_1FE14_Entertainment_System_Configurati";
BA_ "SystemMessageLongSymbol" BO_ 2147614229 "VDMA_1FE15_Entertainment_Zone_Configuration";
BA_ "SystemMessageLongSymbol" BO_ 2147614230 "VDMA_1FE16_Entertainment_Zone_Volume";
BA_ "SystemMessageLongSymbol" BO_ 2147614231 "VDMA_1FE17_Entertainment_Available_Audio_EQ";
BA_ "SystemMessageLongSymbol" BO_ 2147614232 "VDMA_1FE18_Entertainment_Bluetooth_Devices";
BA_ "SystemMessageLongSymbol" BO_ 2147614233 "VDMA_1FE19_Entertainment_Bluetooth_Source_S";
BA_ "SystemMessageLongSymbol" BO_ 2147614234 "VDMA_1FE1A_Entertainment_Zone_Configuration";
BA_ "SystemSignalLongSymbol" SG_ 2147548773 General_Purpose_Message_1_6_RawP "General_Purpose_Message_1_6_RawPayload";
BA_ "SystemSignalLongSymbol" SG_ 2147548774 Battery_Main_Switch_Information_ "Battery_Main_Switch_Information_RawPayload";
BA_ "SystemSignalLongSymbol" SG_ 2147548775 Climate_Control_Configuration_Ra "Climate_Control_Configuration_RawPayload";
BA_ "SystemSignalLongSymbol" SG_ 2147548778 Engine_Fuel_Lube_Systems_RawPayl "Engine_Fuel_Lube_Systems_RawPayload";
BA_ "SystemSignalLongSymbol" SG_ 2147548779 Driver_s_Identification_RawPaylo "Driver_s_Identification_RawPayload";
BA_ "SystemSignalLongSymbol" SG_ 2147548782 High_Resolution_Wheel_Speed_RawP "High_Resolution_Wheel_Speed_RawPayload";
BA_ "SystemSignalLongSymbol" SG_ 2147548783 Adaptive_Cruise_Control_1_RawPay "Adaptive_Cruise_Control_1_RawPayload";
BA_ "SystemSignalLongSymbol" SG_ 2147548784 Combination_Vehicle_Weight_RawPa "Combination_Vehicle_Weight_RawPayload";
BA_ "SystemSignalLongSymbol" SG_ 2147548786 Laser_Leveling_System_Blade_Cont "Laser_Leveling_System_Blade_Cont_RawPayload";
BA_ "SystemSignalLongSymbol" SG_ 2147548787 Laser_Receiver_Mast_Position_Raw "Laser_Receiver_Mast_Position_RawPayload";
BA_ "SystemSignalLongSymbol" SG_ 2147548788 Modify_Leveling_System_Control_S "Modify_Leveling_System_Control_S_RawPayload";
BA_ "SystemSignalLongSymbol" SG_ 2147548789 Laser_Leveling_System_Vertical_D "Laser_Leveling_System_Vertical_D_RawPayload";
BA_ "SystemSignalLongSymbol" SG_ 2147548790 Laser_Leveling_System_Vertical_P "Laser_Leveling_System_Vertical_P_RawPayload";
BA_ "SystemSignalLongSymbol" SG_ 2147548792 Tire_Pressure_Control_Unit_Mode_ "Tire_Pressure_Control_Unit_Mode__RawPayload";
BA_ "SystemSignalLongSymbol" SG_ 2147548793 Tire_Pressure_Control_Unit_Targe "Tire_Pressure_Control_Unit_Targe_RawPayload";
BA_ "SystemSignalLongSymbol" SG_ 2147548794 Tire_Pressure_Control_Unit_Curre "Tire_Pressure_Control_Unit_Curre_RawPayload";
BA_ "SystemSignalLongSymbol" SG_ 2147548801 Fuel_Information_2_Gaseous_RawPa "Fuel_Information_2_Gaseous_RawPayload";
BA_ "SystemSignalLongSymbol" SG_ 2147548808 Ignition_Transformer_Secondary_O "Ignition_Transformer_Secondary_O_RawPayload";
BA_ "SystemSignalLongSymbol" SG_ 2147548809 Ignition_Transformer_Secondary_O "Ignition_Transformer_Secondary_O_RawPayload";
BA_ "SystemSignalLongSymbol" SG_ 2147548810 Ignition_Transformer_Secondary_O "Ignition_Transformer_Secondary_O_RawPayload";
BA_ "SystemSignalLongSymbol" SG_ 2147548811 Gaseous_Fuel_Pressure_1_RawPaylo "Gaseous_Fuel_Pressure_1_RawPayload";
BA_ "SystemSignalLongSymbol" SG_ 2147548812 Auxiliary_Analog_Information_Raw "Auxiliary_Analog_Information_RawPayload";
BA_ "SystemSignalLongSymbol" SG_ 2147548813 Vehicle_Electrical_Power_2_RawPa "Vehicle_Electrical_Power_2_RawPayload";
BA_ "SystemSignalLongSymbol" SG_ 2147548819 Engine_Electrical_System_Module_ "Engine_Electrical_System_Module__RawPayload";
BA_ "SystemSignalLongSymbol" SG_ 2147548820 Engine_Auxiliary_Coolant_RawPayl "Engine_Auxiliary_Coolant_RawPayload";
BA_ "SystemSignalLongSymbol" SG_ 2147548822 Turbocharger_Wastegate_RawPayloa "Turbocharger_Wastegate_RawPayload";
BA_ "SystemSignalLongSymbol" SG_ 2147548823 Turbocharger_Information_5_RawPa "Turbocharger_Information_5_RawPayload";
BA_ "SystemSignalLongSymbol" SG_ 2147548824 Turbocharger_Information_4_RawPa "Turbocharger_Information_4_RawPayload";
BA_ "SystemSignalLongSymbol" SG_ 2147548825 Turbocharger_Information_3_RawPa "Turbocharger_Information_3_RawPayload";
BA_ "SystemSignalLongSymbol" SG_ 2147548826 Turbocharger_Information_2_RawPa "Turbocharger_Information_2_RawPayload";
BA_ "SystemSignalLongSymbol" SG_ 2147548827 Turbocharger_Information_1_RawPa "Turbocharger_Information_1_RawPayload";
BA_ "SystemSignalLongSymbol" SG_ 2147548828 Main_Bearing_Temperature_3_RawPa "Main_Bearing_Temperature_3_RawPayload";
BA_ "SystemSignalLongSymbol" SG_ 2147548829 Main_Bearing_Temperature_2_RawPa "Main_Bearing_Temperature_2_RawPayload";
BA_ "SystemSignalLongSymbol" SG_ 2147548830 Main_Bearing_Temperature_1_RawPa "Main_Bearing_Temperature_1_RawPayload";
BA_ "SystemSignalLongSymbol" SG_ 2147548831 Exhaust_Port_Temperature_5_RawPa "Exhaust_Port_Temperature_5_RawPayload";
BA_ "SystemSignalLongSymbol" SG_ 2147548832 Exhaust_Port_Temperature_4_RawPa "Exhaust_Port_Temperature_4_RawPayload";
BA_ "SystemSignalLongSymbol" SG_ 2147548833 Exhaust_Port_Temperature_3_RawPa "Exhaust_Port_Temperature_3_RawPayload";
BA_ "SystemSignalLongSymbol" SG_ 2147548834 Exhaust_Port_Temperature_2_RawPa "Exhaust_Port_Temperature_2_RawPayload";
BA_ "SystemSignalLongSymbol" SG_ 2147548835 Exhaust_Port_Temperature_1_RawPa "Exhaust_Port_Temperature_1_RawPayload";
BA_ "SystemSignalLongSymbol" SG_ 2147548837 Intake_Manifold_Information_2_Ra "Intake_Manifold_Information_2_RawPayload";
BA_ "SystemSignalLongSymbol" SG_ 2147548838 Intake_Manifold_Information_1_Ra "Intake_Manifold_Information_1_RawPayload";
BA_ "SystemSignalLongSymbol" SG_ 2147548839 Alternator_Temperature_1_RawPayl "Alternator_Temperature_1_RawPayload";
BA_ "SystemSignalLongSymbol" SG_ 2147548843 Electronic_Transmission_Controll "Electronic_Transmission_Controll_RawPayload";
BA_ "SystemSignalLongSymbol" SG_ 2147548844 Wheel_Brake_Lining_Remaining_Inf "Wheel_Brake_Lining_Remaining_Inf_RawPayload";
BA_ "SystemSignalLongSymbol" SG_ 2147548845 Wheel_Application_Pressure_High_ "Wheel_Application_Pressure_High__RawPayload";
BA_ "SystemSignalLongSymbol" SG_ 2147548847 Fuel_Consumption_Gaseous_RawPayl "Fuel_Consumption_Gaseous_RawPayload";
BA_ "SystemSignalLongSymbol" SG_ 2147548848 Trip_Time_Information_2_RawPaylo "Trip_Time_Information_2_RawPayload";
BA_ "SystemSignalLongSymbol" SG_ 2147548850 Fuel_Information_1_Gaseous_RawPa "Fuel_Information_1_Gaseous_RawPayload";
BA_ "SystemSignalLongSymbol" SG_ 2147548851 Fuel_Information_1_Liquid_RawPay "Fuel_Information_1_Liquid_RawPayload";
BA_ "SystemSignalLongSymbol" SG_ 2147548852 Trip_Time_Information_1_RawPaylo "Trip_Time_Information_1_RawPayload";
BA_ "SystemSignalLongSymbol" SG_ 2147548853 Trip_Shutdown_Information_RawPay "Trip_Shutdown_Information_RawPayload";
BA_ "SystemSignalLongSymbol" SG_ 2147548854 Trip_Vehicle_Speed_Cruise_Distan "Trip_Vehicle_Speed_Cruise_Distan_RawPayload";
BA_ "SystemSignalLongSymbol" SG_ 2147548855 Engine_Speed_Load_Factor_Informa "Engine_Speed_Load_Factor_Informa_RawPayload";
BA_ "SystemSignalLongSymbol" SG_ 2147548856 Trip_Fuel_Information_Gaseous_Ra "Trip_Fuel_Information_Gaseous_RawPayload";
BA_ "SystemSignalLongSymbol" SG_ 2147548857 Trip_Fuel_Information_Liquid_Raw "Trip_Fuel_Information_Liquid_RawPayload";
BA_ "SystemSignalLongSymbol" SG_ 2147548858 Trip_Distance_Information_RawPay "Trip_Distance_Information_RawPayload";
BA_ "SystemSignalLongSymbol" SG_ 2147548860 Compression_Service_Brake_Inform "Compression_Service_Brake_Inform_RawPayload";
BA_ "SystemSignalLongSymbol" SG_ 2147548862 Electronic_Engine_Controller_4_R "Electronic_Engine_Controller_4_RawPayload";
BA_ "SystemSignalLongSymbol" SG_ 2147548863 Wheel_Speed_Information_RawPaylo "Wheel_Speed_Information_RawPayload";
BA_ "SystemSignalLongSymbol" SG_ 2147548865 High_Resolution_Vehicle_Distance "High_Resolution_Vehicle_Distance_RawPayload";
BA_ "SystemSignalLongSymbol" SG_ 2147548866 Electronic_Retarder_Controller_2 "Electronic_Retarder_Controller_2_RawPayload";
BA_ "SystemSignalLongSymbol" SG_ 2147548867 Electronic_Transmission_Controll "Electronic_Transmission_Controll_RawPayload";
BA_ "SystemSignalLongSymbol" SG_ 2147548868 Electronic_Brake_System_2_2_RawP "Electronic_Brake_System_2_2_RawPayload";
BA_ "SystemSignalLongSymbol" SG_ 2147548869 Electronic_Transmission_Controll "Electronic_Transmission_Controll_RawPayload";
BA_ "SystemSignalLongSymbol" SG_ 2147548870 Electronic_Brake_System_2_3_RawP "Electronic_Brake_System_2_3_RawPayload";
BA_ "SystemSignalLongSymbol" SG_ 2147548871 Electronic_Transmission_Controll "Electronic_Transmission_Controll_RawPayload";
BA_ "SystemSignalLongSymbol" SG_ 2147548872 General_Purpose_Message_2_2_RawP "General_Purpose_Message_2_2_RawPayload";
BA_ "SystemSignalLongSymbol" SG_ 2147548873 Electronic_Brake_System_1_2_RawP "Electronic_Brake_System_1_2_RawPayload";
BA_ "SystemSignalLongSymbol" SG_ 2147548877 Freeze_Frame_Parameters_RawPaylo "Freeze_Frame_Parameters_RawPayload";
BA_ "SystemSignalLongSymbol" SG_ 2147548878 Diagnostic_Readiness_1_RawPayloa "Diagnostic_Readiness_1_RawPayload";
BA_ "SystemSignalLongSymbol" SG_ 2147548879 Emission_Related_Pending_Diagnos "Emission_Related_Pending_Diagnos_RawPayload";
BA_ "SystemSignalLongSymbol" SG_ 2147548880 Test_Results_for_Non_continuousl "Test_Results_for_Non_continuousl_RawPayload";
BA_ "SystemSignalLongSymbol" SG_ 2147548881 Oxygen_Sensor_Test_Results_RawPa "Oxygen_Sensor_Test_Results_RawPayload";
BA_ "SystemSignalLongSymbol" SG_ 2147548882 Non_Continuously_Monitored_Syste "Non_Continuously_Monitored_Syste_RawPayload";
BA_ "SystemSignalLongSymbol" SG_ 2147548884 Emission_Related_MIL_On_Diagnost "Emission_Related_MIL_On_Diagnost_RawPayload";
BA_ "SystemSignalLongSymbol" SG_ 2147548885 Alternator_Information_1_RawPayl "Alternator_Information_1_RawPayload";
BA_ "SystemSignalLongSymbol" SG_ 2147548886 Hybrid_or_EV_System_Inputs_1_Raw "Hybrid_or_EV_System_Inputs_1_RawPayload";
BA_ "SystemSignalLongSymbol" SG_ 2147548889 Auxiliary_Input_Output_Status_1_ "Auxiliary_Input_Output_Status_1_RawPayload";
BA_ "SystemSignalLongSymbol" SG_ 2147548891 Engine_Fluid_Level_Pressure_2_Ra "Engine_Fluid_Level_Pressure_2_RawPayload";
BA_ "SystemSignalLongSymbol" SG_ 2147548894 Engine_Air_Start_Pressure_RawPay "Engine_Air_Start_Pressure_RawPayload";
BA_ "SystemSignalLongSymbol" SG_ 2147548897 Retarder_Configuration_RawPayloa "Retarder_Configuration_RawPayload";
BA_ "SystemSignalLongSymbol" SG_ 2147548898 Transmission_Configuration_RawPa "Transmission_Configuration_RawPayload";
BA_ "SystemSignalLongSymbol" SG_ 2147548904 Vehicle_Direction_Speed_RawPaylo "Vehicle_Direction_Speed_RawPayload";
BA_ "SystemSignalLongSymbol" SG_ 2147548905 Fuel_Consumption_Liquid_1_RawPay "Fuel_Consumption_Liquid_1_RawPayload";
BA_ "SystemSignalLongSymbol" SG_ 2147548909 Cruise_Control_Vehicle_Speed_Set "Cruise_Control_Vehicle_Speed_Set_RawPayload";
BA_ "SystemSignalLongSymbol" SG_ 2147548912 Power_Takeoff_Information_1_RawP "Power_Takeoff_Information_1_RawPayload";
BA_ "SystemSignalLongSymbol" SG_ 2147548916 Tire_Condition_Message_1_RawPayl "Tire_Condition_Message_1_RawPayload";
BA_ "SystemSignalLongSymbol" SG_ 2147548926 Auxiliary_Water_Pump_Pressure_Ra "Auxiliary_Water_Pump_Pressure_RawPayload";
BA_ "SystemSignalLongSymbol" SG_ 2147609856 NMEA_Request_Command_Acknowledge "NMEA_Request_Command_Acknowledge_RawPayload";
BA_ "SystemSignalLongSymbol" SG_ 2147610112 PGN_List_Transmit_Receive_PGN_s_ "PGN_List_Transmit_Receive_PGN_s__RawPayload";
BA_ "SystemSignalLongSymbol" SG_ 2147610646 Configuration_Information_RawPay "Configuration_Information_RawPayload";
BA_ "SystemSignalLongSymbol" SG_ 2147610649 Cyclic_Alert_List_IEC_61924_2_Ra "Cyclic_Alert_List_IEC_61924_2_RawPayload";
BA_ "SystemSignalLongSymbol" SG_ 2147610650 Responsibility_Transfer_Function "Responsibility_Transfer_Function_RawPayload";
BA_ "SystemSignalLongSymbol" SG_ 2147610881 Man_Overboard_Notification_MOB_R "Man_Overboard_Notification_MOB_RawPayload";
BA_ "SystemSignalLongSymbol" SG_ 2147611136 Engine_Parameters_Rapid_Update_R "Engine_Parameters_Rapid_Update_RawPayload";
BA_ "SystemSignalLongSymbol" SG_ 2147611137 Engine_Parameters_Dynamic_RawPay "Engine_Parameters_Dynamic_RawPayload";
BA_ "SystemSignalLongSymbol" SG_ 2147611138 Electric_Drive_Status_Dynamic_Ra "Electric_Drive_Status_Dynamic_RawPayload";
BA_ "SystemSignalLongSymbol" SG_ 2147611139 Electric_Energy_Storage_Status_D "Electric_Energy_Storage_Status_D_RawPayload";
BA_ "SystemSignalLongSymbol" SG_ 2147611141 Transmission_Parameters_Dynamic_ "Transmission_Parameters_Dynamic_RawPayload";
BA_ "SystemSignalLongSymbol" SG_ 2147611142 Electric_Drive_Information_RawPa "Electric_Drive_Information_RawPayload";
BA_ "SystemSignalLongSymbol" SG_ 2147611143 Electric_Energy_Storage_Informat "Electric_Energy_Storage_Informat_RawPayload";
BA_ "SystemSignalLongSymbol" SG_ 2147611144 Trip_Parameters_Vessel_RawPayloa "Trip_Parameters_Vessel_RawPayload";
BA_ "SystemSignalLongSymbol" SG_ 2147611145 Trip_Parameters_Small_Craft_RawP "Trip_Parameters_Small_Craft_RawPayload";
BA_ "SystemSignalLongSymbol" SG_ 2147611146 Engine_Parameters_Static_RawPayl "Engine_Parameters_Static_RawPayload";
BA_ "SystemSignalLongSymbol" SG_ 2147611148 Load_Controller_Connection_State "Load_Controller_Connection_State_RawPayload";
BA_ "SystemSignalLongSymbol" SG_ 2147611149 Binary_Switch_Bank_Status_RawPay "Binary_Switch_Bank_Status_RawPayload";
BA_ "SystemSignalLongSymbol" SG_ 2147611158 Charger_Configuration_Status_Raw "Charger_Configuration_Status_RawPayload";
BA_ "SystemSignalLongSymbol" SG_ 2147611159 Inverter_Configuration_Status_Ra "Inverter_Configuration_Status_RawPayload";
BA_ "SystemSignalLongSymbol" SG_ 2147611160 AGS_Configuration_Status_RawPayl "AGS_Configuration_Status_RawPayload";
BA_ "SystemSignalLongSymbol" SG_ 2147611161 Battery_Configuration_Status_Raw "Battery_Configuration_Status_RawPayload";
BA_ "SystemSignalLongSymbol" SG_ 2147611392 AC_Power_Current_Phase_A_RawPayl "AC_Power_Current_Phase_A_RawPayload";
BA_ "SystemSignalLongSymbol" SG_ 2147611393 AC_Power_Current_Phase_B_RawPayl "AC_Power_Current_Phase_B_RawPayload";
BA_ "SystemSignalLongSymbol" SG_ 2147611394 AC_Power_Current_Phase_C_RawPayl "AC_Power_Current_Phase_C_RawPayload";
BA_ "SystemSignalLongSymbol" SG_ 2147611395 AC_Voltage_Frequency_Phase_A_Raw "AC_Voltage_Frequency_Phase_A_RawPayload";
BA_ "SystemSignalLongSymbol" SG_ 2147611396 AC_Voltage_Frequency_Phase_B_Raw "AC_Voltage_Frequency_Phase_B_RawPayload";
BA_ "SystemSignalLongSymbol" SG_ 2147611397 AC_Voltage_Frequency_Phase_C_Raw "AC_Voltage_Frequency_Phase_C_RawPayload";
BA_ "SystemSignalLongSymbol" SG_ 2147611398 Converter_Inverter_Charger_Statu "Converter_Inverter_Charger_Statu_RawPayload";
BA_ "SystemSignalLongSymbol" SG_ 2147611650 Electric_Drive_Status_Rapid_Upda "Electric_Drive_Status_Rapid_Upda_RawPayload";
BA_ "SystemSignalLongSymbol" SG_ 2147611651 Electric_Energy_Storage_Status_R "Electric_Energy_Storage_Status_R_RawPayload";
BA_ "SystemSignalLongSymbol" SG_ 2147611654 Thruster_Control_Status_RawPaylo "Thruster_Control_Status_RawPayload";
BA_ "SystemSignalLongSymbol" SG_ 2147612416 Elevator_Motor_Control_RawPayloa "Elevator_Motor_Control_RawPayload";
BA_ "SystemSignalLongSymbol" SG_ 2147612417 Elevator_Deck_Push_Button_RawPay "Elevator_Deck_Push_Button_RawPayload";
BA_ "SystemSignalLongSymbol" SG_ 2147612424 Windlass_Control_Status_RawPaylo "Windlass_Control_Status_RawPayload";
BA_ "SystemSignalLongSymbol" SG_ 2147612425 Anchor_Windlass_Operating_Status "Anchor_Windlass_Operating_Status_RawPayload";
BA_ "SystemSignalLongSymbol" SG_ 2147612426 Anchor_Windlass_Monitoring_Statu "Anchor_Windlass_Monitoring_Statu_RawPayload";
BA_ "SystemSignalLongSymbol" SG_ 2147612428 Linear_Actuator_Control_Status_R "Linear_Actuator_Control_Status_RawPayload";
BA_ "SystemSignalLongSymbol" SG_ 2147612676 Altitude_Delta_High_Precision_Ra "Altitude_Delta_High_Precision_Ra_RawPayload";
BA_ "SystemSignalLongSymbol" SG_ 2147612686 AIS_Class_A_Position_Report_RawP "AIS_Class_A_Position_Report_RawPayload";
BA_ "SystemSignalLongSymbol" SG_ 2147612687 AIS_Class_B_Position_Report_RawP "AIS_Class_B_Position_Report_RawPayload";
BA_ "SystemSignalLongSymbol" SG_ 2147612688 AIS_Class_B_Extended_Position_Re "AIS_Class_B_Extended_Position_Re_RawPayload";
BA_ "SystemSignalLongSymbol" SG_ 2147612689 AIS_Aids_to_Navigation_AtoN_Repo "AIS_Aids_to_Navigation_AtoN_Repo_RawPayload";
BA_ "SystemSignalLongSymbol" SG_ 2147612933 Navigation_Route_WP_information_ "Navigation_Route_WP_information_RawPayload";
BA_ "SystemSignalLongSymbol" SG_ 2147612939 Set_Drift_Rapid_Update_RawPayloa "Set_Drift_Rapid_Update_RawPayload";
BA_ "SystemSignalLongSymbol" SG_ 2147612950 Bearing_and_Distance_between_two "Bearing_and_Distance_between_two_RawPayload";
BA_ "SystemSignalLongSymbol" SG_ 2147613190 GNSS_Pseudorange_Noise_Statistic "GNSS_Pseudorange_Noise_Statistic_RawPayload";
BA_ "SystemSignalLongSymbol" SG_ 2147613195 GNSS_Pseudorange_Error_Statistic "GNSS_Pseudorange_Error_Statistic_RawPayload";
BA_ "SystemSignalLongSymbol" SG_ 2147613198 GNSS_Differential_Correction_Rec "GNSS_Differential_Correction_Rec_RawPayload";
BA_ "SystemSignalLongSymbol" SG_ 2147613199 GNSS_Differential_Correction_Rec "GNSS_Differential_Correction_Rec_RawPayload";
BA_ "SystemSignalLongSymbol" SG_ 2147613440 AIS_DGNSS_Broadcast_Binary_Messa "AIS_DGNSS_Broadcast_Binary_Messa_RawPayload";
BA_ "SystemSignalLongSymbol" SG_ 2147613441 AIS_UTC_and_Date_Report_RawPaylo "AIS_UTC_and_Date_Report_RawPayload";
BA_ "SystemSignalLongSymbol" SG_ 2147613442 AIS_Class_A_Static_and_Voyage_Re "AIS_Class_A_Static_and_Voyage_Re_RawPayload";
BA_ "SystemSignalLongSymbol" SG_ 2147613443 AIS_Addressed_Binary_Message_Raw "AIS_Addressed_Binary_Message_RawPayload";
BA_ "SystemSignalLongSymbol" SG_ 2147613445 AIS_Binary_Broadcast_Message_Raw "AIS_Binary_Broadcast_Message_RawPayload";
BA_ "SystemSignalLongSymbol" SG_ 2147613446 AIS_SAR_Aircraft_Position_Report "AIS_SAR_Aircraft_Position_Report_RawPayload";
BA_ "SystemSignalLongSymbol" SG_ 2147613447 Radio_Frequency_Mode_Power_RawPa "Radio_Frequency_Mode_Power_RawPayload";
BA_ "SystemSignalLongSymbol" SG_ 2147613449 AIS_Addressed_Safety_Related_Mes "AIS_Addressed_Safety_Related_Mes_RawPayload";
BA_ "SystemSignalLongSymbol" SG_ 2147613450 AIS_Safety_Related_Broadcast_Mes "AIS_Safety_Related_Broadcast_Mes_RawPayload";
BA_ "SystemSignalLongSymbol" SG_ 2147613452 AIS_Assignment_Mode_Command_RawP "AIS_Assignment_Mode_Command_RawPayload";
BA_ "SystemSignalLongSymbol" SG_ 2147613453 AIS_Data_Link_Management_Message "AIS_Data_Link_Management_Message_RawPayload";
BA_ "SystemSignalLongSymbol" SG_ 2147613454 AIS_Channel_Management_RawPayloa "AIS_Channel_Management_RawPayload";
BA_ "SystemSignalLongSymbol" SG_ 2147613455 AIS_Class_B_Group_Assignment_Raw "AIS_Class_B_Group_Assignment_RawPayload";
BA_ "SystemSignalLongSymbol" SG_ 2147613457 AIS_Class_B_CS_Static_Data_Repor "AIS_Class_B_CS_Static_Data_Repor_RawPayload";
BA_ "SystemSignalLongSymbol" SG_ 2147613458 AIS_Class_B_CS_Static_Data_Repor "AIS_Class_B_CS_Static_Data_Repor_RawPayload";
BA_ "SystemSignalLongSymbol" SG_ 2147613459 AIS_Single_Slot_Binary_Message_D "AIS_Single_Slot_Binary_Message_D_RawPayload";
BA_ "SystemSignalLongSymbol" SG_ 2147613460 AIS_Multi_Slot_Binary_Message_DE "AIS_Multi_Slot_Binary_Message_DE_RawPayload";
BA_ "SystemSignalLongSymbol" SG_ 2147613461 AIS_Long_Range_Broadcast_Message "AIS_Long_Range_Broadcast_Message_RawPayload";
BA_ "SystemSignalLongSymbol" SG_ 2147613462 AIS_Single_Slot_Binary_Message_R "AIS_Single_Slot_Binary_Message_RawPayload";
BA_ "SystemSignalLongSymbol" SG_ 2147613463 AIS_Multi_Slot_Binary_Message_Ra "AIS_Multi_Slot_Binary_Message_RawPayload";
BA_ "SystemSignalLongSymbol" SG_ 2147613709 Channel_Source_Configuration_Raw "Channel_Source_Configuration_RawPayload";
BA_ "SystemSignalLongSymbol" SG_ 2147613712 Route_and_WP_Service_Database_Li "Route_and_WP_Service_Database_Li_RawPayload";
BA_ "SystemSignalLongSymbol" SG_ 2147613713 Route_and_WP_Service_Route_List_ "Route_and_WP_Service_Route_List_RawPayload";
BA_ "SystemSignalLongSymbol" SG_ 2147613714 Route_and_WP_Service_Route_WP_Li "Route_and_WP_Service_Route_WP_Li_RawPayload";
BA_ "SystemSignalLongSymbol" SG_ 2147613715 Route_and_WP_Service_Route_WP_Na "Route_and_WP_Service_Route_WP_Na_RawPayload";
BA_ "SystemSignalLongSymbol" SG_ 2147613716 Route_and_WP_Service_Route_WP_Na "Route_and_WP_Service_Route_WP_Na_RawPayload";
BA_ "SystemSignalLongSymbol" SG_ 2147613717 Route_and_WP_Service_XTE_Limit_N "Route_and_WP_Service_XTE_Limit_N_RawPayload";
BA_ "SystemSignalLongSymbol" SG_ 2147613718 Route_and_WP_Service_WP_Comment_ "Route_and_WP_Service_WP_Comment_RawPayload";
BA_ "SystemSignalLongSymbol" SG_ 2147613719 Route_and_WP_Service_Route_Comme "Route_and_WP_Service_Route_Comme_RawPayload";
BA_ "SystemSignalLongSymbol" SG_ 2147613720 Route_and_WP_Service_Database_Co "Route_and_WP_Service_Database_Co_RawPayload";
BA_ "SystemSignalLongSymbol" SG_ 2147613721 Route_and_WP_Service_Radius_of_T "Route_and_WP_Service_Radius_of_T_RawPayload";
BA_ "SystemSignalLongSymbol" SG_ 2147613722 Route_and_WP_Service_WP_List_WP_ "Route_and_WP_Service_WP_List_WP__RawPayload";
BA_ "SystemSignalLongSymbol" SG_ 2147613958 Environmental_Parameters_RawPayl "Environmental_Parameters_RawPayload";
BA_ "SystemSignalLongSymbol" SG_ 2147613959 Environmental_Parameters_RawPayl "Environmental_Parameters_RawPayload";
BA_ "SystemSignalLongSymbol" SG_ 2147613964 Temperature_Extended_Range_RawPa "Temperature_Extended_Range_RawPayload";
BA_ "SystemSignalLongSymbol" SG_ 2147613971 Meteorological_Station_Data_RawP "Meteorological_Station_Data_RawPayload";
BA_ "SystemSignalLongSymbol" SG_ 2147613972 Moored_Buoy_Station_Data_RawPayl "Moored_Buoy_Station_Data_RawPayload";
BA_ "SystemSignalLongSymbol" SG_ 2147613978 Lighting_System_Settings_RawPayl "Lighting_System_Settings_RawPayload";
BA_ "SystemSignalLongSymbol" SG_ 2147614212 Lighting_Device_Enumeration_RawP "Lighting_Device_Enumeration_RawPayload";
BA_ "SystemSignalLongSymbol" SG_ 2147614213 Lighting_Color_Sequence_RawPaylo "Lighting_Color_Sequence_RawPayload";
BA_ "SystemSignalLongSymbol" SG_ 2147614215 Watermaker_Input_Setting_and_Sta "Watermaker_Input_Setting_and_Sta_RawPayload";
BA_ "SystemSignalLongSymbol" SG_ 2147614216 Entertainment_Diagnostic_Status_ "Entertainment_Diagnostic_Status_RawPayload";
BA_ "SystemSignalLongSymbol" SG_ 2147614217 Entertainment_Current_File_and_S "Entertainment_Current_File_and_S_RawPayload";
BA_ "SystemSignalLongSymbol" SG_ 2147614218 Entertainment_Library_Data_File_ "Entertainment_Library_Data_File_RawPayload";
BA_ "SystemSignalLongSymbol" SG_ 2147614219 Entertainment_Library_Data_Group "Entertainment_Library_Data_Group_RawPayload";
BA_ "SystemSignalLongSymbol" SG_ 2147614220 Entertainment_Library_Data_Searc "Entertainment_Library_Data_Searc_RawPayload";
BA_ "SystemSignalLongSymbol" SG_ 2147614221 Entertainment_Supported_Source_D "Entertainment_Supported_Source_D_RawPayload";
BA_ "SystemSignalLongSymbol" SG_ 2147614222 Entertainment_Supported_Zone_Dat "Entertainment_Supported_Zone_Dat_RawPayload";
BA_ "SystemSignalLongSymbol" SG_ 2147614223 Entertainment_Parental_Control_S "Entertainment_Parental_Control_S_RawPayload";
BA_ "SystemSignalLongSymbol" SG_ 2147614226 Vessel_Speed_Components_RawPaylo "Vessel_Speed_Components_RawPayload";
BA_ "SystemSignalLongSymbol" SG_ 2147614227 Entertainment_System_Configurati "Entertainment_System_Configurati_RawPayload";
BA_ "SystemSignalLongSymbol" SG_ 2147614228 Entertainment_System_Configurati "Entertainment_System_Configurati_RawPayload";
BA_ "SystemSignalLongSymbol" SG_ 2147614229 Entertainment_Zone_Configuration "Entertainment_Zone_Configuration_RawPayload";
BA_ "SystemSignalLongSymbol" SG_ 2147614230 Entertainment_Zone_Volume_RawPay "Entertainment_Zone_Volume_RawPayload";
BA_ "SystemSignalLongSymbol" SG_ 2147614231 Entertainment_Available_Audio_EQ "Entertainment_Available_Audio_EQ_RawPayload";
BA_ "SystemSignalLongSymbol" SG_ 2147614232 Entertainment_Bluetooth_Devices_ "Entertainment_Bluetooth_Devices_RawPayload";
BA_ "SystemSignalLongSymbol" SG_ 2147614233 Entertainment_Bluetooth_Source_S "Entertainment_Bluetooth_Source_S_RawPayload";
BA_ "SystemSignalLongSymbol" SG_ 2147614234 Entertainment_Zone_Configuration "Entertainment_Zone_Configuration_RawPayload";
